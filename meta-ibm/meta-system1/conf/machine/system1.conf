## meta-ibm/meta-system1/conf/machine/system1.conf
```bitbake
KERNEL_DEVICETREE = "aspeed/aspeed-bmc-ibm-system1.dtb"

UBOOT_MACHINE = "ast2600_openbmc_spl_emmc_defconfig"
# Enable real device tree once available
#UBOOT_DEVICETREE = "ast2600-system1"
UBOOT_DEVICETREE = "ast2600-p10bmc"
SPL_BINARY = "spl/u-boot-spl.bin"

require conf/distro/include/phosphor-mmc.inc
require conf/machine/include/ast2600.inc
require conf/machine/include/obmc-bsp-common.inc
include conf/distro/include/extra-dev-debug-tools.inc

MACHINE_FEATURES += "\
      obmc-phosphor-chassis-mgmt \
      obmc-host-ipmi \
      obmc-phosphor-flash-mgmt \
      "
PREFERRED_PROVIDER_virtual/obmc-host-ipmi-hw = "phosphor-ipmi-kcs"

VIRTUAL-RUNTIME_obmc-sensors-hwmon = "dbus-sensors"

OBMC_POWER_SUPPLY_INSTANCES = "0 1 2 3"
FLASH_SIZE = "16777216"
SERIAL_CONSOLES = "115200;ttyS4"

FIT_HASH_ALG = "sha512"
FIT_SIGN_ALG = "rsa4096"
FIT_SIGN_NUMBITS = "4096"
UBOOT_FITIMAGE_ENABLE = "1"
UBOOT_FIT_HASH_ALG = "sha512"
UBOOT_FIT_SIGN_ALG = "rsa4096"
UBOOT_FIT_SIGN_NUMBITS = "4096"

# TODO: Enable signing at a later date
SOCSEC_SIGN_ENABLE = "0"

PACKAGECONFIG:append:pn-opkg = " curl ssl-curl"
```

## meta-ibm/meta-witherspoon/conf/layer.conf
```bitbake
# We have a conf and classes directory, add to BBPATH
BBPATH .= ":${LAYERDIR}"

# We have recipes-* directories, add to BBFILES
BBFILES += "${LAYERDIR}/recipes-*/*/*.bb \
            ${LAYERDIR}/recipes-*/*/*.bbappend"

BBFILE_COLLECTIONS += "witherspoon-layer"
BBFILE_PATTERN_witherspoon-layer = ""
LAYERSERIES_COMPAT_witherspoon-layer = "thud"
```

## meta-ibm/meta-witherspoon/conf/machine/swift.conf
```bitbake
require conf/machine/witherspoon.conf

# TODO Change to ${KMACHINE}-bmc-opp-swift.dtb when the device tree is available
KERNEL_DEVICETREE = "${KMACHINE}-bmc-opp-witherspoon.dtb"

# TODO Update once a Swift MRW is available
PHOSPHOR_MRW_LICENSE = "Apache-2.0"
PHOSPHOR_MRW_LIC_FILES_CHKSUM = "file://LICENSE;md5=e3fc50a88d0a364313df4b21ef20c29e"
PHOSPHOR_MRW_URI = "git://git@github.com/open-power/swift-xml;protocol=ssh"
PHOSPHOR_MRW_REV = "661fdc993683bd40df4e5f11463ba51da702c55b"

# 128MB flash size
FLASH_SIZE = "131072"

# 32MB read-write filesystem
FLASH_UBI_RWFS_SIZE ?= "32768"
FLASH_UBI_RWFS_TXT_SIZE ?= "32MiB"
BMC_RW_SIZE = "0x2000000"
```

## meta-ibm/meta-witherspoon/conf/machine/witherspoon-128.conf
```bitbake
MACHINEOVERRIDES =. "witherspoon:"
require conf/machine/witherspoon.conf

KERNEL_DEVICETREE = "${KMACHINE}-bmc-opp-${MACHINE}.dtb"

MRW_XML = "witherspoon.xml"

# 128MB flash size
FLASH_SIZE = "131072"

# 32MB read-write filesystem
FLASH_UBI_RWFS_SIZE ?= "32768"
FLASH_UBI_RWFS_TXT_SIZE ?= "32MiB"
BMC_RW_SIZE = "0x2000000"
```

## meta-ibm/meta-witherspoon/conf/machine/witherspoon.conf
```bitbake
KMACHINE = "aspeed"
KERNEL_DEVICETREE = "${KMACHINE}-bmc-opp-${MACHINE}.dtb"
KERNEL_FEATURES_append = " phosphor-wdt-on-panic"

UBOOT_MACHINE = "ast_g5_ncsi_config"

OBMC_POWER_SUPPLY_INSTANCES = "0 1"

PREFERRED_PROVIDER_virtual/p9-vcs-workaround = ''

require conf/machine/include/ast2500.inc
require conf/machine/include/obmc-bsp-common.inc
require conf/machine/include/ibm.inc
require conf/machine/include/p9.inc

PHOSPHOR_MRW_LICENSE = "Apache-2.0"
PHOSPHOR_MRW_LIC_FILES_CHKSUM = "file://LICENSE;md5=e3fc50a88d0a364313df4b21ef20c29e"
PHOSPHOR_MRW_URI = "git://github.com/open-power/witherspoon-xml"
PHOSPHOR_MRW_REV = "6ca015dbd3e1e9d5206f9ec13ec9db2d8965e181"

# Inhibit phosphor-hwmon-config-mrw
VIRTUAL-RUNTIME_phosphor-hwmon-config_df-mrw = ""

# Inhibit phosphor-fan-presence-mrw-native
PREFERRED_PROVIDER_virtual/phosphor-fan-presence-config_df-mrw = \
    "phosphor-fan-presence-config-native"

# Inhibit phosphor-fan-control-fan-config-mrw-native
PREFERRED_PROVIDER_virtual/phosphor-fan-control-fan-config_df-mrw = \
    "phosphor-fan-control-fan-config-native"
```

## meta-ibm/meta-z/conf/bblayers.conf.sample
```bitbake
# LAYER_CONF_VERSION is increased each time build/conf/bblayers.conf
# changes incompatibly
LCONF_VERSION = "8"

BBPATH = "${TOPDIR}"
BBFILES ?= ""

BBLAYERS ?= " \
  ##OEROOT##/meta \
  ##OEROOT##/meta-openembedded/meta-oe/   \
  ##OEROOT##/meta-openembedded/meta-filesystems/   \
  ##OEROOT##/meta-openembedded/meta-networking/   \
  ##OEROOT##/meta-openembedded/meta-python/   \
  ##OEROOT##/meta-openembedded/meta-webserver \
  ##OEROOT##/meta-phosphor \
  ##OEROOT##/meta-ibm/meta-fsp2 \
  ##OEROOT##/meta-openpower \
  ##OEROOT##/meta-ibm \
  ##OEROOT##/meta-ibm/meta-z \
"
BBLAYERS_NON_REMOVABLE ?= " \
  ##OEROOT##/meta \
  "
```

## meta-ibm/meta-z/conf/layer.conf
```bitbake
# We have a conf and classes directory, add to BBPATH
BBPATH .= ":${LAYERDIR}"

BBFILE_COLLECTIONS += "ibm-z-layer"
BBFILE_PATTERN_ibm-z-layer = ""
```

## meta-ibm/meta-z/conf/machine/ibm-z.conf
```bitbake
MACHINE = "ibm-z"
KERNEL_DEVICETREE = "fsp2.dtb"
KBUILD_DEFCONFIG = "44x/fsp2_defconfig"

require conf/machine/include/fsp2.inc
require conf/machine/include/obmc-bsp-common.inc
require conf/machine/include/ibm.inc

UBOOT_MACHINE_sunray2 = "fsp2_defconfig"
UBOOT_ENTRYPOINT = "0x10000000"
UBOOT_LOADADDRESS = "0x10000000"
```

## meta-ieisystem/conf/machine/include/ieisystem-x86.inc
```bitbake
require conf/machine/include/ieisystem.inc

MACHINE_FEATURES:append = "\
        obmc-chassis-state-mgmt \
        obmc-host-state-mgmt \
        obmc-phosphor-chassis-mgmt \
        "

VIRTUAL-RUNTIME_obmc-host-state-manager ?= "x86-power-control"
VIRTUAL-RUNTIME_obmc-chassis-state-manager ?= "x86-power-control"

PREFERRED_PROVIDER_virtual/obmc-host-ipmi-hw ?= "phosphor-ipmi-kcs"
```

## meta-ieisystem/meta-fp5280g3/conf/layer.conf
```bitbake
# We have a conf and classes directory, add to BBPATH
BBPATH .= ":${LAYERDIR}"

# We have recipes-* directories, add to BBFILES
BBFILES += "${LAYERDIR}/recipes-*/*/*.bb \
            ${LAYERDIR}/recipes-*/*/*.bbappend"

BBFILE_COLLECTIONS += "fp5280g3-layer"
BBFILE_PATTERN_fp5280g3-layer := "^${LAYERDIR}/"
LAYERSERIES_COMPAT_fp5280g3-layer = "scarthgap styhead"
```

## meta-ieisystem/meta-fp5280g3/conf/machine/fp5280g3.conf
```bitbake
KMACHINE = "aspeed"
KERNEL_DEVICETREE = " \
    aspeed/${KMACHINE}-bmc-ieisystem-${MACHINE}.dtb \
"

UBOOT_MACHINE = "ast2600_openbmc_spl_emmc_defconfig"
UBOOT_DEVICETREE = "ast2600-evb"
#UBOOT_DEVICETREE = "ast2600-ieisystem-fp5280g3"
SPL_BINARY = "spl/u-boot-spl.bin"

require conf/distro/include/phosphor-mmc.inc
require conf/machine/include/ast2600.inc
require conf/machine/include/ieisystem.inc
require conf/machine/include/obmc-bsp-common.inc
require conf/machine/include/openpower.inc
require conf/distro/include/pldm.inc

DISTRO_FEATURES += "mpreboot"
MACHINE_FEATURES += "phal"

SOCSEC_SIGN_ENABLE = "0"

FLASH_SIZE = "16777216"
```

## meta-ieisystem/meta-nf5280m7/conf/layer.conf
```bitbake
# We have a conf and classes directory, add to BBPATH
BBPATH .= ":${LAYERDIR}"

# We have recipes-* directories, add to BBFILES
BBFILES += "${LAYERDIR}/recipes-*/*/*.bb \
            ${LAYERDIR}/recipes-*/*/*.bbappend"

BBFILE_COLLECTIONS += "nf5280m7-layer"
BBFILE_PATTERN_nf5280m7-layer = "^${LAYERDIR}/"
LAYERSERIES_COMPAT_nf5280m7-layer = "scarthgap styhead"
```

## meta-ieisystem/meta-nf5280m7/conf/machine/nf5280m7.conf
```bitbake
# Add a device tree for nf5280m7
KMACHINE = "aspeed"
KERNEL_DEVICETREE = " \
    aspeed/${KMACHINE}-bmc-ieisystem-${MACHINE}.dtb \
"

UBOOT_MACHINE = "ast2600_openbmc_spl_defconfig"
UBOOT_DEVICETREE = "ast2600-evb"
# UBOOT_DEVICETREE = "${UMACHINE}-ieisystem-${MACHINE}"
SPL_BINARY = "spl/u-boot-spl.bin"

require conf/machine/include/ast2600.inc
require conf/machine/include/obmc-bsp-common.inc

FLASH_SIZE = "65536"

SOCSEC_SIGN_ENABLE = "0"

require conf/machine/include/ieisystem-x86.inc

VIRTUAL-RUNTIME_obmc-inventory-manager ?= "entity-manager"
```

## meta-ieisystems/conf/layer.conf
```bitbake
# We have a conf and classes directory, add to BBPATH
BBPATH .= ":${LAYERDIR}"

# We have recipes-* directories, add to BBFILES
BBFILES += "${LAYERDIR}/recipes-*/*/*.bb \
            ${LAYERDIR}/recipes-*/*/*.bbappend"

BBFILE_COLLECTIONS += "ieisystems-layer"
BBFILE_PATTERN_ieisystems-layer = "^${LAYERDIR}/"
LAYERSERIES_COMPAT_ieisystems-layer = "nanbield scarthgap"
```

## meta-ingrasys/conf/layer.conf
```bitbake
# We have a conf and classes directory, add to BBPATH
BBPATH .= ":${LAYERDIR}"

BBFILE_COLLECTIONS += "ingrasys"
BBFILE_PATTERN_ingrasys := "^${LAYERDIR}/"
LAYERSERIES_COMPAT_ingrasys = "dunfell gatesgarth"
```

## meta-ingrasys/meta-zaius/conf/layer.conf
```bitbake
# We have a conf and classes directory, add to BBPATH
BBPATH .= ":${LAYERDIR}"

# We have recipes-* directories, add to BBFILES
BBFILES += "${LAYERDIR}/recipes-*/*/*.bb \
            ${LAYERDIR}/recipes-*/*/*.bbappend"

BBFILE_COLLECTIONS += "zaius"
BBFILE_PATTERN_zaius := "^${LAYERDIR}/"
LAYERSERIES_COMPAT_zaius = "dunfell gatesgarth"
```

## meta-ingrasys/meta-zaius/conf/local.conf.sample
```bitbake
MACHINE ??= "zaius"
DISTRO ?= "openbmc-openpower"
PACKAGE_CLASSES ?= "package_rpm"
SANITY_TESTED_DISTROS_append ?= " *"
EXTRA_IMAGE_FEATURES = "debug-tweaks"
USER_CLASSES ?= "buildstats image-mklibs image-prelink"
PATCHRESOLVE = "noop"
BB_DISKMON_DIRS = "\
    STOPTASKS,${TMPDIR},1G,100K \
    STOPTASKS,${DL_DIR},1G,100K \
    STOPTASKS,${SSTATE_DIR},1G,100K \
    STOPTASKS,/tmp,100M,100K \
    ABORT,${TMPDIR},100M,1K \
    ABORT,${DL_DIR},100M,1K \
    ABORT,${SSTATE_DIR},100M,1K \
    ABORT,/tmp,10M,1K"
CONF_VERSION = "1"
```

## meta-ingrasys/meta-zaius/conf/machine/zaius.conf
```bitbake
KMACHINE = "aspeed"
KERNEL_DEVICETREE = "aspeed/${KMACHINE}-bmc-opp-${MACHINE}.dtb"

PREFERRED_PROVIDER_virtual/bootloader = "u-boot-aspeed"
PREFERRED_PROVIDER_u-boot = "u-boot-aspeed"
PREFERRED_PROVIDER_u-boot-fw-utils = "u-boot-fw-utils-aspeed"
UBOOT_MACHINE = "ast_g5_ncsi_config"

FLASH_SIZE = "65536"

require conf/machine/include/ast2500.inc
require conf/machine/include/obmc-bsp-common.inc
require conf/machine/include/ingrasys.inc
require conf/machine/include/p9.inc

require conf/distro/include/phosphor-aspeednic-use-mac2.inc
```

## meta-inspur/conf/layer.conf
```bitbake
# We have a conf and classes directory, add to BBPATH
BBPATH .= ":${LAYERDIR}"

# We have recipes-* directories, add to BBFILES
BBFILES += "${LAYERDIR}/recipes-*/*/*.bb \
            ${LAYERDIR}/recipes-*/*/*.bbappend"

BBFILE_COLLECTIONS += "inspur-layer"
BBFILE_PATTERN_inspur-layer = "^${LAYERDIR}/"
LAYERSERIES_COMPAT_inspur-layer = "dunfell gatesgarth"
```

## meta-inspur/meta-fp5280g2/conf/distro/openbmc-fp5280g2.conf
```bitbake
require conf/distro/openbmc-openpower.conf
require conf/distro/include/inspur-distrovars.inc
```

## meta-inspur/meta-fp5280g2/conf/machine/fp5280g2.conf
```bitbake
KMACHINE = "aspeed"
KERNEL_DEVICETREE = "${KMACHINE}-bmc-inspur-${MACHINE}.dtb"

UBOOT_MACHINE = "evb-ast2500_defconfig"
UBOOT_DEVICETREE = "ast2500-evb"

FLASH_SIZE = "65536"

OBMC_POWER_SUPPLY_INSTANCES = "0 1"

PREFERRED_PROVIDER_virtual/openpower-fru-vpd-layout = "fp5280g2-openpower-fru-vpd-layout-native"
PREFERRED_PROVIDER_virtual/openpower-fru-inventory = "fp5280g2-openpower-fru-inventory-native"

require conf/machine/include/ast2500.inc
require conf/machine/include/obmc-bsp-common.inc
require conf/machine/include/openpower.inc
require conf/machine/include/p9.inc

require conf/distro/include/phosphor-aspeednic-use-mac2.inc

PREFERRED_PROVIDER_virtual/bootloader = "u-boot-aspeed-sdk"
PREFERRED_PROVIDER_u-boot = "u-boot-aspeed-sdk"
PREFERRED_PROVIDER_u-boot-fw-utils = "u-boot-fw-utils-aspeed-sdk"
```

## meta-inspur/meta-nf5280m7/conf/machine/nf5280m7.conf
```bitbake
# Add a device tree for nf5280m7
KMACHINE = "aspeed"
KERNEL_DEVICETREE = "aspeed/${KMACHINE}-bmc-inspur-${MACHINE}.dtb"

UBOOT_MACHINE = "ast2600_openbmc_spl_defconfig"
UMACHINE = "ast2600"
UBOOT_DEVICETREE = "${UMACHINE}-inspur-${MACHINE}"
SPL_BINARY = "spl/u-boot-spl.bin"

require conf/machine/include/ast2600.inc
require conf/machine/include/obmc-bsp-common.inc

FLASH_SIZE = "65536"

SOCSEC_SIGN_ENABLE = "0"
```

## meta-inspur/meta-on5263m5/conf/layer.conf
```bitbake
# We have a conf and classes directory, add to BBPATH
BBPATH .= ":${LAYERDIR}"

# We have recipes-* directories, add to BBFILES
BBFILES += "${LAYERDIR}/recipes-*/*/*.bb \
            ${LAYERDIR}/recipes-*/*/*.bbappend"

BBFILE_COLLECTIONS += "on5263m5-layer"
BBFILE_PATTERN_on5263m5-layer = "^${LAYERDIR}/"
LAYERSERIES_COMPAT_on5263m5-layer = "dunfell gatesgarth"
```
