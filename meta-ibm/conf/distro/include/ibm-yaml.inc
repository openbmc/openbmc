## meta-ibm/meta-romulus/conf/machine/romulus.conf
```bitbake
KMACHINE = "aspeed"
KERNEL_DEVICETREE = "${KMACHINE}-bmc-opp-${MACHINE}.dtb"
UBOOT_MACHINE = "ast_g5_ncsi_config"

require conf/machine/include/ast2500.inc
require conf/machine/include/obmc-bsp-common.inc
require conf/machine/include/openpower.inc
require conf/machine/include/p9.inc

PHOSPHOR_MRW_LICENSE = "Apache-2.0"
PHOSPHOR_MRW_LIC_FILES_CHKSUM = "file://LICENSE;md5=e3fc50a88d0a364313df4b21ef20c29e"
PHOSPHOR_MRW_URI = "git://github.com/open-power/romulus-xml"
PHOSPHOR_MRW_REV = "14b471fbf37f5fb60261de001df83caf5f96d81f"

PREFERRED_PROVIDER_virtual/openpower-occ-control-config-native = "romulus-occ-control-config-native"
PREFERRED_PROVIDER_virtual/phosphor-led-manager-config-native = "romulus-led-manager-config-native"
PREFERRED_PROVIDER_virtual/phosphor-logging-callouts = "romulus-phosphor-logging-callouts-native"
```

## meta-ibm/meta-sbp1/conf/layer.conf
```bitbake
# We have a conf and classes directory, add to BBPATH
BBPATH .= ":${LAYERDIR}/"

BBFILES += "${LAYERDIR}/recipes-*/*/*.bb \
            ${LAYERDIR}/recipes-*/*/*.bbappend"

BBFILE_COLLECTIONS += "sbp1-layer"
BBFILE_PATTERN_sbp1-layer := "^${LAYERDIR}/"
LAYERSERIES_COMPAT_sbp1-layer = "scarthgap styhead"
```

## meta-ibm/meta-sbp1/conf/machine/sbp1.conf
```bitbake
KMACHINE = "aspeed"
KERNEL_DEVICETREE = "aspeed/${KMACHINE}-ast2600-evb.dtb"

UBOOT_MACHINE = "ast2600_openbmc_spl_defconfig"
UBOOT_DEVICETREE = "ast2600a1-evb"
SOCSEC_SIGN_ENABLE = "0"
SPL_BINARY = "spl/u-boot-spl.bin"
FLASH_SIZE = "65536"

SERIAL_CONSOLES = "115200;ttyS0"

OBMC_POWER_SUPPLY_INSTANCES = "0 1 2 3"

MACHINE_FEATURES += " \
        obmc-bmc-state-mgmt \
        obmc-phosphor-fan-mgmt \
        obmc-phosphor-chassis-mgmt \
        obmc-chassis-state-mgmt \
        obmc-host-state-mgmt \
        "

require conf/machine/include/ast2600.inc
require conf/machine/include/obmc-bsp-common.inc

PREFERRED_PROVIDER_virtual/phosphor-led-manager-config-native = "sbp1-led-manager-config-native"

VIRTUAL-RUNTIME_obmc-sensors-hwmon = "dbus-sensors"
```

## meta-ibm/meta-system1/conf/layer.conf
```bitbake
# We have a conf and classes directory, add to BBPATH
BBPATH .= ":${LAYERDIR}"

# We have recipes-* directories, add to BBFILES
BBFILES += "${LAYERDIR}/recipes-*/*/*.bb \
            ${LAYERDIR}/recipes-*/*/*.bbappend"

BBFILE_COLLECTIONS += "system1-layer"
BBFILE_PATTERN_system1-layer := "^${LAYERDIR}/"
LAYERSERIES_COMPAT_system1-layer = "scarthgap styhead"
```
