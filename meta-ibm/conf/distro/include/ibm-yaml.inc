## meta-ibm/conf/distro/openbmc-witherspoon.conf
```bitbake
require conf/distro/openbmc-openpower.conf
require conf/distro/include/phosphor-ubi.inc
require conf/distro/include/openpower-mrw.inc
require conf/distro/include/openpower-ubi.inc
```

## meta-ibm/conf/layer.conf
```bitbake
# We have a conf and classes directory, add to BBPATH
BBPATH .= ":${LAYERDIR}"

# We have recipes-* directories, add to BBFILES
BBFILES += "${LAYERDIR}/recipes-*/*/*.bb \
            ${LAYERDIR}/recipes-*/*/*.bbappend"

BBFILE_COLLECTIONS += "ibm-layer"
BBFILE_PATTERN_ibm-layer := "^${LAYERDIR}/"
LAYERSERIES_COMPAT_ibm-layer = "scarthgap styhead"

# Only bring in meta-openpower bbappend files if meta-openpower is
# included in the layer
BBFILES_DYNAMIC += "\
    openpower-layer:${LAYERDIR}/dynamic-layers/meta-openpower/recipes-*/*/*.bbappend \
"
```

## meta-ibm/conf/machine/huygens.conf
```bitbake
MACHINEOVERRIDES =. "pstbmc:"
require conf/machine/pstbmc.conf
require conf/distro/include/chrony.inc
require conf/machine/include/redundant-bmc.inc
require conf/machine/include/tpm2.inc

# Focus Huygens initially on a multi-BMC setup for integrating
# BMC to BMC redundancy logic. Remove anything host or chassis
# related that causes failures booting to BMC Ready.
MACHINE_FEATURES:remove = " \
    op-fsi \
    phal \
    "

DISTRO_FEATURES:remove = " \
    openpower-virtual-pnor \
    openpower-hostfw-over-pldm \
    mpreboot \
    "

IMAGE_FEATURES:remove = " \
    obmc-leds \
    obmc-chassis-mgmt \
    obmc-fan-control \
    obmc-fan-mgmt \
    obmc-host-ctl \
    obmc-host-ipmi \
    "
```

## meta-ibm/conf/machine/include/ibm-enterprise.inc
```bitbake
# A machine override for common machine configuration for all of IBM's
# enterprise based servers
MACHINEOVERRIDES =. "ibm-enterprise:"
```

## meta-ibm/conf/machine/mihawk.conf
```bitbake
KMACHINE = "aspeed"
KERNEL_DEVICETREE = "${KMACHINE}-bmc-opp-${MACHINE}.dtb"

UBOOT_MACHINE = "ast_g5_ncsi_config"

OBMC_POWER_SUPPLY_INSTANCES = "0 1"

PREFERRED_PROVIDER_virtual/openpower-fru-vpd-layout = "mihawk-openpower-fru-vpd-layout-native"

require conf/machine/include/ast2500.inc
require conf/machine/include/obmc-bsp-common.inc
require conf/machine/include/openpower.inc
require conf/machine/include/p9.inc
require conf/distro/include/phosphor-aspeednic-use-mac2.inc

PHOSPHOR_MRW_LICENSE = "Apache-2.0"
PHOSPHOR_MRW_LIC_FILES_CHKSUM = "file://LICENSE;md5=86d3f3a95c324c9479bd8986968f4327"
PHOSPHOR_MRW_URI = "git://github.com/open-power/mihawk-xml"
PHOSPHOR_MRW_REV = "f6ec5aa0f9803d44b147a7670dec7ec935f59582"



# Inhibit phosphor-hwmon-config-mrw
VIRTUAL-RUNTIME_phosphor-hwmon-config_df-mrw = ""

# Inhibit phosphor-fan-presence-mrw-native
PREFERRED_PROVIDER_virtual/phosphor-fan-presence-config_df-mrw = \
    "phosphor-fan-presence-config"

# Inhibit phosphor-fan-control-fan-config-mrw-native
PREFERRED_PROVIDER_virtual/phosphor-fan-control-fan-config_df-mrw = \
    "phosphor-fan-control-fan-config"

# Inhibit mihawk-led-manager-config-native
PREFERRED_PROVIDER_virtual/phosphor-led-manager-config-native_df-mrw = \
    "mihawk-led-manager-config-native"

PREFERRED_PROVIDER_virtual/phosphor-logging-callouts_df-mrw = "mihawk-phosphor-logging-callouts-native"

PREFERRED_PROVIDER_virtual/openpower-fru-inventory_df-mrw = "mihawk-openpower-fru-inventory-native"
```

## meta-ibm/conf/machine/p10bmc-distributed.conf
```bitbake
MACHINEOVERRIDES =. "p10bmc:"
require conf/machine/p10bmc.conf
require conf/distro/include/etcd.inc
```

## meta-ibm/conf/machine/p10bmc.conf
```bitbake
DISTRO_NAME = "IBM eBMC (OpenBMC for IBM Enterprise Systems)"

# The first dtb listed is the one used by default on a BMC genesis boot.
# Need bonnell to be the first one because it contains an eeprom that's bigger
# than in the other systems. Otherwise the device driver would truncate the data
# on that eeprom on a bonnell system.
KERNEL_DEVICETREE = \
    "aspeed/aspeed-bmc-ibm-bonnell.dtb \
     aspeed/aspeed-bmc-ibm-rainier.dtb \
     aspeed/aspeed-bmc-ibm-rainier-4u.dtb \
     aspeed/aspeed-bmc-ibm-rainier-1s4u.dtb \
     aspeed/aspeed-bmc-ibm-everest.dtb"
UBOOT_MACHINE = "ast2600_openbmc_spl_emmc_defconfig"
UBOOT_DEVICETREE = "ast2600-p10bmc"
SPL_BINARY = "spl/u-boot-spl.bin"

OBMC_POWER_SUPPLY_INSTANCES = "0 1 2 3"

require conf/distro/include/phosphor-mmc.inc
require conf/machine/include/ast2600.inc
require conf/machine/include/obmc-bsp-common.inc
require conf/machine/include/openpower.inc
require conf/machine/include/p10.inc
require conf/distro/include/openpower-virtual-pnor.inc
require conf/distro/include/openpower-hostfw-over-pldm.inc
require conf/distro/include/ibm-mpreboot.inc
require conf/distro/include/ibm-yaml.inc
require conf/distro/include/google-authenticator-libpam.inc
include conf/distro/include/extra-dev-debug-tools.inc
DISTRO_FEATURES += "ibm-service-account-policy"
MACHINE_FEATURES += "phal tpm2"

SERIAL_CONSOLES = "115200;ttyS4"

MRW_XML = "witherspoon.xml"
PHOSPHOR_MRW_LICENSE = "Apache-2.0"
PHOSPHOR_MRW_LIC_FILES_CHKSUM = "file://LICENSE;md5=e3fc50a88d0a364313df4b21ef20c29e"
PHOSPHOR_MRW_URI = "git://github.com/open-power/witherspoon-xml;branch=master;protocol=https"
PHOSPHOR_MRW_REV = "c622cb5a5dd3ebc2a4eef558d1b70740f914e6f7"

VIRTUAL-RUNTIME_phosphor-hwmon-config:df-mrw = ""

PREFERRED_PROVIDER_virtual/phosphor-fan-control-fan-config:df-mrw = \
    "phosphor-fan-control-fan-config"
PREFERRED_PROVIDER_virtual/phosphor-fan-presence-config:df-mrw = \
    "phosphor-fan-presence-config"

SKIP_BROKEN_MRW = "1"

IMAGE_FEATURES:remove = "obmc-ikvm"

UBOOT_SIGN_ENABLE = "1"
SPL_SIGN_ENABLE = "1"

FIT_HASH_ALG = "sha512"
FIT_SIGN_ALG = "rsa4096"
FIT_SIGN_NUMBITS = "4096"
UBOOT_FITIMAGE_ENABLE = "1"
UBOOT_FIT_HASH_ALG = "sha512"
UBOOT_FIT_SIGN_ALG = "rsa4096"
UBOOT_FIT_SIGN_NUMBITS = "4096"

UBOOT_SIGN_KEYNAME = "rsa_oem_fitimage_key"
SPL_SIGN_KEYNAME = "rsa_oem_fitimage_key"

UBOOT_SIGN_KEYDIR = "${WORKDIR}"
SPL_SIGN_KEYDIR = "${WORKDIR}"

SOCSEC_SIGN_ENABLE = "1"

DEBUG_TRIGGERS = "kcs2"
PACKAGECONFIG:append:pn-debug-trigger = " triggers"

PACKAGECONFIG:pn-opkg = "curl openssl ssl-curl"
PACKAGECONFIG:remove:pn-entity-manager = "ipmi-fru"

# Add zImage to images directory for Qemu
KERNEL_IMAGETYPES +=" zImage "

# Produce a .qcow2 of the wic for Qemu
IMAGE_FSTYPES +=" wic.qcow2 "

QB_ROOTFS_OPT:p10bmc="-drive file=@ROOTFS@,if=sd,format=qcow2,index=2"
QB_MACHINE:p10bmc="-machine rainier-bmc"
QB_DTB:p10bmc="aspeed/aspeed-bmc-ibm-rainier.dtb"
QB_MEM:p10bmc="-m 1024"
QB_DEFAULT_FSTYPE:p10bmc="wic.qcow2"
QB_FSINFO = "wic:no-kernel-in-fs"
QB_DEFAULT_KERNEL:p10bmc="zImage"
QB_KERNEL_ROOT:p10bmc="PARTLABEL=rofs-a"

FLASH_SIZE = "16777216"
```

## meta-ibm/conf/machine/swift.conf
```bitbake
require conf/machine/witherspoon.conf

IMAGE_FSTYPES += "ext4 mmc-ext4-tar"

KERNEL_DEVICETREE = "${KMACHINE}-bmc-opp-${MACHINE}.dtb"

PHOSPHOR_MRW_LICENSE = "Apache-2.0"
PHOSPHOR_MRW_LIC_FILES_CHKSUM = "file://LICENSE;md5=e3fc50a88d0a364313df4b21ef20c29e"
PHOSPHOR_MRW_URI = "git://git@github.com/open-power/swift-xml;protocol=ssh"
PHOSPHOR_MRW_REV = "2b59e12db44e167a1652777b770674d235ec55ba"

# 128MB flash size
FLASH_SIZE = "131072"

# 32MB read-write filesystem
FLASH_UBI_RWFS_SIZE ?= "32768"
FLASH_UBI_RWFS_TXT_SIZE ?= "32MiB"
BMC_RW_SIZE = "0x2000000"

# Inhibit swift-led-manager-config-native
PREFERRED_PROVIDER_virtual/phosphor-led-manager-config-native_df-mrw = \
    "swift-led-manager-config-native"
```

## meta-ibm/conf/machine/witherspoon-tacoma.conf
```bitbake
KERNEL_DEVICETREE = "aspeed/aspeed-bmc-opp-tacoma.dtb"
UBOOT_MACHINE = "ast2600_openbmc_spl_emmc_defconfig"
UBOOT_DEVICETREE = "ast2600-tacoma"
SPL_BINARY = "spl/u-boot-spl.bin"
SOCSEC_SIGN_ENABLE = "0"

OBMC_POWER_SUPPLY_INSTANCES = "0 1"

MACHINEOVERRIDES =. "ibm-ac-server:witherspoon:"
require conf/distro/include/phosphor-mmc.inc
require conf/machine/include/ast2600.inc
require conf/machine/include/obmc-bsp-common.inc
require conf/machine/include/openpower.inc
require conf/machine/include/p9.inc
require conf/distro/include/ibm-yaml.inc
require conf/distro/include/openpower-virtual-pnor.inc
require conf/distro/include/ibm-mpreboot.inc
include conf/distro/include/extra-dev-debug-tools.inc
DISTRO_FEATURES += "ibm-service-account-policy"

SERIAL_CONSOLES = "115200;ttyS4"

MRW_XML = "witherspoon.xml"
PHOSPHOR_MRW_LICENSE = "Apache-2.0"
PHOSPHOR_MRW_LIC_FILES_CHKSUM = "file://LICENSE;md5=e3fc50a88d0a364313df4b21ef20c29e"
PHOSPHOR_MRW_URI = "git://github.com/open-power/witherspoon-xml;branch=master;protocol=https"
PHOSPHOR_MRW_REV = "c622cb5a5dd3ebc2a4eef558d1b70740f914e6f7"

VIRTUAL-RUNTIME_phosphor-hwmon-config:df-mrw = ""

PREFERRED_PROVIDER_virtual/phosphor-fan-control-fan-config:df-mrw = \
    "phosphor-fan-control-fan-config"
PREFERRED_PROVIDER_virtual/phosphor-fan-presence-config:df-mrw = \
    "phosphor-fan-presence-config"

# The eMMC on Tacoma is just 1GB smaller than Rainier. The template file
# meta-aspeed/wic/emmc-aspeed.wks.in builds an image for the size of Rainier as
# the default. To be able to re-use that template for Tacoma, the size of the
# last partition (hostfw) was made configurable. The default size of the hostfw
# partition is 5GB, therefore setting it to 4GB for Tacoma.
WKS_HOSTFW_SIZE = "4G"

IMAGE_FEATURES:remove = "obmc-ikvm"

DEBUG_TRIGGERS = "kcs2"
PACKAGECONFIG:append:pn-debug-trigger = " triggers"
```

## meta-ibm/conf/machine/witherspoon.conf
```bitbake
KMACHINE = "aspeed"
KERNEL_DEVICETREE = "aspeed/${KMACHINE}-bmc-opp-${MACHINE}.dtb"

PREFERRED_PROVIDER_virtual/bootloader = "u-boot-aspeed"
PREFERRED_PROVIDER_u-boot = "u-boot-aspeed"
PREFERRED_PROVIDER_u-boot-fw-utils = "u-boot-fw-utils-aspeed"
UBOOT_MACHINE = "ast_g5_ncsi_config"

OBMC_POWER_SUPPLY_INSTANCES = "0 1"

# A machine override for common machine configuration for all of IBM's
# "Accelerated Computing" class of systems.
MACHINEOVERRIDES =. "ibm-ac-server:"
require conf/distro/include/phosphor-ubi.inc
require conf/distro/include/openpower-mrw.inc
require conf/distro/include/openpower-ubi.inc
require conf/machine/include/ast2500.inc
require conf/machine/include/obmc-bsp-common.inc
require conf/machine/include/openpower.inc
require conf/machine/include/p9.inc
require conf/distro/include/ibm-yaml.inc
require conf/distro/include/phosphor-no-webui.inc

PHOSPHOR_MRW_LICENSE = "Apache-2.0"
PHOSPHOR_MRW_LIC_FILES_CHKSUM = "file://LICENSE;md5=e3fc50a88d0a364313df4b21ef20c29e"
PHOSPHOR_MRW_URI = "git://github.com/open-power/witherspoon-xml;branch=master;protocol=https"
PHOSPHOR_MRW_REV = "c622cb5a5dd3ebc2a4eef558d1b70740f914e6f7"

# Inhibit phosphor-hwmon-config-mrw
VIRTUAL-RUNTIME_phosphor-hwmon-config:df-mrw = ""

# Inhibit phosphor-fan-presence-mrw-native
PREFERRED_PROVIDER_virtual/phosphor-fan-presence-config:df-mrw = \
    "phosphor-fan-presence-config"

# Inhibit phosphor-fan-control-fan-config-mrw-native
PREFERRED_PROVIDER_virtual/phosphor-fan-control-fan-config:df-mrw = \
    "phosphor-fan-control-fan-config"

IMAGE_FEATURES:remove = "obmc-ikvm obmc-remote-logging-mgmt"
PACKAGECONFIG:remove:pn-entity-manager = "ipmi-fru"

QB_DEFAULT_FSTYPE:witherspoon = "ubi.mtd"
QB_MACHINE:witherspoon = "-machine witherspoon-bmc"
QB_MEM:witherspoon = "-m 512"
```

## meta-ibm/meta-fsp2/conf/layer.conf
```bitbake
# We have a conf and classes directory, add to BBPATH
BBPATH .= ":${LAYERDIR}"

BBFILES += "${LAYERDIR}/recipes-*/*/*.bb \
            ${LAYERDIR}/recipes-*/*/*.bbappend"

BBFILE_PATTERN_fsp2-layer := "^${LAYERDIR}/"
BBFILE_COLLECTIONS += "fsp2-layer"
LAYERVERSION_fsp2-layer = "1"
```

## meta-ibm/meta-fsp2/conf/machine/include/fsp2.inc
```bitbake
#@TYPE: Machine
#@NAME: fsp2
#@DESCRIPTION: evaluation machine board configuration for the fsp2 ppc476

PREFERRED_PROVIDER_virtual/kernel ?= "linux-fsp2"
PREFERRED_PROVIDER_virtual/bootloader ?= "u-boot-fsp2"

DEFAULTTUNE = "powerpc-nf"

SERIAL_CONSOLES = "115200;ttyS0"

MACHINEOVERRIDES .= ":fsp2"

require conf/machine/include/powerpc/arch-powerpc.inc
```

## meta-ibm/meta-fsp2/conf/machine/sunray2.conf
```bitbake
MACHINE = "sunray2"
KERNEL_DEVICETREE = "fsp2.dtb"
KBUILD_DEFCONFIG = "44x/fsp2_defconfig"

require conf/machine/include/fsp2.inc

UBOOT_MACHINE_sunray2 = "fsp2_defconfig"
UBOOT_ENTRYPOINT = "0x10000000"
UBOOT_LOADADDRESS = "0x10000000"
```

## meta-ibm/meta-genesis3/conf/layer.conf
```bitbake
# We have a conf and classes directory, add to BBPATH
BBPATH .= ":${LAYERDIR}/"

BBFILES += "${LAYERDIR}/recipes-*/*/*.bb \
            ${LAYERDIR}/recipes-*/*/*.bbappend"

BBFILE_COLLECTIONS += "genesis3-layer"
BBFILE_PATTERN_genesis3-layer := "^${LAYERDIR}/"
LAYERSERIES_COMPAT_genesis3-layer = "scarthgap styhead"
```

## meta-ibm/meta-genesis3/conf/machine/genesis3.conf
```bitbake
KMACHINE = "aspeed"
KERNEL_DEVICETREE = "aspeed/${KMACHINE}-ast2500-evb.dtb"

PREFERRED_PROVIDER_virtual/bootloader = "u-boot-aspeed"
PREFERRED_PROVIDER_u-boot = "u-boot-aspeed"
PREFERRED_PROVIDER_u-boot-fw-utils = "u-boot-fw-utils-aspeed"
UBOOT_MACHINE = "ast_g5_phy_defconfig"
UBOOT_DEVICETREE = "ast2500-evb"

OBMC_POWER_SUPPLY_INSTANCES = "0 1"

MACHINE_FEATURES += " \
        obmc-bmc-state-mgmt \
        obmc-phosphor-fan-mgmt \
        obmc-phosphor-chassis-mgmt \
        obmc-chassis-state-mgmt \
        obmc-host-state-mgmt \
        "

require conf/machine/include/ast2500.inc
require conf/machine/include/obmc-bsp-common.inc

PREFERRED_PROVIDER_virtual/phosphor-led-manager-config-native = "gen3-led-manager-config-native"

VIRTUAL-RUNTIME_obmc-sensors-hwmon = "dbus-sensors"
```

## meta-ibm/meta-palmetto/conf/layer.conf
```bitbake
# We have a conf and classes directory, add to BBPATH
BBPATH .= ":${LAYERDIR}"

# We have recipes-* directories, add to BBFILES
BBFILES += "${LAYERDIR}/recipes-*/*/*.bb \
            ${LAYERDIR}/recipes-*/*/*.bbappend"

BBFILE_COLLECTIONS += "palmetto-layer"
BBFILE_PATTERN_palmetto-layer := "^${LAYERDIR}/"
LAYERSERIES_COMPAT_palmetto-layer = "dunfell gatesgarth"
```

## meta-ibm/meta-palmetto/conf/machine/palmetto.conf
```bitbake
KMACHINE = "aspeed"
KERNEL_DEVICETREE = "${KMACHINE}-bmc-opp-${MACHINE}.dtb"

require conf/machine/include/ast2400.inc
require conf/machine/include/obmc-bsp-common.inc
require conf/machine/include/openpower.inc
require conf/machine/include/p8.inc

UBOOT_MACHINE_palmetto = "ast_g4_ncsi_config"
UBOOT_ENTRYPOINT = "0x40008000"
UBOOT_LOADADDRESS = "0x40008000"

FLASH_SIZE = "32768"

PHOSPHOR_MRW_LICENSE = "Apache-2.0"
PHOSPHOR_MRW_LIC_FILES_CHKSUM = "file://LICENSE;md5=d2794c0df5b907fdace235a619d80314"
PHOSPHOR_MRW_URI = "git://github.com/open-power/palmetto-xml"
PHOSPHOR_MRW_REV = "82818682f2c2009c30d700df6d5f8897a3096e4f"

PREFERRED_PROVIDER_virtual/phosphor-led-manager-config-native = "palmetto-led-manager-config-native"
PREFERRED_PROVIDER_virtual/openpower-occ-control-config-native = "palmetto-occ-control-config-native"
```

## meta-ibm/meta-romulus/conf/distro/openbmc-romulus.conf
```bitbake
require conf/distro/openbmc-openpower.conf
require conf/distro/include/phosphor-isolation.inc
```

## meta-ibm/meta-romulus/conf/layer.conf
```bitbake
# We have a conf and classes directory, add to BBPATH
BBPATH .= ":${LAYERDIR}"

# We have recipes-* directories, add to BBFILES
BBFILES += "${LAYERDIR}/recipes-*/*/*.bb \
            ${LAYERDIR}/recipes-*/*/*.bbappend"

BBFILE_COLLECTIONS += "romulus"
BBFILE_PATTERN_romulus = ""
LAYERSERIES_COMPAT_romulus = "sumo"
```
