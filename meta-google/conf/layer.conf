## meta-hxt/meta-stardragon4800-rep2/conf/bblayers.conf.sample
```bitbake
# LAYER_CONF_VERSION is increased each time build/conf/bblayers.conf
# changes incompatibly
LCONF_VERSION = "8"

BBPATH = "${TOPDIR}"
BBFILES ?= ""

BBLAYERS ?= " \
  ##OEROOT##/meta \
  ##OEROOT##/meta-poky \
  ##OEROOT##/meta-openembedded/meta-oe \
  ##OEROOT##/meta-openembedded/meta-networking \
  ##OEROOT##/meta-openembedded/meta-perl \
  ##OEROOT##/meta-openembedded/meta-python \
  ##OEROOT##/meta-openembedded/meta-webserver \
  ##OEROOT##/meta-phosphor \
  ##OEROOT##/meta-aspeed \
  ##OEROOT##/meta-arm \
  ##OEROOT##/meta-hxt \
  ##OEROOT##/meta-hxt/meta-stardragon4800-rep2 \
  "
BBLAYERS_NON_REMOVABLE ?= " \
  ##OEROOT##/meta \
  ##OEROOT##/meta-poky \
  ##OEROOT##/meta-openembedded/meta-oe \
  ##OEROOT##/meta-openembedded/meta-networking \
  ##OEROOT##/meta-openembedded/meta-perl \
  ##OEROOT##/meta-openembedded/meta-python \
  ##OEROOT##/meta-openembedded/meta-webserver \
  ##OEROOT##/meta-phosphor \
  ##OEROOT##/meta-aspeed \
  ##OEROOT##/meta-arm \
  ##OEROOT##/meta-hxt \
  ##OEROOT##/meta-hxt/meta-stardragon4800-rep2 \
  "
```

## meta-hxt/meta-stardragon4800-rep2/conf/layer.conf
```bitbake
# We have a conf and classes directory, add to BBPATH
BBPATH .= ":${LAYERDIR}"

# We have recipes-* directories, add to BBFILES
BBFILES += "${LAYERDIR}/recipes-*/*/*.bb \
            ${LAYERDIR}/recipes-*/*/*.bbappend"

BBFILE_COLLECTIONS += "stardragon4800-rep2"
BBFILE_PATTERN_stardragon4800-rep2 = ""
```

## meta-hxt/meta-stardragon4800-rep2/conf/machine/stardragon4800-rep2.conf
```bitbake
KMACHINE = "aspeed"
KERNEL_DEVICETREE = "${KMACHINE}-ast2500-evb.dtb"

UBOOT_MACHINE = "ast_g5_ncsi_config"

FLASH_SIZE = "32768"


PREFERRED_PROVIDER_virtual/phosphor-ipmi-fru-hostfw-config= ""
require conf/machine/include/ast2500.inc
require conf/machine/include/obmc-bsp-common.inc
require conf/machine/include/hxt.inc

IMAGE_INSTALL_append = " ir38163-workaround \
                         stardragon4800-rep2-console-client \
                         socupdate \
"
```

## meta-ibm/conf/distro/include/ibm-audit.inc
```bitbake
# Enable audit with default configuration for IBM systems
# This file enables audit and sets default rules/daemon configuration

# Include core audit infrastructure
require conf/distro/include/linux-audit.inc

# ============================================================================
# AUDIT RULES CONFIGURATION
# ============================================================================
#
# RATIONALE FOR RULE SELECTION:
# ------------------------------
# AUDIT_EXCLUDE_BPF: Reduce noise from BPF events. BPF (Berkeley Packet
#    Filter) events are very frequent in modern systems and typically not
#    security-relevant for BMC monitoring

# Exclude noisy message types
AUDIT_EXCLUDE_BPF = "1"

# ============================================================================
# AUDITD DAEMON CONFIGURATION
# ============================================================================

# Limit amount of disk space logging can consume
AUDITD_MAX_LOG_FILE = "2"
AUDITD_NUM_LOGS = "5"
AUDITD_MAX_LOG_FILE_ACTION = "ROTATE"

# ============================================================================
# SYSTEM DAEMON CONFIGURATION
# ============================================================================

# Disable writing audit entries to journal
AUDIT_JOURNAL = "0"
```

## meta-ibm/conf/distro/include/ibm-mpreboot.inc
```bitbake
# mpreboot is an ibm specific system reboot which preserves the host
# memory. This is utilized to debug issues in the host software.
DISTRO_FEATURES += "mpreboot"
```
