## meta-evb/meta-evb-enclustra/meta-evb-zx3-pm3/conf/layer.conf
```bitbake
# We have a conf and classes directory, add to BBPATH
BBPATH .= ":${LAYERDIR}"

# We have recipes-* directories, add to BBFILES
BBFILES += "${LAYERDIR}/recipes-*/*/*.bb \
            ${LAYERDIR}/recipes-*/*/*.bbappend"

BBFILE_COLLECTIONS += "evb-zx3-pm3"
BBFILE_PATTERN_evb-zx3-pm3 = ""
LAYERSERIES_COMPAT_evb-zx3-pm3 = "dunfell gatesgarth"
```

## meta-evb/meta-evb-enclustra/meta-evb-zx3-pm3/conf/machine/evb-zx3-pm3.conf
```bitbake
SOC_VARIANT ?= "7z"

require conf/machine/include/tune-zynq.inc
require conf/machine/include/machine-xilinx-overrides.inc
require conf/machine/include/machine-xilinx-default.inc
require conf/machine/include/machine-xilinx-board.inc
require conf/machine/include/machine-xilinx-qemu.inc
require conf/machine/include/obmc-bsp-common.inc

MACHINE_FEATURES = "rtc ext2 ext3 vfat usbhost"

# u-boot configuration
UBOOT_MACHINE = "zynq_zc702_config"
SPL_BINARY = "spl/boot.bin"

EXTRA_IMAGEDEPENDS += " \
		u-boot-zynq-uenv \
		virtual/boot-bin \
		"

SERIAL_CONSOLE = "115200 ttyPS0"

KERNEL_DEVICETREE = "zynq-zc702.dtb"

IMAGE_BOOT_FILES += "boot.bin uEnv.txt ${KERNEL_IMAGETYPE}-zynq-zc702.dtb"

# Overwrite flash offsets
FLASH_UBOOT_OFFSET = "0"
FLASH_KERNEL_OFFSET = "6144"
FLASH_UBI_OFFSET = "${FLASH_KERNEL_OFFSET}"
FLASH_ROFS_OFFSET = "12288"
FLASH_RWFS_OFFSET = "65024"
FLASH_SIZE = "65536"

PREFERRED_PROVIDER_virtual/phosphor-led-manager-config-native = "evb-zx3-pm3-led-manager-config-native"
PREFERRED_PROVIDER_u-boot = "u-boot-xlnx"
PREFERRED_PROVIDER_virtual/bootloader = "u-boot"
```

## meta-evb/meta-evb-nuvoton/conf/layer.conf
```bitbake
# We have a conf and classes directory, add to BBPATH
BBPATH .= ":${LAYERDIR}"

BBFILE_COLLECTIONS += "evb-nuvoton"
BBFILE_PATTERN_evb-nuvoton = ""
BBFILE_PATTERN_IGNORE_EMPTY_evb-nuvoton =  "1"
LAYERSERIES_COMPAT_evb-nuvoton = "scarthgap styhead"
```

## meta-evb/meta-evb-nuvoton/meta-buv-runbmc/conf/distro/buv-dev.conf
```bitbake
require conf/distro/openbmc-phosphor.conf

MACHINE_EXTRA_RRECOMMENDS = "kernel-modules"

DISTRO = "buv-dev"
DISTRO_NAME = "Nuvoton OpenBMC (Dev Version)"
DISTRO_FEATURES:append = " buv-dev ext2"
DISTROOVERRIDES .= ":buv-dev"
```

## meta-evb/meta-evb-nuvoton/meta-buv-runbmc/conf/distro/buv-runbmc-emmc-entity.conf
```bitbake
require conf/distro/openbmc-phosphor.conf
require conf/distro/include/phosphor-mmc.inc

VIRTUAL-RUNTIME_obmc-inventory-manager = "entity-manager"
VIRTUAL-RUNTIME_obmc-sensors-hwmon = "dbus-sensors"
PREFERRED_PROVIDER_virtual/obmc-inventory-data = "entity-manager"

DISTRO = "buv-runbmc-emmc"
DISTRO:append = "-entity"
DISTRO_NAME = "Nuvoton OpenBMC (Entity Manager)"
DISTRO_FEATURES:append = " entity-manager"
DISTROOVERRIDES .= ":buv-entity"

# eMMC layout
# max uboot image size in SPI partition is 768K
MMC_UBOOT_SIZE = "640"

WKS_FILE ?= "emmc-buv.wks.in"
WKS_FILE_DEPENDS ?= " \
    virtual/bootloader \
    virtual/kernel \
    "
IMAGE_BOOT_FILES ?= "fitImage-${INITRAMFS_IMAGE}-${MACHINE}-${MACHINE};fitImage"
```

## meta-evb/meta-evb-nuvoton/meta-buv-runbmc/conf/layer.conf
```bitbake
# We have a conf and classes directory, add to BBPATH
BBPATH .= ":${LAYERDIR}"

# We have recipes-* directories, add to BBFILES
BBFILES += "${LAYERDIR}/recipes-*/*/*.bb \
            ${LAYERDIR}/recipes-*/*/*.bbappend"

BBFILE_COLLECTIONS += "buv-runbmc-layer"
BBFILE_PATTERN_buv-runbmc-layer := "^${LAYERDIR}/"
LAYERSERIES_COMPAT_buv-runbmc-layer = "honister kirkstone"
```

## meta-evb/meta-evb-nuvoton/meta-buv-runbmc/conf/machine/buv-runbmc.conf
```bitbake
require conf/machine/include/npcm7xx.inc
require conf/machine/include/obmc-bsp-common.inc

KMACHINE = "nuvoton"
KERNEL_DEVICETREE = "${KMACHINE}-npcm750-buv-runbmc.dtb"

FLASH_SIZE = "65536"
# avoid image_types_phosphor.bbclass override
FLASH_KERNEL_OFFSET:flash-65536 = "2048"
FLASH_ROFS_OFFSET:flash-65536 = "8192"
FLASH_RWFS_OFFSET:flash-65536 = "62464"


UBOOT_MACHINE = "PolegRunBMC_defconfig"
UBOOT_DEVICETREE = "nuvoton-npcm750-buv"
IGPS_MACHINE = "RunBMC"

IMAGE_FSTYPES += " cpio.${INITRAMFS_CTYPE}.u-boot"
IMAGE_FSTYPES += "${@bb.utils.contains('DISTRO_FEATURES', \
        'phosphor-mmc', \
        'wic.gz mmc-ext4-tar', \
        '', d)}"
KERNEL_ALT_IMAGETYPE = "vmlinux"

MACHINE_FEATURES += "\
        obmc-phosphor-fan-mgmt \
        obmc-host-ipmi \
        obmc-phosphor-chassis-mgmt \
        "
VIRTUAL-RUNTIME_obmc-host-state-manager = "x86-power-control"
VIRTUAL-RUNTIME_obmc-chassis-state-manager = "x86-power-control"
VIRTUAL-RUNTIME_obmc-discover-system-state = "x86-power-control"

#KCS_DEVICE = "ipmi-kcs1"
#PREFERRED_PROVIDER_virtual/obmc-host-ipmi-hw = "phosphor-ipmi-kcs"
PREFERRED_PROVIDER_virtual/obmc-host-ipmi-hw = "phosphor-ipmi-ssif"
PREFERRED_PROVIDER_virtual/obmc-fan-mgmt = "packagegroup-buv-runbmc-apps"
PREFERRED_PROVIDER_virtual/obmc-system-mgmt = "packagegroup-buv-runbmc-apps"
PREFERRED_PROVIDER_virtual/obmc-chassis-mgmt = "packagegroup-buv-runbmc-apps"

DISTRO_FEATURES += "ext2"
MACHINE_FEATURES += "ext2"

DISTRO_FEATURES:remove = "avahi"
DISTRO_FEATURES:remove = "slp"

IMAGE_FEATURES:remove = "obmc-fan-control"
MACHINEOVERRIDES .= ":buv-runbmc"
```

## meta-evb/meta-evb-nuvoton/meta-evb-npcm750/conf/layer.conf
```bitbake
# We have a conf and classes directory, add to BBPATH
BBPATH .= ":${LAYERDIR}"

BBFILE_COLLECTIONS += "evb-npcm750"
BBFILE_PATTERN_evb-npcm750 = ""
LAYERSERIES_COMPAT_evb-npcm750 = "scarthgap styhead"
```

## meta-evb/meta-evb-nuvoton/meta-evb-npcm750/conf/machine/evb-npcm750.conf
```bitbake
KMACHINE = "nuvoton"
KERNEL_DEVICETREE = "${KMACHINE}-npcm750-evb.dtb"
UBOOT_MACHINE = "PolegRunBMC_defconfig"
UBOOT_DEVICETREE = "nuvoton-npcm750-evb"
IGPS_MACHINE = "EB"

require conf/machine/include/npcm7xx.inc
require conf/machine/include/obmc-bsp-common.inc

FLASH_SIZE = "32768"

OBMC_MACHINE_FEATURES += "\
        obmc-phosphor-fan-mgmt \
        obmc-phosphor-chassis-mgmt \
        obmc-phosphor-flash-mgmt \
        obmc-host-ipmi \
        obmc-host-state-mgmt \
        obmc-chassis-state-mgmt \
        obmc-bmc-state-mgmt \
        "

PREFERRED_PROVIDER_virtual/obmc-chassis-mgmt = "packagegroup-evb-npcm750-apps"
PREFERRED_PROVIDER_virtual/obmc-fan-mgmt = "packagegroup-evb-npcm750-apps"
PREFERRED_PROVIDER_virtual/obmc-flash-mgmt = "packagegroup-evb-npcm750-apps"
PREFERRED_PROVIDER_virtual/obmc-system-mgmt = "packagegroup-evb-npcm750-apps"
PREFERRED_PROVIDER_virtual/phosphor-led-manager-config-native = "evb-npcm750-led-manager-config-native"
PREFERRED_PROVIDER_virtual/obmc-host-ipmi-hw = "phosphor-ipmi-kcs"
```

## meta-evb/meta-evb-nuvoton/meta-evb-npcm845/conf/distro/arbel-evb-emmc-entity.conf
```bitbake
require conf/distro/openbmc-phosphor.conf
require conf/distro/include/phosphor-mmc.inc

VIRTUAL-RUNTIME_obmc-inventory-manager = "entity-manager"
VIRTUAL-RUNTIME_obmc-sensors-hwmon = "dbus-sensors"
VIRTUAL-RUNTIME_phosphor-ipmi-providers = ""
PREFERRED_PROVIDER_virtual/obmc-inventory-data = "entity-manager"

DISTRO = "arbel-evb-emmc"
DISTRO:append = "-entity"
DISTRO_NAME = "Nuvoton OpenBMC (Entity Manager)"
DISTRO_FEATURES:append  = " entity-manager"

# eMMC layout
# max uboot image size in SPI partition is 768K
MMC_UBOOT_SIZE = "640"

WKS_FILE ?= "emmc-arbel-evb.wks.in"
WKS_FILE_DEPENDS ?= " \
    virtual/bootloader \
    virtual/kernel \
"
IMAGE_BOOT_FILES ?= "fitImage-${INITRAMFS_IMAGE}-${MACHINE}-${MACHINE};fitImage"
```

## meta-evb/meta-evb-nuvoton/meta-evb-npcm845/conf/distro/arbel-evb-entity.conf
```bitbake
require conf/distro/openbmc-phosphor.conf

VIRTUAL-RUNTIME_obmc-inventory-manager = "entity-manager"
VIRTUAL-RUNTIME_obmc-sensors-hwmon = "dbus-sensors"
VIRTUAL-RUNTIME_phosphor-ipmi-providers = ""
PREFERRED_PROVIDER_virtual/obmc-inventory-data = "entity-manager"

DISTRO = "arbel-evb-entity"
DISTRO_NAME = "Nuvoton OpenBMC (Entity Manager)"
DISTRO_FEATURES:append = " entity-manager"
```

## meta-evb/meta-evb-nuvoton/meta-evb-npcm845/conf/layer.conf
```bitbake
# We have a conf and classes directory, add to BBPATH
BBPATH .= ":${LAYERDIR}"

# We have recipes-* directories, add to BBFILES
BBFILES += "${LAYERDIR}/recipes-*/*/*.bb \
            ${LAYERDIR}/recipes-*/*/*.bbappend"

BBFILE_COLLECTIONS += "evb-npcm845"
BBFILE_PATTERN_evb-npcm845 = "^${LAYERDIR}/"

LAYERSERIES_COMPAT_evb-npcm845 = "scarthgap styhead"
BBFILE_PATTERN_IGNORE_EMPTY_evb-npcm845 = "1"
```

## meta-evb/meta-evb-nuvoton/meta-scm-npcm845/conf/layer.conf
```bitbake
# We have a conf and classes directory, add to BBPATH
BBPATH .= ":${LAYERDIR}"

# We have recipes-* directories, add to BBFILES
BBFILES += "${LAYERDIR}/recipes-*/*/*.bb \
            ${LAYERDIR}/recipes-*/*/*.bbappend"

BBFILE_COLLECTIONS += "scm-npcm845"
BBFILE_PATTERN_scm-npcm845 = "^${LAYERDIR}/"
LAYERSERIES_COMPAT_scm-npcm845 = "langdale mickledore"
```

## meta-evb/meta-evb-nuvoton/meta-scm-npcm845/conf/machine/scm-npcm845.conf
```bitbake
KMACHINE = "nuvoton"
KERNEL_DEVICETREE = "nuvoton/${KMACHINE}-npcm845-scm.dtb"

UBOOT_MACHINE = "ArbelEVB_defconfig"
UBOOT_DEVICETREE = "nuvoton-npcm845-scm"

IGPS_MACHINE = "EB"
DEVICE_GEN = "A1"

require conf/machine/include/npcm8xx.inc
require conf/machine/include/obmc-bsp-common.inc

FLASH_SIZE = "65536"
FLASH_UBOOT_OFFSET:flash-65536 = "0"
FLASH_KERNEL_OFFSET:flash-65536 = "4096"
FLASH_ROFS_OFFSET:flash-65536 = "12288"
FLASH_RWFS_OFFSET:flash-65536 = "61440"

BB_ALIGN = "524288"

# Don't generate MTD flash images until we're able to include the primary
# bootloader and the Linux MTD driver is ready.
IMAGE_FSTYPES += "cpio.${INITRAMFS_CTYPE}.u-boot"
IMAGE_FSTYPES += "${@bb.utils.contains('DISTRO_FEATURES', \
        'phosphor-mmc', \
        'wic.gz mmc-ext4-tar', \
        '', d)}"

MACHINE_FEATURES += "\
        obmc-phosphor-fan-mgmt \
        obmc-phosphor-chassis-mgmt \
        obmc-phosphor-flash-mgmt \
        obmc-host-ipmi \
        obmc-host-state-mgmt \
        obmc-chassis-state-mgmt \
        obmc-bmc-state-mgmt \
        "

KCS_DEVICE = "ipmi-kcs1"

DISTRO_FEATURES:append = " ext2"
MACHINE_FEATURES:append = " ext2"

DISTRO_FEATURES:append = " tpm2"
MACHINE_FEATURES:append = " tpm2"

MACHINE_FEATURES:append = " optee-ftpm"

VIRTUAL-RUNTIME_obmc-host-state-manager ?= "x86-power-control"
VIRTUAL-RUNTIME_obmc-chassis-state-manager ?= "x86-power-control"

PREFERRED_PROVIDER_virtual/obmc-chassis-mgmt = "packagegroup-scm-npcm845-apps"
PREFERRED_PROVIDER_virtual/obmc-fan-mgmt = "packagegroup-scm-npcm845-apps"
PREFERRED_PROVIDER_virtual/obmc-flash-mgmt = "packagegroup-scm-npcm845-apps"
PREFERRED_PROVIDER_virtual/obmc-system-mgmt = "packagegroup-scm-npcm845-apps"
PREFERRED_PROVIDER_virtual/obmc-host-ipmi-hw = "phosphor-ipmi-kcs"
PREFERRED_PROVIDER_virtual/phosphor-led-manager-config-native = "scm-npcm845-led-manager-config-native"

# Remove unneeded binaries from image
IMAGE_FEATURES:remove = "obmc-fan-control"

MACHINE_EXTRA_RRECOMMENDS = "kernel-modules"
VOLATILE_LOG_DIR = "no"
```

## meta-evb/meta-evb-raspberrypi/conf/bblayers.conf.sample
```bitbake
# LAYER_CONF_VERSION is increased each time build/conf/bblayers.conf
# changes incompatibly
LCONF_VERSION = "8"

BBPATH = "${TOPDIR}"
BBFILES ?= ""

BBLAYERS ?= " \
  ##OEROOT##/meta \
  ##OEROOT##/meta-poky \
  ##OEROOT##/meta-openembedded/meta-oe \
  ##OEROOT##/meta-openembedded/meta-networking \
  ##OEROOT##/meta-openembedded/meta-python \
  ##OEROOT##/meta-openembedded/meta-webserver \
  ##OEROOT##/meta-phosphor \
  ##OEROOT##/meta-raspberrypi \
  "
BBLAYERS_NON_REMOVABLE ?= " \
  ##OEROOT##/meta \
  ##OEROOT##/meta-poky \
  ##OEROOT##/meta-openembedded/meta-oe \
  ##OEROOT##/meta-openembedded/meta-networking \
  ##OEROOT##/meta-openembedded/meta-python \
  ##OEROOT##/meta-openembedded/meta-webserver \
  ##OEROOT##/meta-phosphor \
  ##OEROOT##/meta-raspberrypi \
  "
```

## meta-facebook/conf/layer.conf
```bitbake
# We have a conf and classes directory, add to BBPATH
BBPATH .= ":${LAYERDIR}"

# We have recipes-* directories, add to BBFILES
BBFILES += "${LAYERDIR}/recipes-*/*/*.bb \
            ${LAYERDIR}/recipes-*/*/*.bbappend"

BBFILES_DYNAMIC += " \
  aspeed-layer:${LAYERDIR}/dynamic-layers/aspeed-layer/recipes-*/*/*.bb \
  aspeed-layer:${LAYERDIR}/dynamic-layers/aspeed-layer/recipes-*/*/*.bbappend \
  nuvoton-layer:${LAYERDIR}/dynamic-layers/nuvoton-layer/recipes-*/*/*.bb \
  nuvoton-layer:${LAYERDIR}/dynamic-layers/nuvoton-layer/recipes-*/*/*.bbappend \
  "

BBFILE_COLLECTIONS += "facebook-layer"
BBFILE_PATTERN_facebook-layer := "^${LAYERDIR}/"
LAYERSERIES_COMPAT_facebook-layer := "nanbield scarthgap"
```

## meta-facebook/conf/machine/include/facebook-compute-multihost.inc
```bitbake
MACHINEOVERRIDES =. "fb-compute-multihost:"

require conf/machine/include/facebook-compute.inc
```

## meta-facebook/conf/machine/include/facebook-compute-singlehost.inc
```bitbake
MACHINEOVERRIDES =. "fb-compute-singlehost:"

require conf/machine/include/facebook-compute.inc

MACHINE_FEATURES:append = " obmc-host-ipmi"
PREFERRED_PROVIDER_virtual/obmc-host-ipmi-hw ?= "phosphor-ipmi-kcs"
```

## meta-facebook/conf/machine/include/facebook-compute.inc
```bitbake
MACHINEOVERRIDES =. "fb-compute:"

require conf/machine/include/facebook-withhost.inc
```

## meta-facebook/conf/machine/include/facebook-fanless.inc
```bitbake
MACHINE_FEATURES:append = " fb-fanless"
MACHINEOVERRIDES:append = ":mf-fb-fanless"
```

## meta-facebook/conf/machine/include/facebook-fboss.inc
```bitbake
MACHINEOVERRIDES =. "fb-fboss:"

require conf/machine/include/facebook.inc

# Darwin uses ttyS0 at 9600 baudrate
SERIAL_CONSOLES:facebook = "9600;ttyS0"
```

## meta-facebook/conf/machine/include/facebook-fixed-nic.inc
```bitbake
MACHINE_FEATURES:append = " fb-fixed-nic"
MACHINEOVERRIDES:append = ":mf-fb-fixed-nic"

FB_ETH_INTF ?= "eth0"
```
