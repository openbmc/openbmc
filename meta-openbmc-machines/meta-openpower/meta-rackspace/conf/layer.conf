## meta-openbmc-machines/meta-openpower/meta-rackspace/conf/layer.conf
```bitbake
# We have a conf and classes directory, add to BBPATH
BBPATH .= ":${LAYERDIR}"

BBFILE_COLLECTIONS += "rackspace"
BBFILE_PATTERN_rackspace = ""
```

## meta-openbmc-machines/meta-openpower/meta-rackspace/meta-barreleye/conf/machine/barreleye.conf
```bitbake
KMACHINE = "aspeed"
KERNEL_DEVICETREE = "${KMACHINE}-bmc-opp-${MACHINE}.dtb"

require conf/machine/include/ast2400.inc
require conf/machine/include/obmc-bsp-common.inc
require conf/machine/include/rackspace.inc

UBOOT_MACHINE_barreleye = "ast_g4_ncsi_config"
UBOOT_ENTRYPOINT = "0x40008000"
UBOOT_LOADADDRESS = "0x40008000"

FLASH_SIZE = "32768"

OBMC_FAN_INSTANCES = "0 1 2 3 4 5"

PREFERRED_PROVIDER_virtual/phosphor-ipmi-fru-inventory = "barreleye-ipmi-inventory-map-native"
PREFERRED_PROVIDER_virtual/phosphor-led-manager-config-native = "barreleye-led-manager-config-native"
```

## meta-openbmc-machines/meta-x86/meta-intel/meta-s2600wf/conf/machine/s2600wf.conf
```bitbake
KMACHINE = "aspeed"
KERNEL_DEVICETREE = "${KMACHINE}-bmc-intel-s2600wf.dtb"

require conf/machine/include/ast2500.inc
require conf/machine/include/obmc-bsp-common.inc
require conf/machine/include/intel.inc

UBOOT_MACHINE = "ast_g5_phy_config"

FLASH_SIZE = "32768"

VIRTUAL-RUNTIME_skeleton_workbook = "${MACHINE}-config"
```

## meta-openbmc-machines/meta-x86/meta-mellanox/conf/distro/openbmc-mellanox.conf
```bitbake
require conf/distro/poky.conf
require conf/distro/include/mellanox-defaults.inc

DISTRO = "openbmc-mellanox"
DISTRO_NAME = "Mellanox BMC (OpenBMC Project Reference Distro)"
DISTRO_VERSION = "6.0.0000"
TARGET_VENDOR="-openbmc"

IMAGE_FSTYPES += "cpio.gz"
IMAGE_FSTYPES += "squashfs-xz"
IMAGE_LINGUAS = "en-us"

VIRTUAL-RUNTIME_keymaps = ""

# Phosphor OpenBMC uses systemd and udev
DISTRO_FEATURES_append = " systemd pam"
VIRTUAL-RUNTIME_init_manager = "systemd"
DISTRO_FEATURES_BACKFILL_CONSIDERED = "sysvinit"
VIRTUAL-RUNTIME_initscripts = ""

DISTRO_FEATURES = "\
        ipv6 \
        obmc-mellanox-fan-mgmt \
        obmc-mellanox-chassis-mgmt \
        obmc-mellanox-sensor-mgmt \
        obmc-mellanox-flash-mgmt \
        obmc-mellanox-event-mgmt \
        obmc-mellanox-user-mgmt \
        obmc-settings-mgmt \
        obmc-mellanox-system-mgmt \
        obmc-host-ipmi \
        obmc-mrw \
        avahi \
        ${DISTRO_FEATURES_LIBC} \
        "

MACHINE_FEATURES += " \
        ${OBMC_MACHINE_FEATURES} \
        "

DISTRO_EXTRA_RDEPENDS_remove_qemuarm = "packagegroup-core-device-devel"

# TODO: openbmc/openbmc#12345 - Upgrade to pygobject-3.
PREFERRED_VERSION_python-pygobject = "2.%"

INHERIT_append = " obmc-phosphor-utils"

include conf/distro/include/openbmc-phosphor/${MACHINE}.inc
```

## meta-openbmc-machines/meta-x86/meta-mellanox/conf/layer.conf
```bitbake
# We have a conf and classes directory, add to BBPATH
BBPATH .= ":${LAYERDIR}"

# We have recipes-* directories, add to BBFILES
BBFILES += "${LAYERDIR}/common/recipes-*/*/*.bb \
            ${LAYERDIR}/common/recipes-*/*/*.bbappend"

BBFILE_COLLECTIONS += "obmc-mellanox"
BBFILE_PATTERN_obmc-mellanox = "^${LAYERDIR}/"
BBFILE_PRIORITY_obmc-mellanox = "8"
LAYERVERSION_obmc-mellanox = "1"

PREFERRED_VERSION_linux-obmc = "4.7%"

# Provide a variable that points the base of the mellanox layer.
MELLANOXBASE = '${@os.path.normpath("${LAYERDIR}/")}'
```

## meta-openbmc-machines/meta-x86/meta-mellanox/meta-msn/conf/bblayers.conf.sample
```bitbake
# LAYER_CONF_VERSION is increased each time build/conf/bblayers.conf
# changes incompatibly
LCONF_VERSION = "6"

BBPATH = "${TOPDIR}"
BBFILES ?= ""

BBLAYERS ?= " \
  ##OEROOT##/meta \
  ##OEROOT##/meta-poky \
  ##OEROOT##/import-layers/meta-openembedded/meta-oe \
  ##OEROOT##/import-layers/meta-openembedded/meta-networking \
  ##OEROOT##/import-layers/meta-openembedded/meta-perl \
  ##OEROOT##/import-layers/meta-openembedded/meta-python \
  ##OEROOT##/import-layers/meta-virtualization \
  ##OEROOT##/meta-phosphor \
  ##OEROOT##/meta-openbmc-bsp/meta-aspeed \
  ##OEROOT##/meta-openbmc-bsp/meta-aspeed/meta-ast2500 \
  ##OEROOT##/meta-openbmc-machines/meta-x86 \
  ##OEROOT##/meta-openbmc-machines/meta-x86/meta-mellanox \
  ##OEROOT##/meta-openbmc-machines/meta-x86/meta-mellanox/meta-msn \
  "
BBLAYERS_NON_REMOVABLE ?= " \
  ##OEROOT##/meta \
  ##OEROOT##/meta-poky \
  ##OEROOT##/import-layers/meta-openembedded/meta-oe \
  ##OEROOT##/import-layers/meta-openembedded/meta-networking \
  ##OEROOT##/import-layers/meta-openembedded/meta-perl \
  ##OEROOT##/import-layers/meta-openembedded/meta-python \
  ##OEROOT##/import-layers/meta-virtualization \
  ##OEROOT##/meta-phosphor \
  ##OEROOT##/meta-openbmc-bsp/meta-aspeed \
  ##OEROOT##/meta-openbmc-bsp/meta-aspeed/meta-ast2500 \
  ##OEROOT##/meta-openbmc-machines/meta-x86 \
  ##OEROOT##/meta-openbmc-machines/meta-x86/meta-mellanox \
  ##OEROOT##/meta-openbmc-machines/meta-x86/meta-mellanox/meta-msn \
  "
```

## meta-openbmc-machines/meta-x86/meta-mellanox/meta-msn/conf/layer.conf
```bitbake
# We have a conf and classes directory, add to BBPATH
BBPATH .= ":${LAYERDIR}"

BBFILE_COLLECTIONS += "msn"
BBFILE_PATTERN_msn = ""
```

## meta-openbmc-machines/meta-x86/meta-mellanox/meta-msn/conf/machine/msn.conf
```bitbake
KMACHINE = "aspeed"
KERNEL_DEVICETREE = "${KMACHINE}-bmc-mellanox-${MACHINE}.dtb"

UBOOT_MACHINE = "ast_g5_ncsi_config"

FLASH_SIZE = "32768"

require conf/machine/include/ast2500.inc
require conf/machine/include/obmc-bsp-common.inc
```

## meta-openbmc-machines/meta-x86/meta-mellanox/meta-msn/conf/machine/msn2420-ast2520.conf
```bitbake
KMACHINE = "aspeed"
KERNEL_DEVICETREE = "mlx-ast2500-bmc.dtb"
KERNEL_IMAGETYPE = "uImage"

UBOOT_MACHINE = "mlnxast2500bmc_config"

require include/ast2500.inc
require conf/machine/include/mlx-obmc-bsp-common.inc
```

## meta-openbmc-machines/meta-x86/meta-portwell/meta-neptune/conf/bblayers.conf.sample
```bitbake
# LAYER_CONF_VERSION is increased each time build/conf/bblayers.conf
# changes incompatibly
LCONF_VERSION = "7"

BBPATH = "${TOPDIR}"
BBFILES ?= ""

BBLAYERS ?= " \
  ##OEROOT##/meta \
  ##OEROOT##/meta-poky \
  ##OEROOT##/import-layers/meta-openembedded/meta-oe \
  ##OEROOT##/import-layers/meta-openembedded/meta-networking \
  ##OEROOT##/import-layers/meta-openembedded/meta-perl \
  ##OEROOT##/import-layers/meta-openembedded/meta-python \
  ##OEROOT##/import-layers/meta-openembedded/meta-webserver \
  ##OEROOT##/import-layers/meta-virtualization \
  ##OEROOT##/meta-phosphor \
  ##OEROOT##/meta-openbmc-bsp/meta-aspeed \
  ##OEROOT##/meta-openbmc-machines/meta-x86/meta-portwell/meta-neptune \
  "
```

## meta-openbmc-machines/meta-x86/meta-quanta/meta-q71l/conf/machine/quanta-q71l.conf
```bitbake
KMACHINE = "aspeed"
KERNEL_DEVICETREE = "${KMACHINE}-bmc-${MACHINE}.dtb"

require conf/machine/include/ast2400.inc
require conf/machine/include/obmc-bsp-common.inc

UBOOT_MACHINE_palmetto = "ast_g4_ncsi_config"
UBOOT_ENTRYPOINT = "0x40008000"
UBOOT_LOADADDRESS = "0x40008000"

FLASH_SIZE = "32768"

# If we included the openpower.inc we'd get these from that.
#OBMC_MACHINE_FEATURES += "\
#        obmc-phosphor-fan-mgmt \
#        obmc-phosphor-chassis-mgmt \
#        obmc-phosphor-flash-mgmt \
#        obmc-host-ipmi \
#        obmc-host-ctl \
#        obmc-host-state-mgmt \
#        obmc-chassis-state-mgmt \
#        obmc-bmc-state-mgmt \
#        "
# But we don't, and it's ok :D  We're pulling in specific packages in an image recipe.

# This sets up our own Quanta-q71l.py inclusion based on the Zaius.py in the skeleton repo.
# As something temporarily required.
VIRTUAL-RUNTIME_skeleton_workbook = "${MACHINE}-config"
PREFERRED_PROVIDER_virtual/obmc-inventory-data ?= "${VIRTUAL-RUNTIME_skeleton_workbook}"

# These are meant to include the inventory config.yaml and so on.
PREFERRED_PROVIDER_virtual/phosphor-ipmi-fru-inventory = "q71l-ipmi-inventory-map-native"
PREFERRED_PROVIDER_virtual/phosphor-ipmi-fru-properties = "q71l-ipmi-fru-properties"

PREFERRED_PROVIDER_virtual/phosphor-ipmi-sensor-inventory = "q71l-ipmi-sensor-map-native"

PREFERRED_PROVIDER_virtual/obmc-host-ipmi-hw = "phosphor-ipmi-bt"
```

## meta-openembedded/meta-filesystems/conf/layer.conf
```bitbake
# We have a conf and classes directory, add to BBPATH
BBPATH .= ":${LAYERDIR}"

# We have recipes-* directories, add to BBFILES
BBFILES += "${LAYERDIR}/recipes-*/*/*.bb \
	${LAYERDIR}/recipes-*/*/*.bbappend"

BBFILE_COLLECTIONS += "filesystems-layer"
BBFILE_PATTERN_filesystems-layer = "^${LAYERDIR}/"
BBFILE_PRIORITY_filesystems-layer = "5"

# This should only be incremented on significant changes that will
# cause compatibility issues with other layers
LAYERVERSION_filesystems-layer = "1"

LAYERDEPENDS_filesystems-layer = "core openembedded-layer networking-layer"

LAYERSERIES_COMPAT_filesystems-layer = "scarthgap"
```

## meta-openembedded/meta-gnome/conf/layer.conf
```bitbake
# We have a conf and classes directory, append to BBPATH
BBPATH .= ":${LAYERDIR}"

# We have a recipes directory, add to BBFILES
BBFILES += "${LAYERDIR}/recipes-*/*/*.bb ${LAYERDIR}/recipes-*/*/*.bbappend"

BBFILE_COLLECTIONS += "gnome-layer"
BBFILE_PATTERN_gnome-layer := "^${LAYERDIR}/"
BBFILE_PRIORITY_gnome-layer = "5"

# auto-pack gnome help files
IMAGE_LINGUAS_COMPLEMENTARY:append = " ${@bb.utils.contains('DISTRO_FEATURES','helpfiles','*-help-%s','',d)}"

# This should only be incremented on significant changes that will
# cause compatibility issues with other layers
LAYERVERSION_gnome-layer = "1"

LAYERDEPENDS_gnome-layer = "core openembedded-layer networking-layer meta-python"

LAYERSERIES_COMPAT_gnome-layer = "styhead walnascar"

SIGGEN_EXCLUDE_SAFE_RECIPE_DEPS += "\
  faenza-icon-theme->gdk-pixbuf \
  faenza-icon-theme->gtk+3 \
"

BBFILES_DYNAMIC += " \
    virtualization-layer:${LAYERDIR}/dynamic-layers/meta-virtualization/*/*/*.bb \
    virtualization-layer:${LAYERDIR}/dynamic-layers/meta-virtualization/*/*/*.bbappend \
    security:${LAYERDIR}/dynamic-layers/meta-security/*/*/*.bb \
"
```

## meta-openembedded/meta-initramfs/conf/layer.conf
```bitbake
# Layer configuration for meta-initramfs layer

# We have a conf and classes directory, append to BBPATH
BBPATH .= ":${LAYERDIR}"

# We have a recipes directory, add to BBFILES
BBFILES += "${LAYERDIR}/recipes-*/*/*.bb ${LAYERDIR}/recipes-*/*/*.bbappend"

BBFILE_COLLECTIONS += "meta-initramfs"
BBFILE_PATTERN_meta-initramfs := "^${LAYERDIR}/"

# Define the priority for recipes (.bb files) from this layer,
# choosing carefully how this layer interacts with all of the
# other layers.

BBFILE_PRIORITY_meta-initramfs = "8"
LAYERDEPENDS_meta-initramfs = "core"

LAYERSERIES_COMPAT_meta-initramfs = "thud warrior zeus dunfell"

SIGGEN_EXCLUDE_SAFE_RECIPE_DEPS += " \
  dracut->virtual/kernel \
"
```

## meta-openembedded/meta-multimedia/conf/layer.conf
```bitbake
# It really depends on order of the layers appearing in BBLAYERS
# variable in toplevel bblayers.conf file, where bitbake will search
# for .inc files and others where bitbake uses BBPATH since it will
# search the directories from first to last as specified in BBPATH
# Therefore if you want a given layer to be considered high priority
# for the .inc and .conf etc. then consider it adding at the beginning
# of BBPATH. For bblayers bitbake will use BBFILES_PRIORITY to resolve
# the recipe contention so the order of directories in BBFILES does 
# not matter.

# We have a conf and classes directory, append to BBPATH
BBPATH .= ":${LAYERDIR}"

# We have a recipes directory, add to BBFILES
BBFILES += "${LAYERDIR}/recipes-*/*/*.bb ${LAYERDIR}/recipes-*/*/*.bbappend"

BBFILE_COLLECTIONS += "multimedia-layer"
BBFILE_PATTERN_multimedia-layer := "^${LAYERDIR}/"

LICENSE_PATH += "${LAYERDIR}/licenses"

# Define the priority for recipes (.bb files) from this layer,
# choosing carefully how this layer interacts with all of the
# other layers.

BBFILE_PRIORITY_multimedia-layer = "6"

# This should only be incremented on significant changes that will
# cause compatibility issues with other layers
LAYERVERSION_multimedia-layer = "1"

LAYERDEPENDS_multimedia-layer = "core meta-python"

LAYERSERIES_COMPAT_multimedia-layer = "gatesgarth hardknott"
```

## meta-openembedded/meta-networking/conf/layer.conf
```bitbake
# We have a conf and classes directory, add to BBPATH
BBPATH .= ":${LAYERDIR}"

# We have a packages directory, add to BBFILES
BBFILES += "${LAYERDIR}/recipes-*/*/*.bb \
            ${LAYERDIR}/recipes-*/*/*.bbappend"

BBFILE_COLLECTIONS += "networking-layer"
BBFILE_PATTERN_networking-layer := "^${LAYERDIR}/"
BBFILE_PRIORITY_networking-layer = "5"

# This should only be incremented on significant changes that will
# cause compatibility issues with other layers
LAYERVERSION_networking-layer = "1"

LAYERDEPENDS_networking-layer = "core meta-python openembedded-layer"

LAYERSERIES_COMPAT_networking-layer = "styhead"

LICENSE_PATH += "${LAYERDIR}/licenses"

SIGGEN_EXCLUDE_SAFE_RECIPE_DEPS += " \
  wireguard-tools->wireguard-module \
  mdio-tools->mdio-netlink \
  ot-br-posix->ipset \
"
BBFILES_DYNAMIC += " \
    meta-python:${LAYERDIR}/dynamic-layers/meta-python/recipes-*/*/*.bb \
"
```
