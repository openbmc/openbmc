## meta-openembedded/meta-oe/conf/layer.conf
```bitbake
# It really depends on order of the layers appearing in BBLAYERS
# variable in toplevel bblayers.conf file, where bitbake will search
# for .inc files and others where bitbake uses BBPATH since it will
# search the directories from first to last as specified in BBPATH
# Therefore if you want a given layer to be considered high priority
# for the .inc and .conf etc. then consider it adding at the beginning
# of BBPATH. For bblayers bitbake will use BBFILES_PRIORITY to resolve
# the recipe contention so the order of directories in BBFILES does
# not matter.

# We have a conf and classes directory, append to BBPATH
BBPATH .= ":${LAYERDIR}"

# We have a recipes directory, add to BBFILES
BBFILES += "${LAYERDIR}/recipes-*/*/*.bb ${LAYERDIR}/recipes-*/*/*.bbappend"

BBFILE_COLLECTIONS += "openembedded-layer"
BBFILE_PATTERN_openembedded-layer := "^${LAYERDIR}/"

# Define the priority for recipes (.bb files) from this layer,
# choosing carefully how this layer interacts with all of the
# other layers.

BBFILE_PRIORITY_openembedded-layer = "5"

# only activates content when identified layers are present,
# to ensure yocto compatibility check pass
BBFILES_DYNAMIC += " \
    meta-clang:${LAYERDIR}/dynamic-layers/clang-layer/recipes-*/*/*.bb \
    meta-clang:${LAYERDIR}/dynamic-layers/clang-layer/recipes-*/*/*.bbappend \
    meta-python:${LAYERDIR}/dynamic-layers/meta-python/recipes-*/*/*.bb \
    meta-python:${LAYERDIR}/dynamic-layers/meta-python/recipes-*/*/*.bbappend \
    multimedia-layer:${LAYERDIR}/dynamic-layers/multimedia-layer/recipes-*/*/*.bb \
    multimedia-layer:${LAYERDIR}/dynamic-layers/multimedia-layer/recipes-*/*/*.bbappend \
    networking-layer:${LAYERDIR}/dynamic-layers/networking-layer/recipes-*/*/*.bb \
    networking-layer:${LAYERDIR}/dynamic-layers/networking-layer/recipes-*/*/*.bbappend \
    gnome-layer:${LAYERDIR}/dynamic-layers/gnome-layer/recipes-*/*/*.bb \
    gnome-layer:${LAYERDIR}/dynamic-layers/gnome-layer/recipes-*/*/*.bbappend \
    perl-layer:${LAYERDIR}/dynamic-layers/perl-layer/recipes-*/*/*.bb \
    perl-layer:${LAYERDIR}/dynamic-layers/perl-layer/recipes-*/*/*.bbappend \
    selinux:${LAYERDIR}/dynamic-layers/selinux/recipes-*/*/*.bb \
    selinux:${LAYERDIR}/dynamic-layers/selinux/recipes-*/*/*.bbappend \
"

# This should only be incremented on significant changes that will
# cause compatibility issues with other layers
LAYERVERSION_openembedded-layer = "1"

LAYERDEPENDS_openembedded-layer = "core"

LAYERSERIES_COMPAT_openembedded-layer = "styhead walnascar"

LICENSE_PATH += "${LAYERDIR}/licenses"

PREFERRED_RPROVIDER_libdevmapper = "lvm2"
PREFERRED_RPROVIDER_libdevmapper-native = "lvm2-native"
PREFERRED_RPROVIDER_nativesdk-libdevmapper = "nativesdk-lvm2"
PREFERRED_PROVIDER_android-tools-conf ?= "android-tools-conf"
# Configures whether coreutils or uutils-coreutils is used.
PREFERRED_PROVIDER_coreutils = "coreutils"
PREFERRED_PROVIDER_virtual/opencl-icd ?= "opencl-icd-loader"
PREFERRED_RPROVIDER_virtual-opencl-icd ?= "opencl-icd-loader"

SIGGEN_EXCLUDERECIPES_ABISAFE += " \
  fbset-modes \
  gpsd-machine-conf \
  distro-feed-configs \
  ca-certificates \
  pointercal \
"

SIGGEN_EXCLUDE_SAFE_RECIPE_DEPS += " \
  android-tools->android-tools-conf \
  usb-modeswitch-data->usb-modeswitch \
  lmsensors->lmsensors-config \
  phoronix-test-suite->bash \
  phoronix-test-suite->python3 \
  phoronix-test-suite->php \
  phoronix-test-suite->lsb-release \
  phoronix-test-suite->util-linux \
  phoronix-test-suite->busybox \
  phoronix-test-suite->shared-mime-info \
  phoronix-test-suite->desktop-file-utils \
"

# ttf.inc inherits fontcache which adds fontconfig-utils to RDEPENDS
SIGGEN_EXCLUDE_SAFE_RECIPE_DEPS += " \
  terminus-font->fontconfig \
  ttf-abyssinica->fontconfig \
  ttf-arphic-uming->fontconfig \
  ttf-dejavu->fontconfig \
  ttf-droid->fontconfig \
  ttf-gentium->fontconfig \
  ttf-google-fira->fontconfig \
  ttf-hunkyfonts->fontconfig \
  ttf-inconsolata->fontconfig \
  ttf-ipa->fontconfig \
  ttf-liberation->fontconfig \
  ttf-liberation-sans-narrow->fontconfig \
  ttf-lklug->fontconfig \
  ttf-lohit->fontconfig \
  ttf-noto-emoji->fontconfig \
  ttf-pt-sans->fontconfig \
  ttf-roboto->fontconfig \
  ttf-mplus->fontconfig \
  ttf-sazanami->fontconfig \
  ttf-takao->fontconfig \
  ttf-tlwg->fontconfig \
  ttf-ubuntu-font-family->fontconfig \
  ttf-vlgothic->fontconfig \
  ttf-wqy-zenhei->fontconfig \
  source-han-sans-cn-fonts->fontconfig \
  source-han-sans-jp-fonts->fontconfig \
  source-han-sans-kr-fonts->fontconfig \
  source-han-sans-tw-fonts->fontconfig \
  source-code-pro-fonts->fontconfig \
"

DEFAULT_TEST_SUITES:pn-meta-oe-ptest-image = " ${PTESTTESTSUITE}"

NON_MULTILIB_RECIPES:append = " crash pahole libbpf"

NON_MULTILIB_RECIPES:remove:x86 = "libbpf"
NON_MULTILIB_RECIPES:remove:x86-64 = "libbpf"
```

## meta-openembedded/meta-perl/conf/layer.conf
```bitbake
# We have a conf and classes directory, add to BBPATH
BBPATH .= ":${LAYERDIR}"

# We have recipes-* directories, add to BBFILES
BBFILES += "${LAYERDIR}/recipes-*/*/*.bb \
	${LAYERDIR}/recipes-*/*/*.bbappend"

BBFILE_COLLECTIONS += "perl-layer"
BBFILE_PATTERN_perl-layer := "^${LAYERDIR}/"
BBFILE_PRIORITY_perl-layer = "5"

# This should only be incremented on significant changes that will
# cause compatibility issues with other layers
LAYERVERSION_perl-layer = "1"

LAYERDEPENDS_perl-layer = "core openembedded-layer"

LAYERSERIES_COMPAT_perl-layer = "nanbield"
```

## meta-openembedded/meta-python/conf/layer.conf
```bitbake
# We might have a conf and classes directory, append to BBPATH
BBPATH .= ":${LAYERDIR}"

# We have recipes directories, add to BBFILES
BBFILES += "${LAYERDIR}/recipes*/*/*.bb ${LAYERDIR}/recipes*/*/*.bbappend"

BBFILE_COLLECTIONS += "meta-python"
BBFILE_PATTERN_meta-python := "^${LAYERDIR}/"
BBFILE_PRIORITY_meta-python = "5"

# This should only be incremented on significant changes that will
# cause compatibility issues with other layers
LAYERVERSION_meta-python = "1"

LAYERDEPENDS_meta-python = "core (>= 12) openembedded-layer"

LAYERSERIES_COMPAT_meta-python = "styhead"

LICENSE_PATH += "${LAYERDIR}/licenses"
```

## meta-openembedded/meta-webserver/conf/layer.conf
```bitbake
# Layer configuration for meta-webserver layer
# Copyright 2012 Intel Corporation

# We have a conf and classes directory, add to BBPATH
BBPATH .= ":${LAYERDIR}"

# We have various recipe-* directories, add to BBFILES
BBFILES += "${LAYERDIR}/recipes-*/*/*.bb ${LAYERDIR}/recipes-*/*/*.bbappend"

BBFILE_COLLECTIONS += "webserver"
BBFILE_PATTERN_webserver := "^${LAYERDIR}/"
BBFILE_PRIORITY_webserver = "5"

# This should only be incremented on significant changes that will
# cause compatibility issues with other layers
LAYERVERSION_webserver = "1"

LAYERDEPENDS_webserver = "core openembedded-layer"

LAYERSERIES_COMPAT_webserver = "styhead"

LICENSE_PATH += "${LAYERDIR}/licenses"

SIGGEN_EXCLUDE_SAFE_RECIPE_DEPS += " \
  phpmyadmin->bash \
  phpmyadmin->php \
"
```

## meta-openembedded/meta-xfce/conf/layer.conf
```bitbake
# We have a conf and classes directory, append to BBPATH
BBPATH .= ":${LAYERDIR}"

# We have a recipes directory, add to BBFILES
BBFILES += "${LAYERDIR}/recipes-*/*/*.bb ${LAYERDIR}/recipes-*/*/*.bbappend"

BBFILE_COLLECTIONS += "xfce-layer"
BBFILE_PATTERN_xfce-layer := "^${LAYERDIR}/"
BBFILE_PRIORITY_xfce-layer = "5"

# This should only be incremented on significant changes that will
# cause compatibility issues with other layers
LAYERVERSION_xfce-layer = "1"

LAYERDEPENDS_xfce-layer = "core"
LAYERDEPENDS_xfce-layer += "openembedded-layer"
LAYERDEPENDS_xfce-layer += "gnome-layer"
LAYERDEPENDS_xfce-layer += "multimedia-layer"
LAYERDEPENDS_xfce-layer += "meta-python"
LAYERDEPENDS_xfce-layer += "networking-layer"

LAYERSERIES_COMPAT_xfce-layer = "scarthgap"

SIGGEN_EXCLUDE_SAFE_RECIPE_DEPS += "\
  openzone->gdk-pixbuf \
  openzone->gtk+3 \
  rodent-icon-theme->gdk-pixbuf \
  rodent-icon-theme->gtk+3 \
"
```

## meta-openpower/conf/distro/include/openpower-distrovars.inc
```bitbake
DISTRO_FEATURES += "openpower"
DISTRO_FEATURES_FILTER_NATIVE += "openpower"
DISTRO_FEATURES_FILTER_NATIVESDK += "openpower"
DISTROOVERRIDES .= ":df-openpower"

OBMC_ORG_YAML_SUBDIRS += " org/open_power"
```

## meta-openpower/conf/distro/include/openpower-hostfw-over-pldm.inc
```bitbake
DISTRO_FEATURES += "openpower-hostfw-over-pldm"
DISTROOVERRIDES .= ":df-openpower-hostfw-over-pldm"
require conf/distro/include/pldm.inc
```

## meta-openpower/conf/distro/include/openpower-mrw.inc
```bitbake
require conf/distro/include/phosphor-mrw.inc

PREFERRED_PROVIDER_virtual/openpower-fru-inventory:df-mrw ?= "openpower-fru-inventory-mrw-native"
PREFERRED_PROVIDER_virtual/openpower-fru-properties:df-mrw ?= "openpower-fru-properties-mrw-native"
PREFERRED_PROVIDER_virtual/openpower-occ-control-config-native:df-mrw ?= "openpower-occ-control-config-mrw-native"
```
