## meta-openbmc-machines/meta-evb/meta-evb-aspeed/meta-evb-ast2500/conf/machine/evb-ast2500.conf
```bitbake
KMACHINE = "aspeed"
KERNEL_DEVICETREE = "${KMACHINE}-ast2500-evb.dtb"

UBOOT_MACHINE = "ast_g5_phy_config"

FLASH_SIZE = "32768"

require conf/machine/include/ast2500.inc
require conf/machine/include/obmc-bsp-common.inc
```

## meta-openbmc-machines/meta-evb/meta-evb-nuvoton/meta-evb-npcm750/conf/bblayers.conf.sample
```bitbake
# LAYER_CONF_VERSION is increased each time build/conf/bblayers.conf
# changes incompatibly
LCONF_VERSION = "6"

BBPATH = "${TOPDIR}"
BBFILES ?= ""

BBLAYERS ?= " \
  ##OEROOT##/meta \
  ##OEROOT##/meta-poky \
  ##OEROOT##/import-layers/meta-openembedded/meta-oe \
  ##OEROOT##/import-layers/meta-openembedded/meta-networking \
  ##OEROOT##/import-layers/meta-openembedded/meta-python \
  ##OEROOT##/import-layers/meta-virtualization \
  ##OEROOT##/meta-phosphor \
  ##OEROOT##/meta-openbmc-bsp/meta-nuvoton \
  ##OEROOT##/meta-openbmc-bsp/meta-nuvoton/meta-npcm7xx \
  ##OEROOT##/meta-openbmc-machines/meta-evb \
  ##OEROOT##/meta-openbmc-machines/meta-evb/meta-evb-nuvoton \
  ##OEROOT##/meta-openbmc-machines/meta-evb/meta-evb-nuvoton/meta-evb-npcm750 \
  "
BBLAYERS_NON_REMOVABLE ?= " \
  ##OEROOT##/meta \
  ##OEROOT##/meta-poky \
  ##OEROOT##/import-layers/meta-openembedded/meta-oe \
  ##OEROOT##/import-layers/meta-openembedded/meta-networking \
  ##OEROOT##/import-layers/meta-openembedded/meta-python \
  ##OEROOT##/import-layers/meta-virtualization \
  ##OEROOT##/meta-phosphor \
  ##OEROOT##/meta-openbmc-bsp/meta-nuvoton \
  ##OEROOT##/meta-openbmc-bsp/meta-nuvoton/meta-npcm7xx \
  ##OEROOT##/meta-openbmc-machines/meta-evb \
  ##OEROOT##/meta-openbmc-machines/meta-evb/meta-evb-nuvoton \
  ##OEROOT##/meta-openbmc-machines/meta-evb/meta-evb-nuvoton/meta-evb-npcm750 \
  "
```

## meta-openbmc-machines/meta-openpower/conf/distro/include/openpower-distrovars.inc
```bitbake
DISTRO_FEATURES += "openpower"
DISTRO_FEATURES_FILTER_NATIVE += "openpower"
DISTRO_FEATURES_FILTER_NATIVESDK += "openpower"
DISTROOVERRIDES .= ":df-openpower"
```

## meta-openbmc-machines/meta-openpower/conf/distro/include/openpower-mrw.inc
```bitbake
require conf/distro/include/phosphor-mrw.inc

PREFERRED_PROVIDER_virtual/openpower-fru-inventory_df-mrw ?= "openpower-fru-inventory-mrw-native"
PREFERRED_PROVIDER_virtual/openpower-fru-properties_df-mrw ?= "openpower-fru-properties-mrw-native"
PREFERRED_PROVIDER_virtual/openpower-occ-control-config-native_df-mrw ?= "openpower-occ-control-config-mrw-native"
```

## meta-openbmc-machines/meta-openpower/conf/layer.conf
```bitbake
# We have a conf and classes directory, add to BBPATH
BBPATH .= ":${LAYERDIR}"

BBFILES += "${LAYERDIR}/common/recipes-*/*/*.bb \
            ${LAYERDIR}/common/recipes-*/*/*.bbappend"

BBFILE_COLLECTIONS += "openpower"
BBFILE_PATTERN_openpower = ""
```

## meta-openbmc-machines/meta-openpower/conf/machine/include/openpower.inc
```bitbake
OBMC_MACHINE_FEATURES += "\
        obmc-phosphor-fan-mgmt \
        obmc-phosphor-chassis-mgmt \
        obmc-phosphor-flash-mgmt \
        obmc-host-ipmi \
        obmc-host-ctl \
        obmc-host-state-mgmt \
        obmc-chassis-state-mgmt \
        obmc-bmc-state-mgmt \
        "

VIRTUAL-RUNTIME_skeleton_workbook = "${MACHINE}-config"

PREFERRED_PROVIDER_virtual/obmc-host-ipmi-hw = "phosphor-ipmi-bt"
PREFERRED_PROVIDER_virtual/obmc-chassis-mgmt = "packagegroup-op-apps"
PREFERRED_PROVIDER_virtual/obmc-fan-mgmt = "packagegroup-op-apps"
PREFERRED_PROVIDER_virtual/obmc-flash-mgmt = "packagegroup-op-apps"
PREFERRED_PROVIDER_virtual/obmc-system-mgmt = "packagegroup-op-apps"
PREFERRED_PROVIDER_virtual/obmc-host-ctl ?= "obmc-op-control-host"
PREFERRED_PROVIDER_virtual/obmc-inventory-data ?= "${VIRTUAL-RUNTIME_skeleton_workbook}"
PREFERRED_PROVIDER_virtual/phosphor-ipmi-fru-hostfw-config ?= "hostboot-inventory-config-native"
PREFERRED_PROVIDER_virtual/openpower-fru-vpd-layout ?= "openpower-fru-vpd-layout-native"
PREFERRED_PROVIDER_virtual/openpower-fru-inventory ?= \
    "${@cf_enabled(d, 'obmc-mrw', 'openpower-fru-inventory-mrw-native', 'openpower-fru-inventory-example-native')}"
PREFERRED_PROVIDER_virtual/openpower-fru-properties ?= \
    "${@cf_enabled(d, 'obmc-mrw', 'openpower-fru-properties-mrw-native', 'openpower-fru-properties-example-native')}"

# The openpower-occ-control application is data-driven and requires an input
# yaml of OCC instance numbers to sensor IDs.
# This virtual is a native recipe that provides that mapping by installing
# configuration files in the format and native sysroot location expected by
# the openpower-occ-control build process in the native sysroot.
PREFERRED_PROVIDER_virtual/openpower-occ-control-config-native ?= \
    "${@cf_enabled(d, 'obmc-mrw', 'openpower-occ-control-config-mrw-native', 'openpower-occ-control-config-example-native')}"
```

## meta-openbmc-machines/meta-openpower/conf/machine/include/p9.inc
```bitbake
OBMC_MACHINE_FEATURES += 'p9-vcs-workaround op-fsi p9-cfam-override'
PREFERRED_PROVIDER_virtual/obmc-host-ctl = "p9-host-start"
```

## meta-openbmc-machines/meta-openpower/meta-foxconn/conf/layer.conf
```bitbake
# We have a conf and classes directory, add to BBPATH
BBPATH .= ":${LAYERDIR}"

BBFILE_COLLECTIONS += "foxconn"
BBFILE_PATTERN_foxconn = ""
```

## meta-openbmc-machines/meta-openpower/meta-ibm/conf/machine/include/ibm.inc
```bitbake
require conf/machine/include/openpower.inc

DISTRO_FEATURES_append = " obmc-ubi-filesystem"
```

## meta-openbmc-machines/meta-openpower/meta-ibm/meta-firestone/conf/machine/firestone.conf
```bitbake
KMACHINE = "aspeed"
KERNEL_DEVICETREE = "${KMACHINE}-bmc-opp-${MACHINE}.dtb"

require conf/machine/include/ast2400.inc
require conf/machine/include/obmc-bsp-common.inc
require conf/machine/include/ibm.inc
require conf/machine/include/p8.inc

UBOOT_MACHINE_firestone = "ast_g4_phy_config"
UBOOT_ENTRYPOINT = "0x40008000"
UBOOT_LOADADDRESS = "0x40008000"

FLASH_SIZE = "32768"

PREFERRED_PROVIDER_virtual/phosphor-ipmi-fru-inventory = "firestone-ipmi-inventory-map-native"
```

## meta-openbmc-machines/meta-openpower/meta-ibm/meta-palmetto/conf/layer.conf
```bitbake
# We have a conf and classes directory, add to BBPATH
BBPATH .= ":${LAYERDIR}"

# We have a recipes-* directories, add to BBFILES
BBFILES += "${LAYERDIR}/recipes-*/*/*.bb \
	${LAYERDIR}/recipes-*/*/*.bbappend"

BBFILE_COLLECTIONS += "palmetto"
BBFILE_PATTERN_palmetto = ""
```

## meta-openbmc-machines/meta-openpower/meta-ibm/meta-palmetto/conf/machine/palmetto.conf
```bitbake
KMACHINE = "aspeed"
KERNEL_DEVICETREE = "${KMACHINE}-bmc-opp-${MACHINE}.dtb"

require conf/machine/include/ast2400.inc
require conf/machine/include/obmc-bsp-common.inc
require conf/machine/include/ibm.inc

UBOOT_MACHINE_palmetto = "palmetto_config"
UBOOT_ENTRYPOINT = "0x40008000"
UBOOT_LOADADDRESS = "0x40008000"

FLASH_SIZE = "32768"

PREFERRED_PROVIDER_virtual/obmc-phosphor-host-ipmi-hw = "host-ipmi-bt"
```

## meta-openbmc-machines/meta-openpower/meta-ibm/meta-romulus/conf/machine/romulus.conf
```bitbake
KMACHINE = "aspeed"
KERNEL_DEVICETREE = "${KMACHINE}-bmc-opp-${MACHINE}.dtb"

UBOOT_MACHINE = "ast_g5_ncsi_config"

PREFERRED_PROVIDER_virtual/p9-vcs-workaround = 'cpld-trigger'

require conf/machine/include/ast2500.inc
require conf/machine/include/obmc-bsp-common.inc
require conf/machine/include/ibm.inc
require conf/machine/include/p9.inc

PHOSPHOR_MRW_URI = "git://github.com/open-power/romulus-xml"
PHOSPHOR_MRW_REV = "14b471fbf37f5fb60261de001df83caf5f96d81f"

PREFERRED_PROVIDER_virtual/phosphor-ipmi-fru-inventory = "romulus-ipmi-inventory-map-native"
PREFERRED_PROVIDER_virtual/phosphor-led-manager-config-native = "romulus-led-manager-config-native"
```

## meta-openbmc-machines/meta-openpower/meta-ibm/meta-stonewither/conf/machine/stonewither.conf
```bitbake
require conf/machine/witherspoon.conf

#Use the Withespoon device tree
KERNEL_DEVICETREE = "${KMACHINE}-bmc-opp-witherspoon.dtb"

#No power supplies
OBMC_POWER_SUPPLY_INSTANCES = ""

#Use the witherspoon MRW XML
MRW_XML = "witherspoon.xml"

#No fans to detect
VIRTUAL-RUNTIME_obmc-fan-presence = ""
```

## meta-openbmc-machines/meta-openpower/meta-ibm/meta-sunray2/conf/machine/sunray2.conf
```bitbake
MACHINE = "sunray2"
KERNEL_DEVICETREE = "fsp2.dtb"

require conf/machine/include/sunray2.inc
require conf/machine/include/obmc-bsp-common.inc
require conf/machine/include/ibm.inc

#dummy uboot settings
UBOOT_MACHINE_sunray2 = "mpc8308_p1m_defconfig"
UBOOT_ENTRYPOINT = "0x0"
UBOOT_LOADADDRESS = "0x0"
```

## meta-openbmc-machines/meta-openpower/meta-ibm/meta-witherspoon/conf/bblayers.conf.sample
```bitbake
# LAYER_CONF_VERSION is increased each time build/conf/bblayers.conf
# changes incompatibly
LCONF_VERSION = "6"

BBPATH = "${TOPDIR}"
BBFILES ?= ""

BBLAYERS ?= " \
  ##OEROOT##/meta \
  ##OEROOT##/meta-yocto \
  ##OEROOT##/meta-phosphor \
  ##OEROOT##/meta-openbmc-bsp/meta-aspeed \
  ##OEROOT##/meta-openbmc-bsp/meta-aspeed/meta-ast2500 \
  ##OEROOT##/meta-openbmc-machines/meta-openpower \
  ##OEROOT##/meta-openbmc-machines/meta-openpower/meta-ibm \
  ##OEROOT##/meta-openbmc-machines/meta-openpower/meta-ibm/meta-witherspoon \
  "
BBLAYERS_NON_REMOVABLE ?= " \
  ##OEROOT##/meta \
  ##OEROOT##/meta-yocto \
  ##OEROOT##/meta-phosphor \
  ##OEROOT##/meta-aspeed \
  ##OEROOT##/meta-aspeed/meta-ast2500 \
  ##OEROOT##/meta-openpower \
  ##OEROOT##/meta-openpower/meta-ibm \
  ##OEROOT##/meta-openpower/meta-ibm/meta-witherspoon\
  "
```

## meta-openbmc-machines/meta-openpower/meta-ibm/meta-witherspoon/conf/distro/openbmc-witherspoon.conf
```bitbake
require conf/distro/include/phosphor-base.inc
require conf/distro/include/phosphor-ubi.inc
require conf/distro/include/openpower-mrw.inc
require conf/distro/include/openpower-ubi.inc
require conf/distro/include/openpower-distrovars.inc
```

## meta-openbmc-machines/meta-openpower/meta-ibm/meta-witherspoon/conf/machine/witherspoon.conf
```bitbake
KMACHINE = "aspeed"
KERNEL_DEVICETREE = "${KMACHINE}-bmc-opp-${MACHINE}.dtb"

UBOOT_MACHINE = "ast_g5_ncsi_config"

OBMC_MACHINE_FEATURES += "obmc-mrw obmc-ubi-fs openpower-ubi-fs"

OBMC_POWER_SUPPLY_INSTANCES = "0 1"

PREFERRED_PROVIDER_virtual/p9-vcs-workaround = 'vcs-pre-post'

require conf/machine/include/ast2500.inc
require conf/machine/include/obmc-bsp-common.inc
require conf/machine/include/ibm.inc
require conf/machine/include/p9.inc

PHOSPHOR_MRW_URI = "git://github.com/open-power/witherspoon-xml"
PHOSPHOR_MRW_REV = "24d2f6d98568f0b23d1eb3bb9f876a638be4ae37"

# Inhibit phosphor-hwmon-config-mrw
VIRTUAL-RUNTIME_phosphor-hwmon-config = ""

# Inhibit phosphor-fan-presence-mrw-native
PREFERRED_PROVIDER_virtual/phosphor-fan-presence-config = \
    "phosphor-fan-presence-config-native"

# Inhibit phosphor-fan-control-fan-config-mrw-native
PREFERRED_PROVIDER_virtual/phosphor-fan-control-fan-config = \
    "phosphor-fan-control-fan-config-native"
```

## meta-openbmc-machines/meta-openpower/meta-ibm/meta-z/conf/bblayers.conf.sample
```bitbake
# LAYER_CONF_VERSION is increased each time build/conf/bblayers.conf
# changes incompatibly
LCONF_VERSION = "7"

BBPATH = "${TOPDIR}"
BBFILES ?= ""

BBLAYERS ?= " \
  ##OEROOT##/meta \
  ##OEROOT##/meta-poky \
  ##OEROOT##/meta-openembedded/meta-oe/   \
  ##OEROOT##/meta-openembedded/meta-filesystems/   \
  ##OEROOT##/meta-openembedded/meta-networking/   \
  ##OEROOT##/meta-openembedded/meta-python/   \
  ##OEROOT##/meta-openembedded/meta-webserver \
  ##OEROOT##/meta-phosphor \
  ##OEROOT##/meta-ibm/meta-fsp2 \
  ##OEROOT##/meta-openbmc-machines/meta-openpower \
  ##OEROOT##/meta-openbmc-machines/meta-openpower/meta-ibm \
  ##OEROOT##/meta-openbmc-machines/meta-openpower/meta-ibm/meta-z \
"
BBLAYERS_NON_REMOVABLE ?= " \
  ##OEROOT##/meta \
  ##OEROOT##/meta-poky \
  "
```

## meta-openbmc-machines/meta-openpower/meta-ibm/meta-z/conf/machine/ibm-z.conf
```bitbake
MACHINE = "ibm-z"
KERNEL_DEVICETREE = "fsp2.dtb"
KBUILD_DEFCONFIG = "44x/fsp2_defconfig"

require conf/machine/include/fsp2.inc
require conf/machine/include/obmc-bsp-common.inc
require conf/machine/include/ibm.inc

#dummy uboot settings
UBOOT_MACHINE_sunray2 = "mpc8308_p1m_defconfig"
UBOOT_ENTRYPOINT = "0x0"
UBOOT_LOADADDRESS = "0x0"
```

## meta-openbmc-machines/meta-openpower/meta-ingrasys/meta-zaius/conf/bblayers.conf.sample
```bitbake
# LAYER_CONF_VERSION is increased each time build/conf/bblayers.conf
# changes incompatibly
LCONF_VERSION = "6"

BBPATH = "${TOPDIR}"
BBFILES ?= ""

BBLAYERS ?= " \
  ##OEROOT##/meta \
  ##OEROOT##/meta-poky \
  ##OEROOT##/meta-phosphor \
  ##OEROOT##/meta-openbmc-bsp/meta-aspeed \
  ##OEROOT##/meta-openbmc-bsp/meta-aspeed/meta-ast2500 \
  ##OEROOT##/meta-openbmc-machines/meta-openpower \
  ##OEROOT##/meta-openbmc-machines/meta-openpower/meta-ingrasys \
  ##OEROOT##/meta-openbmc-machines/meta-openpower/meta-ingrasys/meta-zaius \
  "
BBLAYERS_NON_REMOVABLE ?= " \
  ##OEROOT##/meta \
  ##OEROOT##/meta-poky \
  ##OEROOT##/meta-phosphor \
  ##OEROOT##/meta-openbmc-bsp/meta-aspeed \
  ##OEROOT##/meta-openbmc-bsp/meta-aspeed/meta-ast2500 \
  ##OEROOT##/meta-openbmc-machines/meta-openpower \
  ##OEROOT##/meta-openbmc-machines/meta-openpower/meta-ingrasys \
  ##OEROOT##/meta-openbmc-machines/meta-openpower/meta-ingrasys/meta-zaius \
  "
```

## meta-openbmc-machines/meta-openpower/meta-ingrasys/meta-zaius/conf/machine/zaius.conf
```bitbake
KMACHINE = "aspeed"
KERNEL_DEVICETREE = "${KMACHINE}-bmc-opp-${MACHINE}.dtb"

UBOOT_MACHINE = "ast_g5_ncsi_config"

FLASH_SIZE = "65536"

DISTRO_FEATURES_append = "\
        obmc-openpower \
        obmc-openpower-extra \
        obmc-openpower-legacy \
        "

PREFERRED_PROVIDER_virtual/p9-vcs-workaround = 'vcs-control'
PREFERRED_PROVIDER_virtual/phosphor-ipmi-fru-inventory = "zaius-ipmi-inventory-map-native"

require conf/machine/include/ast2500.inc
require conf/machine/include/obmc-bsp-common.inc
require conf/machine/include/ingrasys.inc
require conf/machine/include/p9.inc
```

## meta-openbmc-machines/meta-openpower/meta-inventec/meta-lanyang/conf/machine/lanyang.conf
```bitbake
KMACHINE = "aspeed"
KERNEL_DEVICETREE = "${KMACHINE}-bmc-opp-${MACHINE}.dtb"

UBOOT_MACHINE = "ast_g5_ncsi_config"

FLASH_SIZE = "65536"

PREFERRED_PROVIDER_virtual/phosphor-ipmi-fru-inventory = "lanyang-ipmi-inventory-map-native"
PREFERRED_PROVIDER_virtual/phosphor-led-manager-config-native = "lanyang-led-manager-config-native"

require conf/machine/include/ast2500.inc
require conf/machine/include/obmc-bsp-common.inc
require conf/machine/include/inventec.inc
require conf/machine/include/p9.inc
```
