## meta-arm/meta-gem5/conf/layer.conf
```bitbake
# We have a conf and classes directory, add to BBPATH
BBPATH .= ":${LAYERDIR}"

# We have recipes-* directories, add to BBFILES
BBFILES += "${LAYERDIR}/recipes-*/*/*.bb \
            ${LAYERDIR}/recipes-*/*/*.bbappend"

BBFILE_COLLECTIONS += "meta-gem5"
BBFILE_PATTERN_meta-gem5 = "^${LAYERDIR}/"
BBFILE_PRIORITY_meta-gem5 = "5"

LAYERDEPENDS_meta-gem5 = "core openembedded-layer meta-arm"
LAYERSERIES_COMPAT_meta-gem5 = "langdale mickledore"

BBFILES_DYNAMIC += " \
    virtualization-layer:${LAYERDIR}/dynamic-layers/meta-virtualization/*/*/*.bbappend \
"

DISTRO_FEATURES_NATIVE:append = " ${@bb.utils.filter('DISTRO_FEATURES', 'xen', d)}"
```

## meta-arm/meta-gem5/conf/machine/gem5-arm64.conf
```bitbake
# Configuration for gem5 running on ARM64

#@TYPE: Machine
#@NAME: Gem5 arm64 machine
#@DESCRIPTION: Machine configuration for Gem5 arm64

TUNE_FEATURES = "aarch64"

require conf/machine/include/arm/arch-armv8a.inc

MACHINE_FEATURES = "optee pci"

KERNEL_IMAGETYPES = "Image vmlinux"
KERNEL_IMAGETYPE = "Image"

IMAGE_FSTYPES += "tar.bz2 ext4"

SERIAL_CONSOLES = "115200;ttyAMA0"

EXTRA_IMAGEDEPENDS += "virtual/gem5-bootloader"

PREFERRED_PROVIDER_virtual/kernel ?= "linux-yocto"
PREFERRED_VERSION_linux-yocto ?= "5.4%"


# Uncomment the following if you need to build gem5 provided bootloader, else
# using standard bootloader by Linux aarch64
# Use gem5 provided bootloader
# PREFERRED_PROVIDER_virtual/gem5-bootloader = "gem5-aarch64-bootloader"

# use the dtb stored in the kernel recipe
# KERNEL_DEVICETREE ?= "gem5-arm64/armv8_gem5_v2_4cpu.dtb"

# Use Linux aarch64 boot wrapper with FDT support and generated
# dtb (gem5-aarch64-dtb.bb)
PREFERRED_PROVIDER_virtual/gem5-bootloader = "boot-wrapper-aarch64"

BOOT_WRAPPER_AARCH64_CMDLINE ?= "\
    earlyprintk=pl011,0x1c090000 console=ttyAMA0 root=/dev/vda rw mem=1G \
    "
# Use baremetal profile and axf file so dtb is in axf file
GEM5_RUN_PROFILE = "configs/example/arm/baremetal.py"
GEM5_RUN_KERNEL = "linux-system.axf"
GEM5_RUN_EXTRA = ""
GEM5_RUN_DTB = ""
GEM5_RUN_CMDLINE = ""

EXTRA_IMAGEDEPENDS += "gem5-aarch64-native"

# As this is a virtual target that will not be used in the real world there is
# no need for real SSH keys.  Disable rng-tools (which takes too long to
# initialise) and install the pre-generated keys.
PACKAGECONFIG:remove:pn-openssh = "rng-tools"
MACHINE_EXTRA_RRECOMMENDS += "ssh-pregen-hostkeys"
```

## meta-aspeed/conf/layer.conf
```bitbake
# We have a conf and classes directory, add to BBPATH
BBPATH .= ":${LAYERDIR}"

BBFILES += "${LAYERDIR}/recipes-*/*/*.bb \
            ${LAYERDIR}/recipes-*/*/*.bbappend"

BBFILE_COLLECTIONS += "aspeed-layer"
BBFILE_PATTERN_aspeed-layer := "^${LAYERDIR}/"
LAYERVERSION_aspeed-layer = "1"
LAYERSERIES_COMPAT_aspeed-layer = "whinlatter walnascar"

# Add dynamic layers for Trusted Firmware-A
BBFILES_DYNAMIC += " \
    meta-arm:${LAYERDIR}/dynamic-layers/arm-layer/recipes-*/*/*.bb \
    meta-arm:${LAYERDIR}/dynamic-layers/arm-layer/recipes-*/*/*.bbappend \
"
```

## meta-aspeed/conf/local.conf.sample
```bitbake
#MACHINE ?= "evb-ast2500"
MACHINE ??= "evb-ast2600"

# Allow logging in if the user does not set the root password.
EXTRA_IMAGE_FEATURES ?= "debug-tweaks"
```

## meta-aspeed/conf/machine/ast2700_bootmcu.conf
```bitbake
require conf/machine/include/riscv/tune-riscv.inc

DEFAULTTUNE = "riscv32nf"

# BootMCU Build Settings
BOOTMCU_MACHINE = "ibex-ast2700_defconfig"
BOOTMCU_FW_BINARY = "ast2700-ibex-spl.bin"
```

## meta-aspeed/conf/machine/evb-ast2500.conf
```bitbake
KERNEL_DEVICETREE = "aspeed/aspeed-ast2500-evb.dtb"

UBOOT_MACHINE = "evb-ast2500_defconfig"
UBOOT_DEVICETREE = "ast2500-evb"

require conf/machine/include/ast2500.inc
require conf/machine/include/obmc-evb-common.inc

SERIAL_CONSOLES = "115200;ttyS4"

FLASH_SIZE = "32768"
```

## meta-aspeed/conf/machine/evb-ast2600.conf
```bitbake
KERNEL_DEVICETREE = "aspeed/aspeed-ast2600-evb.dtb"

UBOOT_MACHINE = "ast2600_openbmc_spl_defconfig"
UBOOT_DEVICETREE = "ast2600-evb"
SPL_BINARY = "spl/u-boot-spl.bin"
# Disable hardware root of trust by default.
# If users want to enable secure boot,
# please do the following steps.
# 1. Set SOCSEC_SIGN_ENABLE to “1”.
# 2. Provide platform OTP config.
# There was an example in p10bmc.
# If users enable socsec signing but do not provide OTP config,
# u-boot will be built failed.
SOCSEC_SIGN_ENABLE = "0"

require conf/machine/include/ast2600.inc
require conf/machine/include/obmc-evb-common.inc

SERIAL_CONSOLES = "115200;ttyS4"

# AST2600 EVB has 64MB SPI flash
FLASH_SIZE = "65536"
```

## meta-aspeed/conf/machine/include/aspeed.inc
```bitbake
PREFERRED_PROVIDER_virtual/kernel ?= "linux-aspeed"

PREFERRED_PROVIDER_virtual/bootloader ?= "u-boot-aspeed-sdk"
PREFERRED_PROVIDER_u-boot ?= "u-boot-aspeed-sdk"
PREFERRED_PROVIDER_u-boot-fw-utils ?= "u-boot-fw-utils-aspeed-sdk"

# Build a FIT image and stuff core-image-minimal in it by default.
# FIT images are now built by the linux-yocto-fitimage recipe
# The kernel itself builds a standard image type (zImage for ARM, Image for ARM64)
KERNEL_IMAGETYPE ?= "zImage"
KERNEL_IMAGETYPE:aarch64 ?= "Image"
KERNEL_IMAGETYPES:aarch64 ?= "Image"
KERNEL_CLASSES ?= "kernel-fit-extra-artifacts"
INITRAMFS_IMAGE ?= "aspeed-image-initramfs"
INITRAMFS_FSTYPES ?= "cpio.xz"

WKS_FILE ?= "emmc-aspeed.wks.in"
WKS_FILE_DEPENDS ?= " \
    phosphor-hostfw-image \
    virtual/bootloader \
    virtual/kernel \
    linux-yocto-fitimage \
"
WKS_HOSTFW_SIZE ?= "5G"
IMAGE_BOOT_FILES ?= "fitImage-${INITRAMFS_IMAGE}-${MACHINE}-${MACHINE};fitImage"

MACHINE_EXTRA_RRECOMMENDS += "udev-aspeed-vuart udev-aspeed-mtd-partitions"
MACHINE_FEATURES += "hw-rng"

MACHINEOVERRIDES =. "aspeed:"

# runqemu support
EXTRA_IMAGEDEPENDS += "qemu-helper-native"
IMAGE_CLASSES += "qemuboot"
QB_ROOTFS_OPT = "-drive file=@ROOTFS@,if=mtd,format=raw"
QB_DEFAULT_FSTYPE = "static.mtd"
# Disable virtio-pci device
QB_RNG = ""
# Specify netdev to align with default QB_SLIRP_OPT
QB_NETWORK_DEVICE = "-net nic,netdev=net0"
# Boot from drive
QB_DEFAULT_KERNEL = "none"
```

## meta-aspeed/conf/machine/include/ast2400.inc
```bitbake
SOC_FAMILY = "aspeed-g4"
include conf/machine/include/soc-family.inc
require conf/machine/include/aspeed.inc
require conf/machine/include/arm/armv5/tune-arm926ejs.inc

SERIAL_CONSOLES ?= "115200;ttyS4"
UBOOT_ENTRYPOINT ?= "0x40001000"
UBOOT_LOADADDRESS ?= "0x40001000"

QB_SYSTEM_NAME = "qemu-system-arm"
QB_MEM = "-m 512"
QB_MACHINE = "-machine palmetto-bmc"

PREFERRED_VERSION_u-boot-aspeed-sdk = "v2019.04+%"
PREFERRED_VERSION_u-boot-fw-utils-aspeed-sdk = "v2019.04+%"
```

## meta-aspeed/conf/machine/include/ast2500.inc
```bitbake
SOC_FAMILY = "aspeed-g5"
include conf/machine/include/soc-family.inc
require conf/machine/include/aspeed.inc

DEFAULTTUNE = "arm1176jzs"
require conf/machine/include/arm/armv6/tune-arm1176jz-s.inc

SERIAL_CONSOLES ?= "115200;ttyS4"
UBOOT_ENTRYPOINT ?= "0x80001000"
UBOOT_LOADADDRESS ?= "0x80001000"

QB_MACHINE = "-machine ast2500-evb"
QB_MEM = "-m 1G"
```

## meta-aspeed/conf/machine/include/tune-arm1176jz-s.inc
```bitbake
DEFAULTTUNE ?= "armv6t-novfp"

require conf/machine/include/arm/arch-armv6.inc

TUNEVALID[arm1176jzs] = "Enable arm1176jzs specific processor optimizations"
TUNE_CCARGS += "${@bb.utils.contains("TUNE_FEATURES", "arm1176jzs", "-mtune=arm1176jz-s", "", d)}"

AVAILTUNES += "arm1176jzs"
ARMPKGARCH_tune-arm1176jzs = "${ARMPKGARCH_tune-armv6t-novfp}"
TUNE_FEATURES_tune-arm1176jzs = "${TUNE_FEATURES_tune-armv6t-novfp} arm1176jzs"
PACKAGE_EXTRA_ARCHS_tune-arm1176jzs = "${PACKAGE_EXTRA_ARCHS_tune-armv6t-novfp}"
```

## meta-aspeed/conf/machine/include/ufs.inc
```bitbake
MACHINE_FEATURES:append = " mf-ufs"
MACHINEOVERRIDES .= ":mf-ufs"

# Use WIC_SECTOR_SIZE and WIC_BLOCK_SIZE to define the sizes for UFS storage.
WIC_SECTOR_SIZE ?= "4096"
WIC_BLOCK_SIZE ?= "4096"
WICVARS:append = " WIC_SECTOR_SIZE WIC_BLOCK_SIZE"
```

## meta-asrock/conf/layer.conf
```bitbake
# We have a conf and classes directory, add to BBPATH
BBPATH .= ":${LAYERDIR}"

# We have recipes-* directories, add to BBFILES
BBFILES += "${LAYERDIR}/meta-common/recipes-*/*/*.bb \
            ${LAYERDIR}/meta-common/recipes-*/*/*.bbappend"

BBFILE_COLLECTIONS += "asrock-layer"
BBFILE_PATTERN_asrock-layer = "^${LAYERDIR}/"
LAYERVERSION_asrock-layer = "1"
LAYERSERIES_COMPAT_asrock-layer = "scarthgap styhead"
```

## meta-asrock/conf/machine/include/asrock.inc
```bitbake
MACHINE_FEATURES += "\
    obmc-host-ipmi \
    "

VIRTUAL-RUNTIME_obmc-inventory-manager = "entity-manager"
PREFERRED_PROVIDER_virtual/obmc-inventory-data = "entity-manager"

VIRTUAL-RUNTIME_obmc-sensors-hwmon ?= "dbus-sensors"

VIRTUAL-RUNTIME_obmc-host-state-manager ?= "x86-power-control"
VIRTUAL-RUNTIME_obmc-chassis-state-manager ?= "x86-power-control"

PREFERRED_PROVIDER_virtual/obmc-chassis-mgmt = "packagegroup-asrock-apps"
PREFERRED_PROVIDER_virtual/obmc-fan-mgmt = "packagegroup-asrock-apps"
PREFERRED_PROVIDER_virtual/obmc-flash-mgmt = "packagegroup-asrock-apps"
PREFERRED_PROVIDER_virtual/obmc-system-mgmt = "packagegroup-asrock-apps"

PREFERRED_PROVIDER_virtual/obmc-host-ipmi-hw ?= "phosphor-ipmi-kcs"
```

## meta-asrock/meta-e3c246d4i/conf/layer.conf
```bitbake
# We have a conf and classes directory, add to BBPATH
BBPATH .= ":${LAYERDIR}"

# We have recipes-* directories, add to BBFILES
BBFILES += "${LAYERDIR}/recipes-*/*/*.bb \
            ${LAYERDIR}/recipes-*/*/*.bbappend"

BBFILE_COLLECTIONS += "e3c246d4i-layer"
BBFILE_PATTERN_e3c246d4i-layer = "^${LAYERDIR}/"
LAYERSERIES_COMPAT_e3c246d4i-layer = "scarthgap styhead"
```

## meta-asrock/meta-e3c246d4i/conf/machine/e3c246d4i.conf
```bitbake
KMACHINE = "aspeed"
KERNEL_DEVICETREE = "aspeed/${KMACHINE}-bmc-asrock-${MACHINE}.dtb"

UBOOT_DEVICETREE = "ast2500-evb"
UBOOT_MACHINE = "evb-ast2500_defconfig"

FLASH_SIZE = "32768"

require conf/machine/include/ast2500.inc
require conf/machine/include/obmc-bsp-common.inc
require conf/machine/include/asrock.inc

MACHINEOVERRIDES =. "asrock-mmc-sdhci-reset-quirk:"
```

## meta-asrock/meta-romed8hm3/conf/layer.conf
```bitbake
# We have a conf and classes directory, add to BBPATH
BBPATH .= ":${LAYERDIR}"

# We have recipes-* directories, add to BBFILES
BBFILES += "${LAYERDIR}/recipes-*/*/*.bb \
            ${LAYERDIR}/recipes-*/*/*.bbappend"

BBFILE_COLLECTIONS += "romed8hm3-layer"
BBFILE_PATTERN_romed8hm3-layer = "^${LAYERDIR}/"
LAYERSERIES_COMPAT_romed8hm3-layer = "scarthgap styhead"
```

## meta-asrock/meta-spc621d8hm3/conf/layer.conf
```bitbake
# We have a conf and classes directory, add to BBPATH
BBPATH .= ":${LAYERDIR}"

# We have recipes-* directories, add to BBFILES
BBFILES += "${LAYERDIR}/recipes-*/*/*.bb \
            ${LAYERDIR}/recipes-*/*/*.bbappend"

BBFILE_COLLECTIONS += "spc621d8hm3-layer"
BBFILE_PATTERN_spc621d8hm3-layer = "^${LAYERDIR}/"
LAYERSERIES_COMPAT_spc621d8hm3-layer = "scarthgap styhead"
```

## meta-axiado-sdk/conf/layer.conf
```bitbake
# We have a conf and classes directory, add to BBPATH
BBPATH .= ":${LAYERDIR}"

# We have recipes-* directories, add to BBFILES
BBFILES += "${LAYERDIR}/recipes-*/*/*.bb \
            ${LAYERDIR}/recipes-*/*/*.bbappend"

BBFILE_COLLECTIONS += "meta-axiado-sdk"
BBFILE_PATTERN_meta-axiado-sdk = "^${LAYERDIR}/"

LAYERDEPENDS_meta-axiado-sdk = "core"
LAYERSERIES_COMPAT_meta-axiado-sdk = "whinlatter walnascar"
```

## meta-axiado-sdk/conf/machine/include/axiado-dbg.inc
```bitbake
# Copyright (c) 2021-24 Axiado Corporation (or its affiliates). All rights reserved.

KERNEL_IMAGETYPE ?= "Image"
FLASH_KERNEL_IMAGE ?= "Image"
INITRAMFS_IMAGE = "obmc-phosphor-image"
INITRAMFS_MAXSIZE = "631072"
```

## meta-axiado-sdk/conf/machine/include/axiado-dev.inc
```bitbake
# Copyright (c) 2021-24 Axiado Corporation (or its affiliates). All rights reserved.

WKS_FILE ?= "emmc-axiado.wks.in"
WKS_FILE_DEPENDS ?= "virtual/kernel"
WKS_FILE_DEPENDS += "e2fsprogs-native"

IMAGE_BOOT_FILES ?= "fitImage"
KERNEL_IMAGETYPE ?= "fitImage"
FLASH_KERNEL_IMAGE ?= "fitImage"

FLASH_UBOOT_OFFSET = "0"

require conf/distro/include/phosphor-mmc.inc
require conf/machine/include/image-type/mmc.inc
```

## meta-axiado-sdk/conf/machine/include/axiado-prod.inc
```bitbake
# Copyright (c) 2021-24 Axiado Corporation (or its affiliates). All rights reserved.

WKS_FILE ?= "emmc-axiado.wks.in"
WKS_FILE_DEPENDS ?= "virtual/kernel"
WKS_FILE_DEPENDS += "e2fsprogs-native"

IMAGE_BOOT_FILES ?= "fitImage"
KERNEL_IMAGETYPE ?= "fitImage"
FLASH_KERNEL_IMAGE ?= "fitImage"

DISTROOVERRIDES .= ":axiado-provision"

IMAGE_CLASSES += "image_types_ax3000"

require conf/distro/include/phosphor-mmc.inc
require conf/machine/include/image-type/mmc.inc
```
