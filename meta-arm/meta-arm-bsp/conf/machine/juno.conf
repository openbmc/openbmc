## meta-arm/meta-arm-bsp/conf/machine/juno.conf
```bitbake
# Configuration for juno development board

#@TYPE: Machine
#@NAME: Juno machine
#@DESCRIPTION: Machine configuration for Juno

TUNE_FEATURES = "aarch64"

require conf/machine/include/arm/arch-armv8a.inc

MACHINE_FEATURES = "usbhost usbgadget alsa screen wifi bluetooth optee pci"

KERNEL_IMAGETYPE = "Image.gz"
KERNEL_DEVICETREE = "arm/juno.dtb arm/juno-r1.dtb arm/juno-r2.dtb"

IMAGE_FSTYPES += "tar.bz2 ext4 cpio.gz"

SERIAL_CONSOLES = "115200;ttyAMA0"

PREFERRED_PROVIDER_virtual/kernel ?= "linux-yocto"
PREFERRED_PROVIDER_virtual/bootloader ?= "u-boot"

EXTRA_IMAGEDEPENDS += "trusted-firmware-a virtual/bootloader firmware-image-juno"

# Juno u-boot configuration
UBOOT_MACHINE = "vexpress_aemv8a_juno_defconfig"

INITRAMFS_IMAGE_BUNDLE ?= "1"
INITRAMFS_IMAGE = "core-image-minimal"
IMAGE_NAME_SUFFIX = ""
```

## meta-arm/meta-arm-bsp/conf/machine/musca-b1.conf
```bitbake
# Configuration for Musca-B1 development board

#@TYPE: Machine
#@NAME: Musca-B1 machine
#@DESCRIPTION: Machine configuration for Musca-B1

DEFAULTTUNE ?= "armv8m-main"
require conf/machine/include/arm/armv8-m/tune-cortexm33.inc

# GLIBC will not work with Cortex-M.
TCLIBC = "newlib"

# For runqemu
IMAGE_FSTYPES += "ext4"
IMAGE_CLASSES += "qemuboot"
QB_SYSTEM_NAME = "qemu-system-arm"
QB_MACHINE = "-machine musca-b1"
QB_CPU = "-cpu cortex-m33"
QB_GRAPHICS = "-nographic -vga none"
QB_MEM = "512k"
QB_RNG = ""

TFM_PLATFORM = "arm/musca_b1"
```

## meta-arm/meta-arm-bsp/conf/machine/n1sdp.conf
```bitbake
# Configuration for Arm N1SDP development board

#@TYPE: Machine
#@NAME: N1SDP machine
#@DESCRIPTION: Machine configuration for N1SDP

require conf/machine/include/arm/armv8-2a/tune-neoversen1.inc

KERNEL_IMAGETYPE = "Image"

IMAGE_FSTYPES += "wic wic.gz wic.bmap tar.bz2 ext4"

SERIAL_CONSOLES = "115200;ttyAMA0"

# Set default WKS
WKS_FILE ?= "n1sdp-efidisk.wks"
IMAGE_EFI_BOOT_FILES ?= "n1sdp-multi-chip.dtb n1sdp-single-chip.dtb"
WKS_FILE_DEPENDS:append = " ${EXTRA_IMAGEDEPENDS}"

# Use kernel provided by yocto
PREFERRED_PROVIDER_virtual/kernel ?= "linux-yocto"
PREFERRED_VERSION_linux-yocto ?= "6.6%"

# RTL8168E Gigabit Ethernet Controller is attached to the PCIe interface
MACHINE_ESSENTIAL_EXTRA_RDEPENDS += "linux-firmware-rtl8168"

# TF-A
EXTRA_IMAGEDEPENDS += "trusted-firmware-a"
TFA_PLATFORM = "n1sdp"
PREFERRED_VERSION_trusted-firmware-a ?= "2.10.%"
PREFERRED_VERSION_tf-a-tests ?= "2.10.%"

# SCP
EXTRA_IMAGEDEPENDS += "virtual/control-processor-firmware"

#UEFI EDK2 firmware
EXTRA_IMAGEDEPENDS += "edk2-firmware"
PREFERRED_VERSION_edk2-firmware ?= "202311"

#optee
PREFERRED_VERSION_optee-os ?= "4.1.%"
PREFERRED_VERSION_optee-os-tadevkit ?= "4.1.%"
PREFERRED_VERSION_optee-test ?= "4.1.%"
PREFERRED_VERSION_optee-client ?= "4.1.%"

#grub-efi
EFI_PROVIDER ?= "grub-efi"
MACHINE_FEATURES += "efi"

# SD-Card firmware
EXTRA_IMAGEDEPENDS += "sdcard-image-n1sdp"
```

## meta-arm/meta-arm-bsp/conf/machine/qemu-cortex-r5.conf
```bitbake
#@TYPE: Machine
#@NAME: qemu_cortex_r5
#@DESCRIPTION: Machine for Zephyr BOARD qemu_cortex_r5

require conf/machine/include/qemu.inc
require conf/machine/include/arm/armv7r/tune-cortexr5.inc

# GLIBC will not work with Cortex-R.
TCLIBC = "newlib"

# For runqemu
QB_SYSTEM_NAME = "qemu-system-aarch64"
QB_MACHINE = "-machine xlnx-zcu102"
QB_CPU = "-cpu cortex-r5"
QB_MEM = "-m 64k"
QB_GRAPHICS = "-nographic -vga none"
QB_RNG = ""

# Zephyr RTOS settings
ZEPHYR_BOARD = "qemu_cortex_r5"
ZEPHYR_INHERIT_CLASSES += "zephyr-qemuboot"
ARCH:qemu-cortex-r5 = "arm"
```

## meta-arm/meta-arm-bsp/conf/machine/sbsa-ref.conf
```bitbake
#@TYPE: Machine
#@NAME: sbsa-ref
#@DESCRIPTION: Reference SBSA machine in qemu-system-aarch64 on Neoverse N2

require conf/machine/include/arm/armv9a/tune-neoversen2.inc
require conf/machine/include/qemu.inc

PREFERRED_PROVIDER_virtual/kernel ?= "linux-yocto"
KERNEL_IMAGETYPE = "Image"
MACHINE_EXTRA_RRECOMMENDS += "kernel-modules"

MACHINE_FEATURES = " alsa bluetooth efi qemu-usermode rtc screen usbhost vfat wifi"

IMAGE_FSTYPES += "wic.qcow2"

# This unique WIC file is necessary because kernel boot args cannot be passed
# because there is no default kernel (see below).  There is no default kernel
# because QEMU will only allow firmware or kernel to be passed in as a
# parameter, and we need the firmware.  So, to allow for "ip=dhcp" as a kernel
# boot arg (which we need for testimage), we have to have a WIC file unique to
# this platform.
WKS_FILE = "qemu-efi-disk.wks.in"

EFI_PROVIDER ?= "${@bb.utils.contains("DISTRO_FEATURES", "systemd", "systemd-boot", "grub-efi", d)}"

SERIAL_CONSOLES ?= "115200;ttyAMA0 115200;hvc0"

EXTRA_IMAGEDEPENDS += "edk2-firmware"

QB_SYSTEM_NAME = "qemu-system-aarch64"
QB_MACHINE = "-machine sbsa-ref"
QB_CPU = "-cpu neoverse-n2"
QB_MEM = "-m 1024"
QB_DEFAULT_FSTYPE = "wic.qcow2"
QB_NETWORK_DEVICE = "-device virtio-net-pci,netdev=net0,mac=@MAC@"
QB_DRIVE_TYPE = "/dev/hd"
QB_ROOTFS_OPT = "-drive file=@ROOTFS@,if=ide,format=qcow2"
QB_DEFAULT_KERNEL = "none"
QB_OPT_APPEND = "-device usb-tablet -device usb-kbd -pflash @DEPLOY_DIR_IMAGE@/SBSA_FLASH0.fd -pflash @DEPLOY_DIR_IMAGE@/SBSA_FLASH1.fd"
QB_SERIAL_OPT = "-device virtio-serial-pci -chardev null,id=virtcon -device virtconsole,chardev=virtcon"
QB_TCPSERIAL_OPT = "-device virtio-serial-pci -chardev socket,id=virtcon,port=@PORT@,host=127.0.0.1 -device virtconsole,chardev=virtcon"
# sbsa-ref is a true virtual machine so can't use KVM
QEMU_USE_KVM = "0"
```

## meta-arm/meta-arm-bsp/conf/machine/sgi575.conf
```bitbake
# Configuration for Arm SGI575 development board

#@TYPE: Machine
#@NAME: SGI575
#@DESCRIPTION: Machine configuration for SGI575

require conf/machine/include/arm/armv8-2a/tune-cortexa75.inc

EXTRA_IMAGEDEPENDS += "virtual/control-processor-firmware"

EXTRA_IMAGEDEPENDS += "trusted-firmware-a"

KERNEL_IMAGETYPE ?= "Image"
PREFERRED_PROVIDER_virtual/kernel ?= "linux-yocto"
SERIAL_CONSOLES = "115200;ttyAMA0"

#grub-efi
EFI_PROVIDER ?= "grub-efi"
MACHINE_FEATURES += "efi"

IMAGE_FSTYPES += "cpio.gz wic"

WKS_FILE ?= "sgi575-efidisk.wks"
WKS_FILE_DEPENDS:append = " ${EXTRA_IMAGEDEPENDS}"
```

## meta-arm/meta-arm-bsp/conf/machine/tc0.conf
```bitbake
# Configuration for TC0

#@TYPE: Machine
#@NAME: TC0
#@DESCRIPTION: Machine configuration for TC0

require conf/machine/include/tc.inc
```

## meta-arm/meta-arm-bsp/conf/machine/tc1.conf
```bitbake
# Configuration for TC1

#@TYPE: Machine
#@NAME: TC1
#@DESCRIPTION: Machine configuration for TC1

require conf/machine/include/tc.inc

TEST_TARGET = "OEFVPTarget"
TEST_SUITES = "fvp_boot"

# FVP Config
FVP_PROVIDER ?= "fvp-tc1-native"
FVP_EXE ?= "FVP_TC1"

# FVP Parameters
FVP_CONFIG[css.scp.ROMloader.fname] ?= "scp_romfw.bin"
FVP_CONFIG[css.trustedBootROMloader.fname] ?= "bl1-tc.bin"
FVP_CONFIG[board.flashloader0.fname] ?= "fip_gpt-tc.bin"

#FVP_CONFIG[board.hostbridge.userNetworking] ?= "true"
#FVP_CONFIG[board.hostbridge.userNetPorts] ?= "2222=22"
#smsc ethernet takes a very long time to come up.  disable now to prevent testimage timeout
#FVP_CONFIG[board.smsc_91c111.enabled] ?= "1"

FVP_CONSOLE = "terminal_s1"
FVP_TERMINALS[soc.terminal_s0] ?= "Secure Console"
FVP_TERMINALS[soc.terminal_s1] ?= "Console"

# Boot image
FVP_DATA ?= "board.dram=fitImage-core-image-minimal-tc1-tc1@0x20000000"
```

## meta-arm/meta-arm-bsp/wic/core-image-minimal.corstone500.wks
```
# WIC partitioning for corstone500
# Layout and maximum sizes (to be defined):
#

# Rawcopy of the FIP binary
part --source rawcopy --sourceparams="file=fip.bin" --no-table --align 1 --fixed-size 1

# Rawcopy of the kernel binary
part --source rawcopy --sourceparams="file=zImage" --no-table --fixed-size 12

# Rawcopy of the rootfs
part --source rawcopy --sourceparams="file=${IMGDEPLOYDIR}/core-image-minimal-corstone500.squashfs" --no-table
```

## meta-arm/meta-arm-bsp/wic/corstone1000-image.corstone1000.wks
```
# WIC partitioning for corstone1000
# Layout and maximum sizes (to be defined):
#

part --source rawcopy --sourceparams="file=bl2_signed.bin" --align 1 --no-table --fixed-size 100k
part --source rawcopy --sourceparams="file=bl2_signed.bin" --align 1 --no-table --fixed-size 100k

part --source rawcopy --sourceparams="file=tfm_s_signed.bin" --align 1 --no-table --fixed-size 376k
part --source rawcopy --sourceparams="file=tfm_s_signed.bin" --align 1 --no-table --fixed-size 376k

# Rawcopy of the FIP binary
part --source rawcopy --sourceparams="file=signed_fip-corstone1000.bin" --align 1 --no-table --fixed-size 2

# Rawcopy of kernel with initramfs
part --source rawcopy --sourceparams="file=Image.gz-initramfs-${MACHINE}.bin" --no-table --fixed-size 12
```

## meta-arm/meta-arm-bsp/wic/fvp-base.wks
```
# For fvp-base* machines we just need to populate the rootfs partition

part / --source rootfs --ondisk sda --fstype=ext4 --label root --align 1024 --extra-space 100
```

## meta-arm/meta-arm-bsp/wic/n1sdp-efidisk.wks
```
# short-description: Create an EFI disk image
# long-description: Creates a partitioned EFI disk image that the user
# can directly dd to boot media. Uses a custom grub.cfg file to configure the boot.

part /boot --source bootimg-efi --sourceparams="loader=grub-efi" --ondisk sda --label msdos --active --align 1024

part / --source rootfs --ondisk sda --fstype=ext4 --label root --align 1024 --uuid=6a60524d-061d-454a-bfd1-38989910eccd

bootloader --ptable gpt --configfile="n1sdp-grub.cfg" --timeout=5
```

## meta-arm/meta-arm-bsp/wic/sgi575-efidisk.wks
```
# short-description: Create an EFI disk image
# long-description: Creates a partitioned EFI disk image that the user
# can directly dd to boot media. Uses a custom grub.cfg file to configure the boot.

part /boot --source bootimg-efi --sourceparams="loader=grub-efi" --ondisk sda --label msdos --active --align 1024

part / --source rootfs --ondisk sda --fstype=ext4 --label root --align 1024 --uuid=9c53a91b-e182-4ff1-aeac-6ee2c432ae94

part swap --ondisk sda --size 44 --label swap1 --fstype=swap

bootloader --ptable gpt --configfile="sgi575-grub.cfg" --timeout=5
```

## meta-arm/meta-arm-systemready/conf/layer.conf
```bitbake
# We have a conf and classes directory, add to BBPATH
BBPATH .= ":${LAYERDIR}"

# We have recipes-* directories, add to BBFILES
BBFILES += "${LAYERDIR}/recipes-*/*/*.bb \
            ${LAYERDIR}/recipes-*/*/*.bbappend"

BBFILE_COLLECTIONS += "meta-arm-systemready"
BBFILE_PATTERN_meta-arm-systemready = "^${LAYERDIR}/"

LAYERSERIES_COMPAT_meta-arm-systemready = "styhead walnascar"

LAYERDEPENDS_meta-arm-systemready = "core"

addpylib ${LAYERDIR}/lib oeqa
```
