## meta-aspeed/conf/machine/include/ast2700.inc
```bitbake
SOC_FAMILY = "aspeed-g7"
include conf/machine/include/soc-family.inc

# U-Boot Settings before aspeed.inc
PREFERRED_PROVIDER_virtual/bootloader ?= "u-boot-aspeed"
PREFERRED_PROVIDER_u-boot ?= "u-boot-aspeed"
PREFERRED_VERSION_u-boot-aspeed ?= "2026.10"

# fw_printenv/fw_setenv are provided by libubootenv; the fw_env.config
# is installed by the libubootenv bbappend in meta-aspeed.
PREFERRED_PROVIDER_u-boot-fw-utils ?= "libubootenv"

require conf/machine/include/aspeed.inc

DEFAULTTUNE = "cortexa35"

require conf/machine/include/arm/armv8a/tune-cortexa35.inc
require conf/machine/include/bootmcu.inc

UBOOT_FIT_ARM_TRUSTED_FIRMWARE = "1"
UBOOT_FIT_TEE = "1"

SERIAL_CONSOLES ?= "115200;ttyS12"

# For runqemu
QB_SYSTEM_NAME = "qemu-system-aarch64"
QB_MACHINE = "-machine ast2700a1-evb"
QB_MEM = "-m 1G"

# bootloader fitimage
UBOOT_FIT_UBOOT_ENTRYPOINT ?= "0x80000000"
UBOOT_FIT_UBOOT_LOADADDRESS ?= "0x80000000"
UBOOT_FIT_ARM_TRUSTED_FIRMWARE_LOADADDRESS ?= "0xb0000000"
UBOOT_FIT_ARM_TRUSTED_FIRMWARE_ENTRYPOINT ?= "0xb0000000"
UBOOT_FIT_TEE_LOADADDRESS ?= "0xb0080000"
UBOOT_FIT_TEE_ENTRYPOINT ?= "0xb0080000"

# kernel fitimage
# Use lzma compressed algorithm instead of gzip to save the code size.
FIT_KERNEL_COMP_ALG ?= "lzma"
FIT_KERNEL_COMP_ALG_EXTENSION ?= ".lzma"

FIT_ADDRESS_CELLS ?= "2"
UBOOT_ENTRYPOINT ?= "0x4 0x00000000"
UBOOT_LOADADDRESS ?= "0x4 0x00000000"

COMPATIBLE_MACHINE:aspeed-g7 = "aspeed-g7"
TFA_PLATFORM = "ast2700"

# optee for BL32.
TFA_SPD = "opteed"

# TFA default build is BL31.
TFA_BUILD_TARGET = "bl31"

# It is a shortcut for "make PLATFORM=aspeed PLATFORM_FLAVOR=ast2700"
OPTEEMACHINE = "aspeed-ast2700"

UBOOT_FIT_ARM_TRUSTED_FIRMWARE_IMAGE ?= "${DEPLOY_DIR_IMAGE}/${TFA_BUILD_TARGET}.bin"
UBOOT_FIT_TEE_IMAGE ?= "${DEPLOY_DIR_IMAGE}/optee/tee-raw.bin"

# bootmcu
PREFERRED_PROVIDER_virtual/bootmcu ?= "bootmcu-spl"
```

## meta-facebook/meta-catalina/meta-clemente/conf/machine/clemente.conf
```bitbake
require conf/machine/catalina.conf

OBMC_COMPATIBLE_NAMES = "com.meta.Hardware.BMC.Model.Clemente"
```

## meta-ibm/conf/machine/pstbmc.conf
```bitbake
MACHINEOVERRIDES =. "p10bmc:"

require conf/machine/include/ibm-enterprise.inc
require conf/machine/p10bmc.conf
require conf/distro/include/phosphor-no-ipmi-rmcp.inc
require conf/distro/include/phosphor-no-snmp.inc

DEBUG_TRIGGERS = "kcs2"
PACKAGECONFIG:append:pn-debug-trigger = " triggers"

IMAGE_FEATURES:remove = "obmc-host-ipmi"
```

## meta-intel-openbmc/meta-jncrp/conf/machine/jncrp.conf
```bitbake
KMACHINE = "aspeed"
# Device tree is under review
KERNEL_DEVICETREE = "aspeed/${KMACHINE}-bmc-intel-jncrp.dtb"

UBOOT_MACHINE = "evb-ast2600_defconfig"
UBOOT_DEVICETREE = "ast2600-evb"
SOCSEC_SIGN_ENABLE = "0"

FLASH_SIZE = "65536"

require conf/machine/include/ast2600.inc
require conf/machine/include/obmc-bsp-common.inc
require conf/machine/include/intel.inc

MACHINE_FEATURES:remove = " \
    obmc-phosphor-fan-mgmt \
    obmc-phosphor-flash-mgmt \
    "
```

## meta-nvidia/meta-vr-c2-obmc/conf/machine/vr-c2-obmc.conf
```bitbake
KMACHINE = "aspeed"
# Switch to the MGX Vera C2 kernel DTS once it lands upstream.
KERNEL_DEVICETREE = "aspeed/${KMACHINE}-ast2600-evb.dtb"

UBOOT_MACHINE = "ast2600_openbmc_spl_defconfig"
UBOOT_DEVICETREE = "ast2600-vr-bmc-nvidia"
SPL_BINARY = "spl/u-boot-spl.bin"

require conf/machine/include/ast2600.inc
require conf/machine/include/obmc-bsp-common.inc
require conf/distro/include/pldm.inc
require conf/machine/include/nvidia.inc

# Standard 64MB flash layout (openbmc-flash-layout-64).
FLASH_SIZE = "65536"
SOCSEC_SIGN_ENABLE = "0"

IMAGE_FEATURES:remove = " \
    obmc-chassis-mgmt \
    obmc-chassis-state-mgmt \
    obmc-fan-control \
    obmc-fan-mgmt \
    obmc-flash-mgmt \
    obmc-host-state-mgmt \
"
```
