## conf/machine/include/sample.inc
```bitbake
OBMC_MACHINE_FEATURES += "\
        obmc-phosphor-fan-mgmt \
        obmc-phosphor-chassis-mgmt \
        obmc-phosphor-sensor-mgmt \
        obmc-phosphor-flash-mgmt \
        "

VIRTUAL-RUNTIME_obmc-phosphor-fan-ctl = " \
       obmc-phosphor-qemu \
       "
VIRTUAL-RUNTIME_obmc-phosphor-sensor-ctl = " \
       obmc-phosphor-qemu \
       "
VIRTUAL-RUNTIME_obmc-phosphor-chassis-ctl = " \
       obmc-phosphor-qemu \
       "
VIRTUAL-RUNTIME_obmc-phosphor-flash-ctl = " \
       obmc-phosphor-qemu \
       "
```

## import-layers/meta-openembedded/meta-efl/conf/distro/include/efl-from-svn-recipes.inc
```bitbake
EFL_PREFERRED_VERSION ?= "1.7.4+svn%"
EFL_PREFERRED_PYTHON_VERSION ?= "1.7.0+svn%"

PREFERRED_VERSION_e-wm ?= "0.17.0+svnr%"

PREFERRED_VERSION_ecore ?= "${EFL_PREFERRED_VERSION}"
PREFERRED_VERSION_ecore-native ?= "${EFL_PREFERRED_VERSION}"
PREFERRED_VERSION_edbus ?= "${EFL_PREFERRED_VERSION}"
PREFERRED_VERSION_edbus-native ?= "${EFL_PREFERRED_VERSION}"
PREFERRED_VERSION_edje ?= "${EFL_PREFERRED_VERSION}"
PREFERRED_VERSION_edje-native ?= "${EFL_PREFERRED_VERSION}"
PREFERRED_VERSION_edje-nativesdk ?= "${EFL_PREFERRED_VERSION}"
PREFERRED_VERSION_eeze ?= "${EFL_PREFERRED_VERSION}"
PREFERRED_VERSION_eeze-native ?= "${EFL_PREFERRED_VERSION}"
PREFERRED_VERSION_efreet ?= "${EFL_PREFERRED_VERSION}"
PREFERRED_VERSION_efreet-native ?= "${EFL_PREFERRED_VERSION}"
PREFERRED_VERSION_eina ?= "${EFL_PREFERRED_VERSION}"
PREFERRED_VERSION_eina-native ?= "${EFL_PREFERRED_VERSION}"
PREFERRED_VERSION_embryo ?= "${EFL_PREFERRED_VERSION}"
PREFERRED_VERSION_embryo-native ?= "${EFL_PREFERRED_VERSION}"
PREFERRED_VERSION_evas ?= "${EFL_PREFERRED_VERSION}"
PREFERRED_VERSION_evas-generic-loaders ?= "${EFL_PREFERRED_VERSION}"
PREFERRED_VERSION_evas-native ?= "${EFL_PREFERRED_VERSION}"
PREFERRED_VERSION_expedite ?= "${EFL_PREFERRED_VERSION}"
PREFERRED_VERSION_expedite-native ?= "${EFL_PREFERRED_VERSION}"

PREFERRED_VERSION_eet ?= "${EFL_PREFERRED_VERSION}"
PREFERRED_VERSION_eet-native ?= "${EFL_PREFERRED_VERSION}"

PREFERRED_VERSION_eio ?= "${EFL_PREFERRED_VERSION}"
PREFERRED_VERSION_eio-native ?= "${EFL_PREFERRED_VERSION}"
PREFERRED_VERSION_emotion ?= "${EFL_PREFERRED_VERSION}"
PREFERRED_VERSION_ethumb ?= "${EFL_PREFERRED_VERSION}"
PREFERRED_VERSION_elementary ?= "${EFL_PREFERRED_VERSION}"

PREFERRED_VERSION_python-elementary ?= "${EFL_PREFERRED_PYTHON_VERSION}"
PREFERRED_VERSION_python-ecore ?= "${EFL_PREFERRED_PYTHON_VERSION}"
PREFERRED_VERSION_python-edbus ?= "${EFL_PREFERRED_PYTHON_VERSION}"
PREFERRED_VERSION_python-edje ?= "${EFL_PREFERRED_PYTHON_VERSION}"
PREFERRED_VERSION_python-emotion ?= "${EFL_PREFERRED_PYTHON_VERSION}"
PREFERRED_VERSION_python-evas ?= "${EFL_PREFERRED_PYTHON_VERSION}"

PREFERRED_VERSION_terminology ?= "0.2.0+svn%"
```

## import-layers/meta-openembedded/meta-efl/conf/layer.conf
```bitbake
# We have a conf and classes directory, append to BBPATH 
BBPATH .= ":${LAYERDIR}"

# We have a recipes directory, add to BBFILES
BBFILES += "${LAYERDIR}/recipes-*/*/*.bb ${LAYERDIR}/recipes-*/*/*.bbappend"

BBFILE_COLLECTIONS += "efl-layer"
BBFILE_PATTERN_efl-layer := "^${LAYERDIR}/"
BBFILE_PRIORITY_efl-layer = "7"

# This should only be incremented on significant changes that will
# cause compatibility issues with other layers
LAYERVERSION_efl-layer = "1"

LAYERDEPENDS_efl-layer = "core openembedded-layer"

E_MIRROR = "http://download.enlightenment.org/releases"
E_RELEASES = "http://download.enlightenment.org/rel"
E_SVN = "svn://svn.enlightenment.org/svn/e"

# RDEPENDS on update-alternatives provider opkg-utils
SIGGEN_EXCLUDE_SAFE_RECIPE_DEPS += "\
  exquisite-theme-illume->opkg-utils \
"

# RDEPENDS on e-wm
SIGGEN_EXCLUDE_SAFE_RECIPE_DEPS += "\
  e-wm-theme-illume-efenniht->e-wm \
  e-wm-theme-illume-neo->e-wm \
  e-wm-theme-b-and-w->e-wm \
"

SIGGEN_EXCLUDE_SAFE_RECIPE_DEPS += " \
  packagegroup-efl-sdk->packagegroup-core-sdk \
"
```

## import-layers/meta-openembedded/meta-gnome/conf/layer.conf
```bitbake
# We have a conf and classes directory, append to BBPATH
BBPATH .= ":${LAYERDIR}"

# We have a recipes directory, add to BBFILES
BBFILES += "${LAYERDIR}/recipes-*/*/*.bb ${LAYERDIR}/recipes-*/*/*.bbappend"

BBFILE_COLLECTIONS += "gnome-layer"
BBFILE_PATTERN_gnome-layer := "^${LAYERDIR}/"
BBFILE_PRIORITY_gnome-layer = "7"

# This should only be incremented on significant changes that will
# cause compatibility issues with other layers
LAYERVERSION_gnome-layer = "1"

LAYERDEPENDS_gnome-layer = "core openembedded-layer networking-layer"

AVAHI_GTK_pn-avahi-ui = "gtk gtk3"
```

## import-layers/meta-openembedded/meta-gpe/conf/layer.conf
```bitbake
# We have a conf and classes directory, append to BBPATH
BBPATH .= ":${LAYERDIR}"

# We have a recipes directory, add to BBFILES
BBFILES += "${LAYERDIR}/recipes-*/*/*.bb ${LAYERDIR}/recipes-*/*/*.bbappend"

BBFILE_COLLECTIONS += "gpe-layer"
BBFILE_PATTERN_gpe-layer := "^${LAYERDIR}/"
BBFILE_PRIORITY_gpe-layer = "7"

# This should only be incremented on significant changes that will
# cause compatibility issues with other layers
LAYERVERSION_gpe-layer = "1"

LAYERDEPENDS_gpe-layer = "core openembedded-layer"
```

## import-layers/meta-openembedded/meta-networking/conf/distro/include/meta_networking_security_flags.inc
```bitbake
# configure righteously complains:
# | configure:3479: using CFLAGS:  -O2 -pipe -g -feliminate-unused-debug-types -fstack-protector-strong -pie -fpie -D_FORTIFY_SOURCE=2
# | configure:3485: CFLAGS error: CFLAGS may only be used to specify C compiler flags, not macro definitions. Use CPPFLAGS for: -D_FORTIFY_SOURCE=2
# | configure:3516: error: Can not continue. Fix errors mentioned immediately above this line.

# Make sure it's at least empty in builds which don't include
# conf/distro/include/security_flags.inc
lcl_maybe_fortify ?= ""
TARGET_CFLAGS_remove_pn-c-ares = "${lcl_maybe_fortify}"
TARGET_CPPFLAGS_append_pn-c-ares = "${lcl_maybe_fortify}"
```

## import-layers/meta-openembedded/meta-networking/conf/layer.conf
```bitbake
# We have a conf and classes directory, add to BBPATH
BBPATH .= ":${LAYERDIR}"

# We have a packages directory, add to BBFILES
BBFILES += "${LAYERDIR}/recipes-*/*/*.bb \
            ${LAYERDIR}/recipes-*/*/*.bbappend"

BBFILE_COLLECTIONS += "networking-layer"
BBFILE_PATTERN_networking-layer := "^${LAYERDIR}/"
BBFILE_PRIORITY_networking-layer = "5"

# This should only be incremented on significant changes that will
# cause compatibility issues with other layers
LAYERVERSION_networking-layer = "1"

LAYERDEPENDS_networking-layer = "core"
LAYERDEPENDS_networking-layer += "openembedded-layer"
LAYERDEPENDS_networking-layer += "meta-python"

LICENSE_PATH += "${LAYERDIR}/licenses"

# Override security flags
require conf/distro/include/meta_networking_security_flags.inc

SIGGEN_EXCLUDE_SAFE_RECIPE_DEPS += " \
  wireguard-tools->wireguard-module \
"
```

## import-layers/meta-openembedded/meta-oe/conf/distro/include/meta_oe_security_flags.inc
```bitbake
# Build errors with the pie options enabled
SECURITY_CFLAGS_pn-libdbus-c++ = "${SECURITY_NO_PIE_CFLAGS}"
SECURITY_CFLAGS_pn-lvm2 = "${SECURITY_NO_PIE_CFLAGS}"
SECURITY_CFLAGS_pn-rrdtool = "${SECURITY_NO_PIE_CFLAGS}"

# This has text reloc errors with the pie options enabled
SECURITY_CFLAGS_pn-llvm3.3 = "${SECURITY_NO_PIE_CFLAGS}"
SECURITY_CFLAGS_pn-mozjs = "${SECURITY_NO_PIE_CFLAGS}"
SECURITY_CFLAGS_pn-openldap = "${SECURITY_NO_PIE_CFLAGS}"
SECURITY_CFLAGS_pn-s3c64xx-gpio = "${SECURITY_NO_PIE_CFLAGS}"
SECURITY_CFLAGS_pn-s3c24xx-gpio = "${SECURITY_NO_PIE_CFLAGS}"
SECURITY_CFLAGS_pn-cpufrequtils = "${SECURITY_NO_PIE_CFLAGS}"
SECURITY_CFLAGS_pn-libcec = "${SECURITY_NO_PIE_CFLAGS}"
SECURITY_CFLAGS_pn-libmodplug = "${SECURITY_NO_PIE_CFLAGS}"
SECURITY_CFLAGS_pn-libcdio = "${SECURITY_NO_PIE_CFLAGS}"

#| /mnt/b/build/tmp-glibc/sysroots/intel-corei7-64/usr/lib/libc_nonshared.a(elf-init.oS): In function `__libc_csu_init':
#| /usr/src/debug/glibc/2.24-r0/git/csu/elf-init.c:86: undefined reference to `__init_array_start'

SECURITY_CFLAGS_pn-libvdpau = "${SECURITY_NO_PIE_CFLAGS}"

#| /mnt/a/build/tmp-glibc/sysroots/x86_64-linux/usr/libexec/x86_64-oe-linux/gcc/x86_64-oe-linux/6.2.0/ld: lj_err_dyn.o: relocation R_X86_64_TPOFF32 against `static_uex' can not be used when making a shared object; recompile with -fPIC
#| /mnt/a/build/tmp-glibc/sysroots/x86_64-linux/usr/libexec/x86_64-oe-linux/gcc/x86_64-oe-linux/6.2.0/ld: final link failed: Nonrepresentable section on output
#| collect2: error: ld returned 1 exit status
#| make[1]: *** [Makefile:675: libluajit.so] Error 1
SECURITY_CFLAGS_pn-luajit = "${SECURITY_NO_PIE_CFLAGS}"
```

## import-layers/meta-openembedded/meta-oe/conf/layer.conf
```bitbake
# It really depends on order of the layers appearing in BBLAYERS
# variable in toplevel bblayers.conf file, where bitbake will search
# for .inc files and others where bitbake uses BBPATH since it will
# search the directories from first to last as specified in BBPATH
# Therefore if you want a given layer to be considered high priority
# for the .inc and .conf etc. then consider it adding at the beginning
# of BBPATH. For bblayers bitbake will use BBFILES_PRIORITY to resolve
# the recipe contention so the order of directories in BBFILES does 
# not matter.

# We have a conf and classes directory, append to BBPATH
BBPATH .= ":${LAYERDIR}"

# We have a recipes directory, add to BBFILES
BBFILES += "${LAYERDIR}/recipes-*/*/*.bb ${LAYERDIR}/recipes-*/*/*.bbappend"

BBFILE_COLLECTIONS += "openembedded-layer"
BBFILE_PATTERN_openembedded-layer := "^${LAYERDIR}/"

# Define the priority for recipes (.bb files) from this layer,
# choosing carefully how this layer interacts with all of the
# other layers.

BBFILE_PRIORITY_openembedded-layer = "6"

# This should only be incremented on significant changes that will
# cause compatibility issues with other layers
LAYERVERSION_openembedded-layer = "1"

LAYERDEPENDS_openembedded-layer = "core"

LICENSE_PATH += "${LAYERDIR}/licenses"

SIGGEN_EXCLUDERECIPES_ABISAFE += " \
  mplayer-common \
  fbset-modes \
  gpsd-machine-conf \
  distro-feed-configs \
  ca-certificates \
  pointercal \
"

SIGGEN_EXCLUDE_SAFE_RECIPE_DEPS += " \
  android-tools->android-tools-conf \
  usb-modeswitch-data->usb-modeswitch \
  lmsensors->lmsensors-config \
  phoronix-test-suite->bash \
  phoronix-test-suite->python \
  phoronix-test-suite->php \
"

# ttf.inc inherits fontcache which adds fontconfig-utils to RDEPENDS
SIGGEN_EXCLUDE_SAFE_RECIPE_DEPS += " \
  terminus-font->fontconfig \
  ttf-abyssinica->fontconfig \
  ttf-arphic-uming->fontconfig \
  ttf-dejavu->fontconfig \
  ttf-droid->fontconfig \
  ttf-gentium->fontconfig \
  ttf-hunkyfonts->fontconfig \
  ttf-inconsolata->fontconfig \
  ttf-liberation->fontconfig \
  ttf-liberation-sans-narrow->fontconfig \
  ttf-lklug->fontconfig \
  ttf-lohit->fontconfig \
  ttf-pt-sans->fontconfig \
  ttf-mplus->fontconfig \
  ttf-sazanami->fontconfig \
  ttf-tlwg->fontconfig \
  ttf-ubuntu-font-family->fontconfig \
  ttf-vlgothic->fontconfig \
  ttf-wqy-zenhei->fontconfig \
  source-han-sans-cn-fonts->fontconfig \
  source-han-sans-jp-fonts->fontconfig \
  source-han-sans-kr-fonts->fontconfig \
  source-han-sans-tw-fonts->fontconfig \
"
```

## import-layers/meta-openembedded/meta-python/conf/layer.conf
```bitbake
# We might have a conf and classes directory, append to BBPATH
BBPATH .= ":${LAYERDIR}"

# We have recipes directories, add to BBFILES
BBFILES += "${LAYERDIR}/recipes*/*/*.bb ${LAYERDIR}/recipes*/*/*.bbappend"

BBFILE_COLLECTIONS += "meta-python"
BBFILE_PATTERN_meta-python := "^${LAYERDIR}/"
BBFILE_PRIORITY_meta-python = "7"

# This should only be incremented on significant changes that will
# cause compatibility issues with other layers
LAYERVERSION_meta-python = "1"

LAYERDEPENDS_meta-python = "core openembedded-layer"

LAYERSERIES_COMPAT_meta-python = "sumo"

LICENSE_PATH += "${LAYERDIR}/licenses"
```

## import-layers/meta-openembedded/meta-ruby/conf/layer.conf
```bitbake
# We have a conf and classes directory, append to BBPATH 
BBPATH .= ":${LAYERDIR}"

# We have a recipes directory, add to BBFILES
BBFILES += "${LAYERDIR}/recipes-*/*/*.bb ${LAYERDIR}/recipes-*/*/*.bbappend"

BBFILE_COLLECTIONS += "ruby-layer"
BBFILE_PATTERN_ruby-layer := "^${LAYERDIR}/"
BBFILE_PRIORITY_ruby-layer = "7"

# This should only be incremented on significant changes that will
# cause compatibility issues with other layers
LAYERVERSION_ruby-layer = "1"

LAYERDEPENDS_ruby-layer = "core openembedded-layer"
```

## import-layers/meta-openembedded/meta-systemd/conf/layer.conf
```bitbake
# It really depends on order of the layers appearing in BBLAYERS
# variable in toplevel bblayers.conf file, where bitbake will search
# for .inc files and others where bitbake uses BBPATH since it will
# search the directories from first to last as specified in BBPATH
# Therefore if you want a given layer to be considered high priority
# for the .inc and .conf etc. then consider it adding at the beginning
# of BBPATH. For bblayers bitbake will use BBFILES_PRIORITY to resolve
# the recipe contention so the order of directories in BBFILES does 
# not matter.

# We have a conf and classes directory, append to BBPATH
BBPATH .= ":${LAYERDIR}"

# We have a recipes directory, add to BBFILES
BBFILES += "\
  ${LAYERDIR}/recipes-*/*/*.bb \
  ${LAYERDIR}/oe-core/recipes-*/*/*.bbappend \
"

BBFILE_COLLECTIONS += "systemd-layer"
BBFILE_PATTERN_systemd-layer := "^${LAYERDIR}/"

# Define the priority for recipes (.bb files) from this layer,
# choosing carefully how this layer interacts with all of the
# other layers.

BBFILE_PRIORITY_systemd-layer = "7"

SIGGEN_EXCLUDERECIPES_ABISAFE += " \
  systemd-serialgetty \
"
LAYERDEPENDS_systemd-layer = "core"
```

## import-layers/meta-openembedded/meta-xfce/conf/layer.conf
```bitbake
# We have a conf and classes directory, append to BBPATH
BBPATH .= ":${LAYERDIR}"

# We have a recipes directory, add to BBFILES
BBFILES += "${LAYERDIR}/recipes-*/*/*.bb ${LAYERDIR}/recipes-*/*/*.bbappend"

BBFILE_COLLECTIONS += "xfce-layer"
BBFILE_PATTERN_xfce-layer := "^${LAYERDIR}/"
BBFILE_PRIORITY_xfce-layer = "7"

# This should only be incremented on significant changes that will
# cause compatibility issues with other layers
LAYERVERSION_xfce-layer = "1"

LAYERDEPENDS_xfce-layer = "core"
LAYERDEPENDS_xfce-layer += "openembedded-layer"
LAYERDEPENDS_xfce-layer += "gnome-layer"
LAYERDEPENDS_xfce-layer += "openembedded-layer"
LAYERDEPENDS_xfce-layer += "meta-python"

SIGGEN_EXCLUDE_SAFE_RECIPE_DEPS += " \
  xfce4-session->machine-host \
"
```

## import-layers/meta-raspberrypi/conf/layer.conf
```bitbake
# We have a conf and classes directory, append to BBPATH
BBPATH .= ":${LAYERDIR}"

# We have a recipes directory containing .bb and .bbappend files, add to BBFILES
BBFILES += "${LAYERDIR}/recipes*/*/*.bb \
            ${LAYERDIR}/recipes*/*/*.bbappend"

BBFILE_COLLECTIONS += "raspberrypi"
BBFILE_PATTERN_raspberrypi := "^${LAYERDIR}/"
BBFILE_PRIORITY_raspberrypi = "9"

# Additional license directories.
LICENSE_PATH += "${LAYERDIR}/files/custom-licenses"
```
