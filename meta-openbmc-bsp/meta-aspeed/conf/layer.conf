## meta-openbmc-bsp/meta-nuvoton/meta-npcm7xx/conf/machine/evb-npcm750.conf
```bitbake
KMACHINE = "nuvoton"
KERNEL_DEVICETREE = "${KMACHINE}-npcm750-evb.dtb"

UBOOT_MACHINE = "PolegSVB_config"

FLASH_SIZE = "32768"

require conf/machine/include/npcm7xx.inc
require conf/machine/include/obmc-bsp-common.inc
```

## meta-openbmc-bsp/meta-nuvoton/meta-npcm7xx/conf/machine/include/tune-arm7a-novfp.inc
```bitbake
DEFAULTTUNE ?= "arm7a-novfp"

require conf/machine/include/arm/arch-armv7a.inc

TUNEVALID[arm7a-novfp] = "Enable arm7a-novfp specific processor optimizations"

AVAILTUNES += "arm7a-novfp"
ARMPKGARCH_tune-arm7a-novfp = "armv7a"
TUNE_FEATURES_tune-armv7a = "arm armv7a"
TUNE_FEATURES_tune-arm7a-novfp = "${TUNE_FEATURES_tune-armv7a} arm7a-novfp"
PACKAGE_EXTRA_ARCHS_tune-arm7a-novfp = "${PACKAGE_EXTRA_ARCHS_tune-armv7a}"
```

## meta-openbmc-bsp/meta-nuvoton/recipes-kernel/linux/linux-nuvoton/defconfig
```kconfig
CONFIG_SYSVIPC=y
CONFIG_BSD_PROCESS_ACCT=y
CONFIG_LOG_BUF_SHIFT=21
CONFIG_CGROUPS=y
CONFIG_SYSFS_DEPRECATED=y
CONFIG_SYSFS_DEPRECATED_V2=y
CONFIG_BLK_DEV_INITRD=y
CONFIG_KERNEL_XZ=y
CONFIG_SYSCTL_SYSCALL=y
CONFIG_EMBEDDED=y
CONFIG_SLAB=y
CONFIG_MODULES=y
CONFIG_MODULE_UNLOAD=y
CONFIG_MODVERSIONS=y
CONFIG_PARTITION_ADVANCED=y
CONFIG_DEFAULT_DEADLINE=y
CONFIG_ARCH_NPCM=y
CONFIG_ARCH_NPCM7XX=y
CONFIG_SMP=y
CONFIG_AEABI=y
CONFIG_ZBOOT_ROM_BSS=0x0
CONFIG_BINFMT_MISC=y
CONFIG_NET=y
CONFIG_PACKET=y
CONFIG_UNIX=y
CONFIG_INET=y
CONFIG_IP_PNP=y
CONFIG_IP_PNP_DHCP=y
CONFIG_IP_PNP_BOOTP=y
CONFIG_UEVENT_HELPER_PATH="/sbin/hotplug"
CONFIG_DEVTMPFS=y
CONFIG_MTD=y
CONFIG_MTD_BLOCK=y
CONFIG_MTD_RAM=y
CONFIG_MTD_COMPLEX_MAPPINGS=y
CONFIG_MTD_SPI_NOR=y
CONFIG_SPI_NPCM=y
CONFIG_OF_OVERLAY=y
CONFIG_BLK_DEV_LOOP=y
CONFIG_BLK_DEV_NBD=y
CONFIG_BLK_DEV_RAM=y
CONFIG_BLK_DEV_RAM_COUNT=1
CONFIG_BLK_DEV_RAM_SIZE=8192
CONFIG_SCSI=y
CONFIG_BLK_DEV_SD=y
CONFIG_NETDEVICES=y
CONFIG_NPCM7XX_EMC_ETH=y
CONFIG_STMMAC_ETH=y
CONFIG_BROADCOM_PHY=y
CONFIG_SERIAL_8250=y
CONFIG_SERIAL_8250_CONSOLE=y
CONFIG_SERIAL_OF_PLATFORM=y
CONFIG_NPCM750_OTP=y
CONFIG_NPCM750_OTP_WRITE_ENABLE=y
CONFIG_NPCM7XX_KCS_IPMI_BMC=y
CONFIG_HW_RANDOM=y
CONFIG_I2C=y
CONFIG_I2C_CHARDEV=y
CONFIG_I2C_NPCM7XX=y
CONFIG_GPIO_SYSFS=y
CONFIG_GPIO_GENERIC_PLATFORM=y
CONFIG_SENSORS_LM75=y
CONFIG_SENSORS_TMP102=y
CONFIG_SENSORS_NPCM7XX=y
CONFIG_WATCHDOG=y
CONFIG_USB_HIDDEV=y
CONFIG_USB_ANNOUNCE_NEW_DEVICES=y
CONFIG_USB_STORAGE=y
CONFIG_USB_CHIPIDEA=y
CONFIG_USB_CHIPIDEA_UDC=y
CONFIG_USB_GADGET=y
CONFIG_USB_GADGET_NPCMX50_USB2=y
CONFIG_USB_EHCI_ROOT_HUB_TT=y
CONFIG_USB_ARCH_HAS_HCD=y
CONFIG_USB_ARCH_HAS_EHCI=y
CONFIG_USB_EHCI_HCD=y
CONFIG_USB_ARCH_HAS_OHCI=y
CONFIG_USB_OHCI_HCD=y
CONFIG_USB=y
#CONFIG_USB_MASS_STORAGE=m
#CONFIG_USB_EDM_KBD_MOUSE=m
CONFIG_MMC=y
CONFIG_MMC_SDHCI=y
CONFIG_MMC_SDHCI_NPCM750=y
CONFIG_IIO=y
CONFIG_NPCM7XX_ADC=y
CONFIG_MSDOS_FS=y
CONFIG_VFAT_FS=y
CONFIG_TMPFS=y
CONFIG_ROMFS_FS=y
CONFIG_NFS_FS=y
CONFIG_ROOT_NFS=y
CONFIG_CIFS=y
CONFIG_CIFS_XATTR=y
CONFIG_NLS_CODEPAGE_437=y
CONFIG_NLS_ASCII=y
CONFIG_NLS_ISO8859_1=y
CONFIG_DYNAMIC_DEBUG=y
CONFIG_DEBUG_INFO=y
CONFIG_DEBUG_INFO_REDUCED=y
CONFIG_READABLE_ASM=y
CONFIG_DEBUG_SECTION_MISMATCH=y
CONFIG_MAGIC_SYSRQ=y
CONFIG_FUNCTION_TRACER=y
CONFIG_EARLY_PRINTK=y
CONFIG_CRYPTO_CBC=y
CONFIG_CRYPTO_CTR=y
CONFIG_CRYPTO_CMAC=y
CONFIG_CRYPTO_CRC32C=y
CONFIG_CRYPTO_DEFLATE=y
CONFIG_CRYPTO_LZO=y
CONFIG_CRYPTO_USER_API_SKCIPHER=y
CONFIG_CRYPTO_DEV_NPCMX50=y
CONFIG_ARM_CRYPTO=y
```

## meta-openbmc-machines/meta-arm/meta-qualcomm/meta-centriq2400-rep/conf/bblayers.conf.sample
```bitbake
# LAYER_CONF_VERSION is increased each time build/conf/bblayers.conf
# changes incompatibly
LCONF_VERSION = "6"

BBPATH = "${TOPDIR}"
BBFILES ?= ""

BBLAYERS ?= " \
  ##OEROOT##/meta \
  ##OEROOT##/meta-poky \
  ##OEROOT##/import-layers/meta-openembedded/meta-oe \
  ##OEROOT##/import-layers/meta-openembedded/meta-networking \
  ##OEROOT##/import-layers/meta-openembedded/meta-perl \
  ##OEROOT##/import-layers/meta-openembedded/meta-python \
  ##OEROOT##/import-layers/meta-virtualization \
  ##OEROOT##/meta-phosphor \
  ##OEROOT##/meta-openbmc-bsp/meta-aspeed \
  ##OEROOT##/meta-openbmc-bsp/meta-aspeed/meta-ast2500 \
  ##OEROOT##/meta-openbmc-machines/meta-arm \
  ##OEROOT##/meta-openbmc-machines/meta-arm/meta-qualcomm \
  ##OEROOT##/meta-openbmc-machines/meta-arm/meta-qualcomm/meta-centriq2400-rep \
  "
BBLAYERS_NON_REMOVABLE ?= " \
  ##OEROOT##/meta \
  ##OEROOT##/meta-poky \
  ##OEROOT##/import-layers/meta-openembedded/meta-oe \
  ##OEROOT##/import-layers/meta-openembedded/meta-networking \
  ##OEROOT##/import-layers/meta-openembedded/meta-perl \
  ##OEROOT##/import-layers/meta-openembedded/meta-python \
  ##OEROOT##/import-layers/meta-virtualization \
  ##OEROOT##/meta-phosphor \
  ##OEROOT##/meta-openbmc-bsp/meta-aspeed \
  ##OEROOT##/meta-openbmc-bsp/meta-aspeed/meta-ast2500 \
  ##OEROOT##/meta-openbmc-machines/meta-arm \
  ##OEROOT##/meta-openbmc-machines/meta-arm/meta-qualcomm \
  ##OEROOT##/meta-openbmc-machines/meta-arm/meta-qualcomm/meta-centriq2400-rep \
  "
```

## meta-openbmc-machines/meta-arm/meta-qualcomm/meta-centriq2400-rep/conf/machine/centriq2400-rep.conf
```bitbake
KMACHINE = "aspeed"
KERNEL_DEVICETREE = "${KMACHINE}-ast2500-evb.dtb"

UBOOT_MACHINE = "ast_g5_ncsi_config"

FLASH_SIZE = "32768"


PREFERRED_PROVIDER_virtual/phosphor-ipmi-fru-hostfw-config= ""
require conf/machine/include/ast2500.inc
require conf/machine/include/obmc-bsp-common.inc
require conf/machine/include/qualcomm.inc

IMAGE_INSTALL_append = " ir38163-workaround \
                         centriq-2400rep-console-client \
                         socupdate \
"
```

## meta-openbmc-machines/meta-evb/conf/layer.conf
```bitbake
# We have a conf and classes directory, add to BBPATH
BBPATH .= ":${LAYERDIR}"

BBFILE_COLLECTIONS += "evb"
BBFILE_PATTERN_evb = ""
```

## meta-openbmc-machines/meta-evb/meta-evb-aspeed/conf/layer.conf
```bitbake
# We have a conf and classes directory, add to BBPATH
BBPATH .= ":${LAYERDIR}"

BBFILE_COLLECTIONS += "evb-aspeed"
BBFILE_PATTERN_evb-aspeed = ""
```

## meta-openbmc-machines/meta-evb/meta-evb-aspeed/meta-evb-ast2500/conf/bblayers.conf.sample
```bitbake
# LAYER_CONF_VERSION is increased each time build/conf/bblayers.conf
# changes incompatibly
LCONF_VERSION = "6"

BBPATH = "${TOPDIR}"
BBFILES ?= ""

BBLAYERS ?= " \
  ##OEROOT##/meta \
  ##OEROOT##/meta-yocto \
  ##OEROOT##/meta-phosphor \
  ##OEROOT##/meta-openbmc-bsp/meta-aspeed \
  ##OEROOT##/meta-openbmc-bsp/meta-aspeed/meta-ast2500 \
  ##OEROOT##/meta-openbmc-machines/meta-evb \
  ##OEROOT##/meta-openbmc-machines/meta-evb/meta-evb-aspeed \
  ##OEROOT##/meta-openbmc-machines/meta-evb/meta-evb-aspeed/meta-evb-ast2500 \
  "
BBLAYERS_NON_REMOVABLE ?= " \
  ##OEROOT##/meta \
  ##OEROOT##/meta-yocto \
  ##OEROOT##/meta-phosphor \
  ##OEROOT##/meta-openbmc-bsp/meta-aspeed \
  ##OEROOT##/meta-openbmc-bsp/meta-aspeed/meta-ast2500 \
  ##OEROOT##/meta-openbmc-machines/meta-evb \
  ##OEROOT##/meta-openbmc-machines/meta-evb/meta-evb-aspeed \
  ##OEROOT##/meta-openbmc-machines/meta-evb/meta-evb-aspeed/meta-evb-ast2500 \
  "
```

## meta-openbmc-machines/meta-evb/meta-evb-aspeed/meta-evb-ast2500/conf/distro/include/openbmc-phosphor/evb-ast2500.inc
```bitbake
OBMC_MACHINE_FEATURES += "\
	obmc-phosphor-fan-mgmt \
	obmc-phosphor-chassis-mgmt \
	obmc-phosphor-sensor-mgmt \
	obmc-phosphor-flash-mgmt \
	obmc-host-ipmi \
	"
```

## meta-openbmc-machines/meta-evb/meta-evb-aspeed/meta-evb-ast2500/conf/machine/ast2500-evb.conf
```bitbake
KMACHINE = "aspeed"
KERNEL_DEVICETREE = "${KMACHINE}-ast2500-evb.dtb"

require conf/machine/include/ast2500.inc
require conf/machine/include/obmc-bsp-common.inc
require conf/machine/include/sample.inc
```
