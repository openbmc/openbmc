## meta-ufispace/meta-ncplite/conf/machine/ncplite.conf
```bitbake
KMACHINE = "aspeed"
KERNEL_DEVICETREE = "aspeed/${KMACHINE}-bmc-ufispace-${MACHINE}.dtb"

require conf/machine/include/ast2600.inc
require conf/machine/include/obmc-bsp-common.inc
require conf/machine/include/ufispace.inc

UBOOT_MACHINE = "ast2600_openbmc_spl_defconfig"
#UBOOT_DEVICETREE = "ast2600-${MACHINE}"
UBOOT_DEVICETREE = "ast2600-evb"
SPL_BINARY = "spl/u-boot-spl.bin"

SERIAL_CONSOLES = "115200;ttyS4"
SOCSEC_SIGN_ENABLE = "0"
FLASH_SIZE = "65536"

VIRTUAL-RUNTIME_obmc-sensors-hwmon = "dbus-sensors"

PREFERRED_PROVIDER_virtual/phosphor-led-manager-config-native = "ncplite-led-manager-config-native"

IMAGE_FEATURES:remove = "obmc-fan-control"
```

## meta-wistron/conf/layer.conf
```bitbake
# We have a conf and classes directory, add to BBPATH
BBPATH .= ":${LAYERDIR}"

# We have recipes-* directories, add to BBFILES
BBFILES += "${LAYERDIR}/recipes-*/*/*.bb \
            ${LAYERDIR}/recipes-*/*/*.bbappend"

BBFILE_COLLECTIONS += "wistron-layer"
BBFILE_PATTERN_wistron-layer := "^${LAYERDIR}/"
LAYERSERIES_COMPAT_wistron-layer = "scarthgap styhead"
```

## meta-wistron/conf/machine/include/wistron.inc
```bitbake
DISTROOVERRIDES .= ":wistron"

MACHINE_FEATURES += "\
        obmc-bmc-state-mgmt \
        obmc-phosphor-fan-mgmt \
        obmc-phosphor-flash-mgmt \
        "

VIRTUAL-RUNTIME_skeleton_workbook = "${MACHINE}-config"

PREFERRED_PROVIDER_virtual/obmc-chassis-mgmt = "packagegroup-wistron-apps"
PREFERRED_PROVIDER_virtual/obmc-fan-mgmt = "packagegroup-wistron-apps"
PREFERRED_PROVIDER_virtual/obmc-flash-mgmt = "packagegroup-wistron-apps"
PREFERRED_PROVIDER_virtual/obmc-inventory-data ?= "${VIRTUAL-RUNTIME_skeleton_workbook}"
PREFERRED_PROVIDER_virtual/obmc-system-mgmt = "packagegroup-wistron-apps"

IMAGE_FEATURES:remove = "obmc-ikvm"

SERIAL_CONSOLES:wistron = "115200;ttyS4"
```

## meta-wistron/meta-lannister/conf/layer.conf
```bitbake
# We have a conf and classes directory, add to BBPATH
BBPATH .= ":${LAYERDIR}"

# We have recipes-* directories, add to BBFILES
BBFILES += "${LAYERDIR}/recipes-*/*/*.bb \
            ${LAYERDIR}/recipes-*/*/*.bbappend"

BBFILE_COLLECTIONS += "lannister"
BBFILE_PATTERN_lannister = "^${LAYERDIR}/"
LAYERSERIES_COMPAT_lannister = "scarthgap styhead"
```

## meta-wistron/meta-lannister/conf/machine/lannister.conf
```bitbake
KMACHINE = "aspeed"
KERNEL_DEVICETREE = "${KMACHINE}-bmc-wistron-${MACHINE}.dtb"

require conf/machine/include/wistron.inc
require conf/machine/include/ast2600.inc
require conf/machine/include/obmc-bsp-common.inc

UBOOT_MACHINE = "ast2600_openbmc_defconfig"
UBOOT_DEVICETREE = "ast2600-intel"
SPL_BINARY = "spl/u-boot-spl.bin"
SOCSEC_SIGN_ENABLE = "0"

SERIAL_CONSOLES = "115200;ttyS4"

FLASH_SIZE = "65536"

OBMC_MACHINE_FEATURES += "\
        obmc-chassis-state-mgmt \
        obmc-host-state-mgmt \
        "
VIRTUAL-RUNTIME_obmc-host-state-manager ?= "x86-power-control"
VIRTUAL-RUNTIME_obmc-chassis-state-manager ?= "x86-power-control"
```

## meta-x86/conf/layer.conf
```bitbake
# We have a conf and classes directory, add to BBPATH
BBPATH .= ":${LAYERDIR}"

BBFILE_COLLECTIONS += "obmc_machines_x86"
BBFILE_PATTERN_obmc_machines_x86 = ""
LAYERSERIES_COMPAT_obmc_machines_x86 = "dunfell gatesgarth"
```

## meta-xilinx/meta-microblaze/conf/layer.conf
```bitbake
# We have a conf and classes directory, add to BBPATH
BBPATH .= ":${LAYERDIR}"

# We have a packages directory, add to BBFILES
BBFILES += "${LAYERDIR}/recipes-*/*/*.bb"
BBFILES += "${LAYERDIR}/recipes-*/*/*.bbappend"

BBFILE_COLLECTIONS += "xilinx-microblaze"
BBFILE_PATTERN_xilinx-microblaze = "^${LAYERDIR}/"
BBFILE_PRIORITY_xilinx-microblaze = "5"

LAYERDEPENDS_xilinx-microblaze = "core"

LAYERSERIES_COMPAT_xilinx-microblaze = "dunfell gatesgarth"

# Until we've moved to a newer version, we need to stick on 9.2
GDBVERSION_microblaze = "9.2"
```

## meta-xilinx/meta-xilinx-bsp/conf/bblayers.conf.sample
```bitbake
LCONF_VERSION = "7"

BBPATH = "${TOPDIR}"
BBFILES ?= ""

BBLAYERS ?= " \
    ##OEROOT##/meta \
    ##OEROOT##/meta-poky \
    ##OEROOT##/../meta-openembedded/meta-perl \
    ##OEROOT##/../meta-openembedded/meta-python \
    ##OEROOT##/../meta-openembedded/meta-filesystems \
    ##OEROOT##/../meta-openembedded/meta-gnome \
    ##OEROOT##/../meta-openembedded/meta-multimedia \
    ##OEROOT##/../meta-openembedded/meta-networking \
    ##OEROOT##/../meta-openembedded/meta-webserver \
    ##OEROOT##/../meta-openembedded/meta-xfce \
    ##OEROOT##/../meta-openembedded/meta-initramfs \
    ##OEROOT##/../meta-openembedded/meta-oe \
    ##OEROOT##/../meta-browser \
    ##OEROOT##/../meta-qt5 \
    ##OEROOT##/../meta-xilinx/meta-xilinx-bsp \
    ##OEROOT##/../meta-xilinx/meta-xilinx-pynq \
    ##OEROOT##/../meta-xilinx/meta-xilinx-standalone \
    ##OEROOT##/../meta-xilinx/meta-xilinx-contrib \
    ##OEROOT##/../meta-xilinx-tools \
    ##OEROOT##/../meta-petalinux \
    ##OEROOT##/../meta-virtualization \
    ##OEROOT##/../meta-openamp \
    ##OEROOT##/../meta-jupyter \
    ##OEROOT##/../meta-python2 \
"

BBLAYERS_NON_REMOVABLE ?= " \
    ##OEROOT##/meta \
"
```

## meta-xilinx/meta-xilinx-bsp/conf/layer.conf
```bitbake
# We have a conf and classes directory, add to BBPATH
BBPATH .= ":${LAYERDIR}"

# We have a packages directory, add to BBFILES
BBFILES += "${LAYERDIR}/recipes-*/*/*.bb"
BBFILES += "${LAYERDIR}/recipes-*/*/*.bbappend"

BBFILE_COLLECTIONS += "xilinx"
BBFILE_PATTERN_xilinx = "^${LAYERDIR}/"
BBFILE_PRIORITY_xilinx = "5"

LAYERDEPENDS_xilinx = "core"

LAYERSERIES_COMPAT_xilinx = "dunfell gatesgarth"

BB_DANGLINGAPPENDS_WARNONLY ?= "1"

XILINX_RELEASE_VERSION = "v2020.2"
```

## meta-xilinx/meta-xilinx-bsp/conf/machine/aarch32-tc.conf
```bitbake
require conf/multilib.conf
require conf/machine/include/tune-cortexa9.inc
require conf/machine/include/baremetal-tc.conf

# Define all of the multilibs supproted by this configuration
MULTILIB_GLOBAL_VARIANTS = "${@extend_variants(d,'MULTILIBS','multilib')}"

MULTILIBS  = "multilib:libarmv5tesoftfp multilib:libarmv5tehard"
MULTILIBS += "multilib:libnofp"
MULTILIBS += "multilib:libv7nofp multilib:libv7fpsoftfp multilib:libv7fphard"
MULTILIBS += "multilib:libv7anofp"
MULTILIBS += "multilib:libv7afpsoftfp"
MULTILIBS += "multilib:libv7afpthf multilib:libv7asimdsoftfp"
MULTILIBS += "multilib:libv7asimdhard multilib:libv7vesimdsoftfp"
MULTILIBS += "multilib:libvtvesimdhf"
MULTILIBS += "multilib:libv8anofp"
MULTILIBS += "multilib:libv8asimdsoftfp multilib:libv8asimdhard"

TUNE_CCARGS = "${TUNE_CCARGS_tune-${DEFAULTTUNE}}"
TUNE_PKGARCH = "${TUNE_PKGARCH_tune-${DEFAULTTUNE}}"

# Base configuration
# CFLAGS:
DEFAULTTUNE = "aarch32"

AVAILTUNES += "aarch32"
PACKAGE_EXTRA_ARCHS_tune-aarch32 = "${TUNE_PKGARCH_tune-aarch32}"
BASE_LIB_tune-aarch32 = "lib"
TUNE_FEATURES_tune-aarch32 = "arm"
TUNE_CCARGS_tune-aarch32 = ""
TUNE_PKGARCH_tune-aarch32 = "aarch32"


# arm/v5te/softfp
# CFLAGS: -marm -march=armv5te+fp -mfloat-abi=softfp
DEFAULTTUNE_virtclass-multilib-libarmv5tesoftfp = "armv5tesoftfp"

AVAILTUNES += "armv5tesoftfp"
PACKAGE_EXTRA_ARCHS_tune-armv5tesoftfp = "${TUNE_PKGARCH_tune-armv5tesoftfp}"
BASE_LIB_tune-armv5tesoftfp = "lib/arm/v5te/softfp"
TUNE_FEATURES_tune-armv5tesoftfp = "arm"
TUNE_CCARGS_tune-armv5tesoftfp = "-marm -march=armv5te+fp -mfloat-abi=softfp"
TUNE_PKGARCH_tune-armv5tesoftfp = "armv5tefp"


# arm/v5te/hard
# CFLAGS: -marm -march=armv5te+fp -mfloat-abi=hard
DEFAULTTUNE_virtclass-multilib-libarmv5tehard = "armv5tehard"

AVAILTUNES += "armv5tehard"
PACKAGE_EXTRA_ARCHS_tune-armv5tehard = "${TUNE_PKGARCH_tune-armv5tehard}"
BASE_LIB_tune-armv5tehard = "lib/arm/v5te/hard"
TUNE_FEATURES_tune-armv5tehard = "arm"
TUNE_CCARGS_tune-armv5tehard = "-marm -march=armv5te+fp -mfloat-abi=hard"
TUNE_PKGARCH_tune-armv5tehard = "armv5tefphf"


# thumb/nofp
# CFLAGS: -mthumb -mfloat-abi=soft
DEFAULTTUNE_virtclass-multilib-libnofp = "armnofp"

AVAILTUNES += "armnofp"
PACKAGE_EXTRA_ARCHS_tune-armnofp = "${TUNE_PKGARCH_tune-armnofp}"
BASE_LIB_tune-armnofp = "lib/thumb/nofp"
TUNE_FEATURES_tune-armnofp = "arm"
TUNE_CCARGS_tune-armnofp = "-mthumb -mfloat-abi=soft"
TUNE_PKGARCH_tune-armnofp = "armt"


# thumb/v7/nofp
# CFLAGS: -mthumb -march=armv7 -mfloat-abi=soft
DEFAULTTUNE_virtclass-multilib-libv7nofp = "armv7nofp"

AVAILTUNES += "armv7nofp"
PACKAGE_EXTRA_ARCHS_tune-armv7nofp = "${TUNE_PKGARCH_tune-armv7nofp}"
BASE_LIB_tune-armv7nofp = "lib/thumb/v7/nofp"
TUNE_FEATURES_tune-armv7nofp = "arm"
TUNE_CCARGS_tune-armv7nofp = "-mthumb -march=armv7 -mfloat-abi=soft"
TUNE_PKGARCH_tune-armv7nofp = "armv7t"


# thumb/v7+fp/softfp
# CFLAGS: -mthumb -march=armv7+fp -mfloat-abi=softfp
DEFAULTTUNE_virtclass-multilib-libv7fpsoftfp = "armv7fpsoftfp"

AVAILTUNES += "armv7fpsoftfp"
PACKAGE_EXTRA_ARCHS_tune-armv7fpsoftfp = "${TUNE_PKGARCH_tune-armv7fpsoftfp}"
BASE_LIB_tune-armv7fpsoftfp = "lib/thumb/v7+fp/softfp"
TUNE_FEATURES_tune-armv7fpsoftfp = "arm"
TUNE_CCARGS_tune-armv7fpsoftfp = "-mthumb -march=armv7+fp -mfloat-abi=softfp"
TUNE_PKGARCH_tune-armv7fpsoftfp = "armv7fpt"


# thumb/v7+fp/hard
# CFLAGS: -mthumb -march=armv7+fp -mfloat-abi=hard
DEFAULTTUNE_virtclass-multilib-libv7fphard = "armv7fphard"

AVAILTUNES += "armv7fphard"
PACKAGE_EXTRA_ARCHS_tune-armv7fphard = "${TUNE_PKGARCH_tune-armv7fphard}"
BASE_LIB_tune-armv7fphard = "lib/thumb/v7+fp/hard"
TUNE_FEATURES_tune-armv7fphard = "arm"
TUNE_CCARGS_tune-armv7fphard = "-mthumb -march=armv7+fp -mfloat-abi=hard"
TUNE_PKGARCH_tune-armv7fphard = "armv7fpthf"


# thumb/v7-a/nofp
# CFLAGS: -mthumb -march=armv7-a -mfloat-abi=soft
DEFAULTTUNE_virtclass-multilib-libv7anofp = "armv7anofp"

AVAILTUNES += "armv7anofp"
PACKAGE_EXTRA_ARCHS_tune-armv7anofp = "${TUNE_PKGARCH_tune-armv7anofp}"
BASE_LIB_tune-armv7anofp = "lib/thumb/v7-a/nofp"
TUNE_FEATURES_tune-armv7anofp = "arm"
TUNE_CCARGS_tune-armv7anofp = "-mthumb -march=armv7-a -mfloat-abi=soft"
TUNE_PKGARCH_tune-armv7anofp = "armv7at"


# thumb/v7-a+fp/softfp
# CFLAGS: -mthumb -march=armv7-a+fp -mfloat-abi=softfp
DEFAULTTUNE_virtclass-multilib-libv7afpsoftfp = "armv7afpsoftfp"

AVAILTUNES += "armv7afpsoftfp"
PACKAGE_EXTRA_ARCHS_tune-armv7afpsoftfp = "${TUNE_PKGARCH_tune-armv7afpsoftfp}"
BASE_LIB_tune-armv7afpsoftfp = "lib/thumb/v7-a+fp/softfp"
TUNE_FEATURES_tune-armv7afpsoftfp = "arm"
TUNE_CCARGS_tune-armv7afpsoftfp = "-mthumb -march=armv7-a+fp -mfloat-abi=softfp"
TUNE_PKGARCH_tune-armv7afpsoftfp = "armv7afpt"


# thumb/v7-a+fp/hard
# CFLAGS: -mthumb -march=armv7-a+fp -mfloat-abi=hard
DEFAULTTUNE_virtclass-multilib-libv7afpthf = "armv7afpthf"

AVAILTUNES += "armv7afpthf"
PACKAGE_EXTRA_ARCHS_tune-armv7afpthf = "${TUNE_PKGARCH_tune-armv7afpthf}"
BASE_LIB_tune-armv7afpthf = "lib/thumb/v7-a+fp/hard"
TUNE_FEATURES_tune-armv7afpthf = "arm"
TUNE_CCARGS_tune-armv7afpthf = "-mthumb -march=armv7-a+fp -mfloat-abi=hard"
TUNE_PKGARCH_tune-armv7afpthf = "armv7afpthf"

# thumb/v7-a+simd/softfp
# CFLAGS: -mthumb -march=armv7-a+simd -mfloat-abi=softfp
DEFAULTTUNE_virtclass-multilib-libv7asimdsoftfp = "armv7asimdsoftfp"

AVAILTUNES += "armv7asimdsoftfp"
PACKAGE_EXTRA_ARCHS_tune-armv7asimdsoftfp = "${TUNE_PKGARCH_tune-armv7asimdsoftfp}"
BASE_LIB_tune-armv7asimdsoftfp = "lib/thumb/v7-a+simd/softfp"
TUNE_FEATURES_tune-armv7asimdsoftfp = "arm"
TUNE_CCARGS_tune-armv7asimdsoftfp = "-mthumb -march=armv7-a+simd -mfloat-abi=softfp"
TUNE_PKGARCH_tune-armv7asimdsoftfp = "armv7asimdt"


# thumb/v7-a+simd/hard
# CFLAGS: -mthumb -march=armv7-a+simd -mfloat-abi=hard
DEFAULTTUNE_virtclass-multilib-libv7asimdhard = "armv7asimdhard"

AVAILTUNES += "armv7asimdhard"
PACKAGE_EXTRA_ARCHS_tune-armv7asimdhard = "${TUNE_PKGARCH_tune-armv7asimdhard}"
BASE_LIB_tune-armv7asimdhard = "lib/thumb/v7-a+simd/hard"
TUNE_FEATURES_tune-armv7asimdhard = "arm"
TUNE_CCARGS_tune-armv7asimdhard = "-mthumb -march=armv7-a+simd -mfloat-abi=hard"
TUNE_PKGARCH_tune-armv7asimdhard = "armv7asimdthf"


# thumb/v7ve+simd/softfp
# CFLAGS: -mthumb -march=armv7ve+simd -mfloat-abi=softfp
DEFAULTTUNE_virtclass-multilib-libv7vesimdsoftfp = "armv7vesimdsoftfp"

AVAILTUNES += "armv7vesimdsoftfp"
PACKAGE_EXTRA_ARCHS_tune-armv7vesimdsoftfp = "${TUNE_PKGARCH_tune-armv7vesimdsoftfp}"
BASE_LIB_tune-armv7vesimdsoftfp = "lib/thumb/v7ve+simd/softfp"
TUNE_FEATURES_tune-armv7vesimdsoftfp = "arm"
TUNE_CCARGS_tune-armv7vesimdsoftfp = "-mthumb -march=armv7ve+simd -mfloat-abi=softfp"
TUNE_PKGARCH_tune-armv7vesimdsoftfp = "armv7vesimdt"

# thumb/v7ve+simd/hard
# CFLAGS: -mthumb -march=armv7ve+simd -mfloat-abi=hard
DEFAULTTUNE_virtclass-multilib-libvtvesimdhf = "armvtvesimdhf"

AVAILTUNES += "armvtvesimdhf"
PACKAGE_EXTRA_ARCHS_tune-armvtvesimdhf = "${TUNE_PKGARCH_tune-armvtvesimdhf}"
BASE_LIB_tune-armvtvesimdhf = "lib/thumb/v7ve+simd/hard"
TUNE_FEATURES_tune-armvtvesimdhf = "arm"
TUNE_CCARGS_tune-armvtvesimdhf = "-mthumb -march=armv7ve+simd -mfloat-abi=hard"
TUNE_PKGARCH_tune-armvtvesimdhf = "armv7vesimdthf"


# thumb/v8-a/nofp
# CFLAGS: -mthumb -march=armv8-a -mfloat-abi=soft
DEFAULTTUNE_virtclass-multilib-libv8anofp = "armv8anofp"

AVAILTUNES += "armv8anofp"
PACKAGE_EXTRA_ARCHS_tune-armv8anofp = "${TUNE_PKGARCH_tune-armv8anofp}"
BASE_LIB_tune-armv8anofp = "lib/thumb/v8-a/nofp"
TUNE_FEATURES_tune-armv8anofp = "arm"
TUNE_CCARGS_tune-armv8anofp = "-mthumb -march=armv8-a -mfloat-abi=soft"
TUNE_PKGARCH_tune-armv8anofp = "armv8at"

# thumb/v8-a+simd/softfp
# CFLAGS: -mthumb -march=armv8-a+simd -mfloat-abi=softfp
DEFAULTTUNE_virtclass-multilib-libv8asimdsoftfp = "armv8asimdsoftfp"

AVAILTUNES += "armv8asimdsoftfp"
PACKAGE_EXTRA_ARCHS_tune-armv8asimdsoftfp = "${TUNE_PKGARCH_tune-armv8asimdsoftfp}"
BASE_LIB_tune-armv8asimdsoftfp = "lib/thumb/v8-a+simd/softfp"
TUNE_FEATURES_tune-armv8asimdsoftfp = "arm"
TUNE_CCARGS_tune-armv8asimdsoftfp = "-mthumb -march=armv8-a+simd -mfloat-abi=softfp"
TUNE_PKGARCH_tune-armv8asimdsoftfp = "armv8asimdt"


# thumb/v8-a+simd/hard
# CFLAGS:  -mthumb -march=armv8-a+simd -mfloat-abi=hard
DEFAULTTUNE_virtclass-multilib-libv8asimdhard = "armv8asimdhard"

AVAILTUNES += "armv8asimdhard"
PACKAGE_EXTRA_ARCHS_tune-armv8asimdhard = "${TUNE_PKGARCH_tune-armv8asimdhard}"
BASE_LIB_tune-armv8asimdhard = "lib/thumb/v8-a+simd/hard"
TUNE_FEATURES_tune-armv8asimdhard = "arm"
TUNE_CCARGS_tune-armv8asimdhard = "-mthumb -march=armv8-a+simd -mfloat-abi=hard"
TUNE_PKGARCH_tune-armv8asimdhard = "armv8asimdthf"
```

## meta-xilinx/meta-xilinx-bsp/conf/machine/aarch64-tc.conf
```bitbake
require conf/multilib.conf
require conf/machine/include/tune-cortexa72-cortexa53.inc
require conf/machine/include/baremetal-tc.conf

# Define ilp32 variant (not in tune files)
TUNEVALID[ilp32] = "ilp32 ABI"

TUNE_CCARGS .= '${@bb.utils.contains("TUNE_FEATURES", "ilp32", " -mabi=ilp32", "", d)}'

# ILP request an alternative machine dictionary
INHERIT += "xlnx-standalone"
PACKAGEQA_EXTRA_MACHDEFFUNCS .= '${@bb.utils.contains("TUNE_FEATURES", "ilp32", " xlnx_ilp32_dict", "", d)}'

# Define all of the multilibs supported by this configuration
MULTILIB_GLOBAL_VARIANTS = "${@extend_variants(d,'MULTILIBS','multilib')}"
MULTILIBS = "multilib:libilp32"

# Base configuration
# CFLAGS:
DEFAULTTUNE = "cortexa72-cortexa53"

# CFLAGS: -mabi=ilp32
DEFAULTTUNE_virtclass-multilib-libilp32 = "cortexa72-cortexa53-ilp32"

AVAILTUNES += "cortexa72-cortexa53-ilp32"
ARMPKGARCH_tune-cortexa72-cortexa53-ilp32 = "${ARMPKGARCH_tune-cortexa72-cortexa53}-ilp32"
TUNE_FEATURES_tune-cortexa72-cortexa53-ilp32 = "${TUNE_FEATURES_tune-cortexa72-cortexa53} ilp32"
PACKAGE_EXTRA_ARCHS_tune-cortexa72-cortexa53-ilp32 = "${PACKAGE_EXTRA_ARCHS_tune-cortexa72-cortexa53} cortexa72-cortexa53-ilp32"
BASE_LIB_tune-cortexa72-cortexa53-ilp32 = "lib/ilp32"
```
