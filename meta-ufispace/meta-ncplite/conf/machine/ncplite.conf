## meta-xilinx/meta-xilinx-bsp/conf/machine/include/machine-xilinx-qemu.inc
```bitbake
# This include is used to setup default QEMU and qemuboot config for meta-xilinx
# machines.

# Use the xilinx specific version for these users
IMAGE_CLASSES += "qemuboot-xilinx"

# depend on qemu-helper-native, which will depend on QEMU
EXTRA_IMAGEDEPENDS += "qemu-helper-native"

PREFERRED_PROVIDER_qemu-helper-native = "qemu-xilinx-helper-native"
PREFERRED_PROVIDER_qemu = "qemu-xilinx"
PREFERRED_PROVIDER_qemu-native = "qemu-xilinx-native"
PREFERRED_PROVIDER_nativesdk-qemu = "nativesdk-qemu-xilinx"

def qemu_default_dtb(d):
    if d.getVar("IMAGE_BOOT_FILES", True):
        dtbs = d.getVar("IMAGE_BOOT_FILES", True).split(" ")
        # IMAGE_BOOT_FILES has extra renaming info in the format '<source>;<target>'
        # Note: Wildcard sources work here only because runqemu expands them at run time
        dtbs = [f.split(";")[0] for f in dtbs]
        dtbs = [f for f in dtbs if f.endswith(".dtb")]
        if len(dtbs) != 0:
            return dtbs[0]
    return ""

def qemu_default_serial(d):
    if d.getVar("SERIAL_CONSOLES", True):
        first_console = d.getVar("SERIAL_CONSOLES", True).split(" ")[0]
        speed, console = first_console.split(";", 1)
        # zynqmp uses earlycon and stdout (in dtb)
        if "zynqmp" in d.getVar("MACHINEOVERRIDES", True).split(":"):
            return ""
        return "console=%s,%s earlyprintk" % (console, speed)
    return ""

def qemu_target_binary(d):
    ta = d.getVar("TARGET_ARCH", True)
    if ta == "microblazeeb":
        ta = "microblaze"
    elif ta == "arm":
        ta = "aarch64"
    return "qemu-system-%s" % ta

def qemu_zynqmp_unhalt(d, multiarch):
    if multiarch:
        return "-global xlnx,zynqmp-boot.cpu-num=0 -global xlnx,zynqmp-boot.use-pmufw=true"
    return "-device loader,addr=0xfd1a0104,data=0x8000000e,data-len=4 -device loader,addr=0xfd1a0104,data=0x8000000e,data-len=4"

# For qemuboot, default setup across all machines in meta-xilinx
QB_SYSTEM_NAME_aarch64 ?= "${@qemu_target_binary(d)}-multiarch"
QB_SYSTEM_NAME ?= "${@qemu_target_binary(d)}"
QB_DEFAULT_FSTYPE ?= "cpio"
QB_DTB ?= "${@qemu_default_dtb(d)}"
QB_KERNEL_CMDLINE_APPEND ?= "${@qemu_default_serial(d)}"
```

## meta-xilinx/meta-xilinx-bsp/conf/machine/include/soc-tune-include.inc
```bitbake
# Unfortunately various tunefiles don't include each other, so create
# a list of things to require based on the DEFAULTTUNE setting.
TUNEFILE[cortexr5] = "conf/machine/include/tune-cortexrm.inc"
TUNEFILE[cortexr5f] = "conf/machine/include/tune-cortexrm.inc"
TUNEFILE[cortexa9thf-neon] = "conf/machine/include/tune-cortexa9.inc"
TUNEFILE[cortexa53] = "conf/machine/include/tune-cortexa53.inc"
TUNEFILE[cortexa72] = "conf/machine/include/tune-cortexa72.inc"
TUNEFILE[cortexa72-cortexa53] = "conf/machine/include/tune-cortexa72-cortexa53.inc"
TUNEFILE[microblaze] = "conf/machine/include/tune-microblaze.inc"

# Default to arch-armv8a.inc
TUNEFILE = "${@ d.getVarFlag('TUNEFILE', d.getVar('DEFAULTTUNE')) if d.getVarFlag('TUNEFILE', d.getVar('DEFAULTTUNE')) else 'conf/machine/include/arm/arch-armv8a.inc'}"

require ${TUNEFILE}
```

## meta-xilinx/meta-xilinx-bsp/conf/machine/include/soc-versal.inc
```bitbake
DEFAULTTUNE ?= "cortexa72-cortexa53"
SOC_FAMILY ?= "versal"

# Available SOC_VARIANT's for versal:
# "-prime"    - Versal deafult Prime Devices
# "-ai-core"  - Versal AI-core Devices
# "-premium"  - Versal Premium Devices

SOC_VARIANT ?= "-prime"

require soc-tune-include.inc
require xilinx-soc-family.inc

# Linux Configuration
KERNEL_IMAGETYPE ?= "Image"

WIC_DEPENDS ?= "virtual/kernel virtual/bootloader virtual/boot-bin virtual/arm-trusted-firmware"

UBOOT_ELF ?= "u-boot.elf"
```

## meta-xilinx/meta-xilinx-bsp/conf/machine/include/soc-zynq.inc
```bitbake
DEFAULTTUNE ?= "cortexa9thf-neon"
SOC_FAMILY ?= "zynq"

# Available SOC_VARIANT's for zynq:
# 7zs - Zynq-7000 Single A9 Core
# 7z  - Zynq-7000 Dual A9 Core

SOC_VARIANT ?= "7z"

require soc-tune-include.inc
require xilinx-soc-family.inc

# Linux Configuration
KERNEL_IMAGETYPE ?= "uImage"
KERNEL_IMAGETYPES += "zImage"

# Set default load address.
# Override with KERNEL_EXTRA_ARGS_<board> += "..." in machine file if required
KERNEL_EXTRA_ARGS_zynq += "UIMAGE_LOADADDR=0x8000"

# WIC Specific dependencies
WIC_DEPENDS ?= "virtual/kernel virtual/bootloader virtual/boot-bin"

UBOOT_ELF ?= "u-boot.elf"
```
