## meta-xilinx/meta-xilinx-bsp/conf/machine/arm-rm-tc.conf
```bitbake
require conf/multilib.conf
require conf/machine/include/tune-cortexrm.inc
require conf/machine/include/baremetal-tc.conf

# Define all of the multilibs supproted by this configuration
MULTILIB_GLOBAL_VARIANTS = "${@extend_variants(d,'MULTILIBS','multilib')}"

MULTILIBS  = "multilib:libarmv5tesoftfp multilib:libarmv5tehard"
MULTILIBS += "multilib:libnofp"
MULTILIBS += "multilib:libv7nofp multilib:libv7fpsoftfp multilib:libv7fphard"
MULTILIBS += "multilib:libv6mnofp"
MULTILIBS += "multilib:libv7mnofp"
MULTILIBS += "multilib:libv7emnofp multilib:libv7emfpsoftfp"
MULTILIBS += "multilib:libv7emfphard multilib:libv7emdpsoftfp"
MULTILIBS += "multilib:libv7emdphard"
MULTILIBS += "multilib:libv8mbasenofp"
MULTILIBS += "multilib:libv8mmainnofp multilib:libv8mmainfpsoftfp multilib:libv8mmainfphard multilib:libv8mmaindpsoftfp multilib:libv8mmaindphard"

TUNE_CCARGS = "${TUNE_CCARGS_tune-${DEFAULTTUNE}}"
TUNE_PKGARCH = "${TUNE_PKGARCH_tune-${DEFAULTTUNE}}"

# Base configuration
# CFLAGS:
DEFAULTTUNE = "armrm"

AVAILTUNES += "armrm"
PACKAGE_EXTRA_ARCHS_tune-armrm = "${TUNE_PKGARCH_tune-armrm}"
BASE_LIB_tune-armrm = "lib"
TUNE_FEATURES_tune-armrm = "arm armrm"
TUNE_CCARGS_tune-armrm = ""
TUNE_PKGARCH_tune-armrm = "armrm"


# arm/v5te/softfp
# CFLAGS:  -marm -march=armv5te+fp -mfloat-abi=softfp
DEFAULTTUNE_virtclass-multilib-libarmv5tesoftfp = "armv5tesoftfp"

AVAILTUNES += "armv5tesoftfp"
PACKAGE_EXTRA_ARCHS_tune-armv5tesoftfp = "${TUNE_PKGARCH_tune-armv5tesoftfp}"
BASE_LIB_tune-armv5tesoftfp = "lib/arm/v5te/softfp"
TUNE_FEATURES_tune-armv5tesoftfp = "arm armrm"
TUNE_CCARGS_tune-armv5tesoftfp = "-marm -march=armv5te+fp -mfloat-abi=softfp"
TUNE_PKGARCH_tune-armv5tesoftfp = "armv5tefp"


# arm/v5te/hard
# CFLAGS: -marm -march=armv5te+fp -mfloat-abi=hard
DEFAULTTUNE_virtclass-multilib-libarmv5tehard = "armv5tehard"

AVAILTUNES += "armv5tehard"
PACKAGE_EXTRA_ARCHS_tune-armv5tehard = "${TUNE_PKGARCH_tune-armv5tehard}"
BASE_LIB_tune-armv5tehard = "lib/arm/v5te/hard"
TUNE_FEATURES_tune-armv5tehard = "arm armrm"
TUNE_CCARGS_tune-armv5tehard = "-marm -march=armv5te+fp -mfloat-abi=hard"
TUNE_PKGARCH_tune-armv5tehard = "armv5tefphf"


# thumb/nofp
# CFLAGS: -mthumb -mfloat-abi=soft
DEFAULTTUNE_virtclass-multilib-libnofp = "armnofp"

AVAILTUNES += "armnofp"
PACKAGE_EXTRA_ARCHS_tune-armnofp = "${TUNE_PKGARCH_tune-armnofp}"
BASE_LIB_tune-armnofp = "lib/thumb/nofp"
TUNE_FEATURES_tune-armnofp = "arm armrm"
TUNE_CCARGS_tune-armnofp = "-mthumb -mfloat-abi=soft"
TUNE_PKGARCH_tune-armnofp = "armt"


# thumb/v7/nofp
# CFLAGS: -mthumb -march=armv7 -mfloat-abi=soft
DEFAULTTUNE_virtclass-multilib-libv7nofp = "armv7nofp"

AVAILTUNES += "armv7nofp"
PACKAGE_EXTRA_ARCHS_tune-armv7nofp = "${TUNE_PKGARCH_tune-armv7nofp}"
BASE_LIB_tune-armv7nofp = "lib/thumb/v7/nofp"
TUNE_FEATURES_tune-armv7nofp ="arm armrm"
TUNE_CCARGS_tune-armv7nofp = "-mthumb -march=armv7 -mfloat-abi=soft"
TUNE_PKGARCH_tune-armv7nofp = "armv7t"


# thumb/v7+fp/softfp
# CFLAGS: -mthumb -march=armv7+fp -mfloat-abi=softfp
DEFAULTTUNE_virtclass-multilib-libv7fpsoftfp = "armv7fpsoftfp"

AVAILTUNES += "armv7fpsoftfp"
PACKAGE_EXTRA_ARCHS_tune-armv7fpsoftfp = "${TUNE_PKGARCH_tune-armv7fpsoftfp}"
BASE_LIB_tune-armv7fpsoftfp = "lib/thumb/v7+fp/softfp"
TUNE_FEATURES_tune-armv7fpsoftfp ="arm armrm"
TUNE_CCARGS_tune-armv7fpsoftfp = "-mthumb -march=armv7+fp -mfloat-abi=softfp"
TUNE_PKGARCH_tune-armv7fpsoftfp = "armv7fpt"


# thumb/v7+fp/hard
# CFLAGS: -mthumb -march=armv7+fp -mfloat-abi=hard
DEFAULTTUNE_virtclass-multilib-libv7fphard = "armv7fphard"

AVAILTUNES += "armv7fphard"
PACKAGE_EXTRA_ARCHS_tune-armv7fphard = "${TUNE_PKGARCH_tune-armv7fphard}"
BASE_LIB_tune-armv7fphard = "lib/thumb/v7+fp/hard"
TUNE_FEATURES_tune-armv7fphard ="arm armrm"
TUNE_CCARGS_tune-armv7fphard = "-mthumb -march=armv7+fp -mfloat-abi=hard"
TUNE_PKGARCH_tune-armv7fphard = "armv7fpthf"


# thumb/v6-m/nofp
# CFLAGS: -mthumb -march=armv6s-m -mfloat-abi=soft
DEFAULTTUNE_virtclass-multilib-libv6mnofp = "armv6mnofp"

# Workaround for this multilib in newlib
# newlib/libc/sys/arm/trap.S:88: Error: lo register required -- `sub ip,sp,ip
EXTRA_OECONF_append_pn-libv6mnofp-newlib     = " --disable-newlib-supplied-syscalls"

AVAILTUNES += "armv6mnofp"
PACKAGE_EXTRA_ARCHS_tune-armv6mnofp = "${TUNE_PKGARCH_tune-armv6mnofp}"
BASE_LIB_tune-armv6mnofp = "lib/thumb/v6-m/nofp"
TUNE_FEATURES_tune-armv6mnofp ="arm armrm"
TUNE_CCARGS_tune-armv6mnofp = "-mthumb -march=armv6s-m -mfloat-abi=soft"
TUNE_PKGARCH_tune-armv6mnofp = "armv6smt"


# thumb/v7-m/nofp
# CFLAGS: -mthumb -march=armv7-m -mfloat-abi=soft
DEFAULTTUNE_virtclass-multilib-libv7mnofp = "armv7mnofp"

AVAILTUNES += "armv7mnofp"
PACKAGE_EXTRA_ARCHS_tune-armv7mnofp = "${TUNE_PKGARCH_tune-armv7mnofp}"
BASE_LIB_tune-armv7mnofp = "lib/thumb/v7-m/nofp"
TUNE_FEATURES_tune-armv7mnofp ="arm armrm"
TUNE_CCARGS_tune-armv7mnofp = "-mthumb -march=armv7-m -mfloat-abi=soft"
TUNE_PKGARCH_tune-armv7mnofp = "armv7mt"


# thumb/v7e-m/nofp
# CFLAGS: -mthumb -march=armv7e-m -mfloat-abi=soft
DEFAULTTUNE_virtclass-multilib-libv7emnofp = "armv7emnofp"

AVAILTUNES += "armv7emnofp"
PACKAGE_EXTRA_ARCHS_tune-armv7emnofp = "${TUNE_PKGARCH_tune-armv7emnofp}"
BASE_LIB_tune-armv7emnofp = "lib/thumb/v7e-m/nofp"
TUNE_FEATURES_tune-armv7emnofp ="arm armrm"
TUNE_CCARGS_tune-armv7emnofp = "-mthumb -march=armv7e-m -mfloat-abi=soft"
TUNE_PKGARCH_tune-armv7emnofp = "armv7emt"


# thumb/v7e-m+fp/softfp
# CFLAGS: -mthumb -march=armv7e-m+fp -mfloat-abi=softfp
DEFAULTTUNE_virtclass-multilib-libv7emfpsoftfp = "armv7emfpsoftfp"

AVAILTUNES += "armv7emfpsoftfp"
PACKAGE_EXTRA_ARCHS_tune-armv7emfpsoftfp = "${TUNE_PKGARCH_tune-armv7emfpsoftfp}"
BASE_LIB_tune-armv7emfpsoftfp = "lib/thumb/v7e-m+fp/softfp"
TUNE_FEATURES_tune-armv7emfpsoftfp ="arm armrm"
TUNE_CCARGS_tune-armv7emfpsoftfp = "-mthumb -march=armv7e-m+fp -mfloat-abi=softfp"
TUNE_PKGARCH_tune-armv7emfpsoftfp = "armv7emfpt"


# thumb/v7e-m+fp/hard
# CFLAGS: -mthumb -march=armv7e-m+fp -mfloat-abi=hard
DEFAULTTUNE_virtclass-multilib-libv7emfphard = "armv7emfphard"

AVAILTUNES += "armv7emfphard"
PACKAGE_EXTRA_ARCHS_tune-armv7emfphard = "${TUNE_PKGARCH_tune-armv7emfphard}"
BASE_LIB_tune-armv7emfphard = "lib/thumb/v7e-m+fp/hard"
TUNE_FEATURES_tune-armv7emfphard ="arm armrm"
TUNE_CCARGS_tune-armv7emfphard = "-mthumb -march=armv7e-m+fp -mfloat-abi=hard"
TUNE_PKGARCH_tune-armv7emfphard = "armv7emfpthf"


# thumb/v7e-m+dp/softfp
# CFLAGS: -mthumb -march=armv7e-m+fp.dp -mfloat-abi=softfp
DEFAULTTUNE_virtclass-multilib-libv7emdpsoftfp = "armv7emdpsoftfp"

AVAILTUNES += "armv7emdpsoftfp"
PACKAGE_EXTRA_ARCHS_tune-armv7emdpsoftfp = "${TUNE_PKGARCH_tune-armv7emdpsoftfp}"
BASE_LIB_tune-armv7emdpsoftfp = "lib/thumb/v7e-m+dp/softfp"
TUNE_FEATURES_tune-armv7emdpsoftfp ="arm armrm"
TUNE_CCARGS_tune-armv7emdpsoftfp = "-mthumb -march=armv7e-m+fp.dp -mfloat-abi=softfp"
TUNE_PKGARCH_tune-armv7emdpsoftfp = "armv7emdp"

# thumb/v7e-m+dp/hard
# CFLAGS: -mthumb -march=armv7e-m+fp.dp -mfloat-abi=hard
DEFAULTTUNE_virtclass-multilib-libv7emdphard = "armv7emdphard"

AVAILTUNES += "armv7emdphard"
PACKAGE_EXTRA_ARCHS_tune-armv7emdphard = "${TUNE_PKGARCH_tune-armv7emdphard}"
BASE_LIB_tune-armv7emdphard = "lib/thumb/v7e-m+dp/hard"
TUNE_FEATURES_tune-armv7emdphard ="arm armrm"
TUNE_CCARGS_tune-armv7emdphard = "-mthumb -march=armv7e-m+fp.dp -mfloat-abi=hard"
TUNE_PKGARCH_tune-armv7emdphard = "armv7emdpthf"


# thumb/v8-m.base/nofp
# CFLAGS: -mthumb -march=armv8-m.base -mfloat-abi=soft
DEFAULTTUNE_virtclass-multilib-libv8mbasenofp = "armv8mbasenofp"

# Workaround for this multilib in newlib
# newlib/libc/sys/arm/trap.S:88: Error: lo register required -- `sub ip,sp,ip'
EXTRA_OECONF_append_pn-libv8mbasenofp-newlib = " --disable-newlib-supplied-syscalls"

AVAILTUNES += "armv8mbasenofp"
PACKAGE_EXTRA_ARCHS_tune-armv8mbasenofp = "${TUNE_PKGARCH_tune-armv8mbasenofp}"
BASE_LIB_tune-armv8mbasenofp = "lib/thumb/v8-m.base/nofp"
TUNE_FEATURES_tune-armv8mbasenofp ="arm armrm"
TUNE_CCARGS_tune-armv8mbasenofp = "-mthumb -march=armv8-m.base -mfloat-abi=soft"
TUNE_PKGARCH_tune-armv8mbasenofp = "armv8mbaset"

# thumb/v8-m.main/nofp
# CFLAGS: -mthumb -march=armv8-m.main -mfloat-abi=soft
DEFAULTTUNE_virtclass-multilib-libv8mmainnofp = "armv8mmainnofp"

AVAILTUNES += "armv8mmainnofp"
PACKAGE_EXTRA_ARCHS_tune-armv8mmainnofp = "${TUNE_PKGARCH_tune-armv8mmainnofp}"
BASE_LIB_tune-armv8mmainnofp = "lib/thumb/v8-m.main/nofp"
TUNE_FEATURES_tune-armv8mmainnofp ="arm armrm"
TUNE_CCARGS_tune-armv8mmainnofp = "-mthumb -march=armv8-m.main -mfloat-abi=soft"
TUNE_PKGARCH_tune-armv8mmainnofp = "armv8mmaint"


# thumb/v8-m.main+fp/softfp
# CFLAGS: -mthumb -march=armv8-m.main+fp -mfloat-abi=softfp
DEFAULTTUNE_virtclass-multilib-libv8mmainfpsoftfp = "armv8mmainfpsoftfp"

AVAILTUNES += "armv8mmainfpsoftfp"
PACKAGE_EXTRA_ARCHS_tune-armv8mmainfpsoftfp = "${TUNE_PKGARCH_tune-armv8mmainfpsoftfp}"
BASE_LIB_tune-armv8mmainfpsoftfp = "lib/thumb/v8-m.main+fp/softfp"
TUNE_FEATURES_tune-armv8mmainfpsoftfp ="arm armrm"
TUNE_CCARGS_tune-armv8mmainfpsoftfp = "-mthumb -march=armv8-m.main+fp -mfloat-abi=softfp"
TUNE_PKGARCH_tune-armv8mmainfpsoftfp = "armv8mmainfpt"

# thumb/v8-m.main+fp/hard
# CFLAGS: -mthumb -march=armv8-m.main+fp -mfloat-abi=hard
DEFAULTTUNE_virtclass-multilib-libv8mmainfphard = "armv8mmainfphard"

AVAILTUNES += "armv8mmainfphard"
PACKAGE_EXTRA_ARCHS_tune-armv8mmainfphard = "${TUNE_PKGARCH_tune-armv8mmainfphard}"
BASE_LIB_tune-armv8mmainfphard = "lib/thumb/v8-m.main+fp/hard"
TUNE_FEATURES_tune-armv8mmainfphard ="arm armrm"
TUNE_CCARGS_tune-armv8mmainfphard = "-mthumb -march=armv8-m.main+fp -mfloat-abi=hard"
TUNE_PKGARCH_tune-armv8mmainfphard = "armv8mmainfpthf"


# thumb/v8-m.main+dp/softfp
# CFLAGS: -mthumb -march=armv8-m.main+fp.dp -mfloat-abi=softfp
DEFAULTTUNE_virtclass-multilib-libv8mmaindpsoftfp = "armv8mmaindpsoftfp"

AVAILTUNES += "armv8mmaindpsoftfp"
PACKAGE_EXTRA_ARCHS_tune-armv8mmaindpsoftfp = "${TUNE_PKGARCH_tune-armv8mmaindpsoftfp}"
BASE_LIB_tune-armv8mmaindpsoftfp = "lib/thumb/v8-m.main+dp/softfp"
TUNE_FEATURES_tune-armv8mmaindpsoftfp ="arm armrm"
TUNE_CCARGS_tune-armv8mmaindpsoftfp = "-mthumb -march=armv8-m.main+fp.dp -mfloat-abi=softfp"
TUNE_PKGARCH_tune-armv8mmaindpsoftfp = "armv8mmainfpdpt"


# thumb/v8-m.main+dp/hard
# CFLAGS: -mthumb -march=armv8-m.main+fp.dp -mfloat-abi=hard
DEFAULTTUNE_virtclass-multilib-libv8mmaindphard = "armv8mmaindphard"

AVAILTUNES += "armv8mmaindphard"
PACKAGE_EXTRA_ARCHS_tune-armv8mmaindphard = "${TUNE_PKGARCH_tune-armv8mmaindphard}"
BASE_LIB_tune-armv8mmaindphard = "lib/thumb/v8-m.main+dp/hard"
TUNE_FEATURES_tune-armv8mmaindphard ="arm armrm"
TUNE_CCARGS_tune-armv8mmaindphard = "-mthumb -march=armv8-m.main+fp.dp -mfloat-abi=hard"
TUNE_PKGARCH_tune-armv8mmaindphard = "armv8mmainfpdpthf"
```

## meta-xilinx/meta-xilinx-bsp/conf/machine/include/baremetal-tc.conf
```bitbake
# This is specific to baremetal toolchains only.
#
# Some of the operations we want to do are different then regular Yocto
# Project SDK workflows, so wrap baremetal toolchain items in a custom
# override:

MACHINEOVERRIDES_append = ":baremetal-multilib-tc"
```

## meta-xilinx/meta-xilinx-bsp/conf/machine/include/machine-xilinx-default.inc
```bitbake
# Default Xilinx BSP Machine settings

MACHINE_FEATURES_BACKFILL_CONSIDERED += "rtc"

# File System Configuration
IMAGE_FSTYPES ?= "tar.gz cpio cpio.gz.u-boot"

# Kernel Configuration
PREFERRED_PROVIDER_virtual/kernel ??= "linux-xlnx"

# U-Boot Configuration
PREFERRED_PROVIDER_virtual/bootloader ??= "u-boot-xlnx"
PREFERRED_PROVIDER_virtual/boot-bin ??= "${PREFERRED_PROVIDER_virtual/bootloader}"

do_image_wic[depends] += "${@' '.join('%s:do_deploy' % r for r in (d.getVar('WIC_DEPENDS') or "").split())}"

UBOOT_SUFFIX ?= "img"
UBOOT_SUFFIX_microblaze ?= "bin"

UBOOT_BINARY ?= "u-boot.${UBOOT_SUFFIX}"
UBOOT_ELF ?= "u-boot"
UBOOT_ELF_aarch64 ?= "u-boot.elf"

#Hardware accelaration
PREFERRED_PROVIDER_virtual/libgles1_mali400 = "libmali-xlnx"
PREFERRED_PROVIDER_virtual/libgles2_mali400 = "libmali-xlnx"
PREFERRED_PROVIDER_virtual/egl_mali400 = "libmali-xlnx"
PREFERRED_PROVIDER_virtual/libgl_mali400 = "mesa-gl"
PREFERRED_PROVIDER_virtual/mesa_mali400 = "mesa-gl"

# microblaze does not get on with pie for reasons not looked into as yet
GCCPIE_microblaze = ""
GLIBCPIE_microblaze = ""
SECURITY_CFLAGS_microblaze = ""
SECURITY_LDFLAGS_microblaze = ""
# Microblaze does not support gnu hash style
LINKER_HASH_STYLE_microblaze = "sysv"

XSERVER ?= " \
	xserver-xorg \
	xf86-input-evdev \
	xf86-input-mouse \
	xf86-input-keyboard \
	xf86-video-fbdev \
	${XSERVER_EXT} \
	"

IMAGE_BOOT_FILES ?= "${@get_default_image_boot_files(d)}"

def get_default_image_boot_files(d):
    files = []

    # kernel images
    kerneltypes = set((d.getVar("KERNEL_IMAGETYPE") or "").split())
    kerneltypes |= set((d.getVar("KERNEL_IMAGETYPES") or "").split())
    for i in kerneltypes:
        files.append(i)

    # u-boot image
    if d.getVar("UBOOT_BINARY"):
        files.append(d.getVar("UBOOT_BINARY"))

    # device trees (device-tree only), these are first as they are likely desired over the kernel ones
    if "device-tree" in (d.getVar("MACHINE_ESSENTIAL_EXTRA_RDEPENDS") or ""):
        files.append("devicetree/*.dtb")


    # device trees (kernel only)
    if d.getVar("KERNEL_DEVICETREE"):
        dtbs = d.getVar("KERNEL_DEVICETREE").split(" ")
        dtbs = [os.path.basename(d) for d in dtbs]
        for dtb in dtbs:
            files.append(dtb)

    return " ".join(files)

XSERVER_EXT ?= ""

FPGA_MNGR_RECONFIG_ENABLE ?= "${@bb.utils.contains('IMAGE_FEATURES', 'fpga-manager', '1', '0', d)}"
```

## meta-xilinx/meta-xilinx-bsp/conf/machine/include/machine-xilinx-overrides.inc
```bitbake
SOC_VARIANT ??= ""
MACHINEOVERRIDES =. "${@['', '${SOC_FAMILY}${SOC_VARIANT}:']['${SOC_VARIANT}' != '']}"

# Here we can extend overrides for the corresponding family and variant
def get_soc_overrides(fam, var, d):
  extender = ''
  if (fam == 'zynqmp'):
    if (var == 'eg'):
      extender = 'mali400:'
    elif (var == 'ev'):
      extender = 'mali400:vcu:'
  return extender

# Gets OVERRIDES extender depending on the board
SOC_OVERRIDES = "${@get_soc_overrides(d.getVar('SOC_FAMILY'),d.getVar('SOC_VARIANT'), d)}"

MACHINEOVERRIDES  =. "${SOC_OVERRIDES}"

PACKAGE_EXTRA_ARCHS_append = " ${SOC_FAMILY}"
PACKAGE_EXTRA_ARCHS_append = "${@['', ' ${SOC_FAMILY}${SOC_VARIANT}']['${SOC_VARIANT}' != '']}"
```
