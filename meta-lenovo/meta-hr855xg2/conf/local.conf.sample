## meta-nvidia/meta-gb200nvl-obmc/conf/machine/gb200nvl-obmc.conf
```bitbake
KMACHINE = "aspeed"
#Temporary
KERNEL_DEVICETREE = "aspeed/aspeed-bmc-nvidia-gb200nvl-bmc.dtb"

UBOOT_MACHINE = "ast2600_openbmc_spl_defconfig"
UBOOT_DEVICETREE = "ast2600-gb200nvl-bmc-nvidia"
SPL_BINARY = "spl/u-boot-spl.bin"

require conf/machine/include/ast2600.inc
require conf/machine/include/obmc-bsp-common.inc
require conf/distro/include/pldm.inc
require conf/machine/include/nvidia.inc

# Declare offsets (in KB) of each flash partition
FLASH_UBOOT_OFFSET = "0"
FLASH_UBOOT_ENV_OFFSET = "896"
FLASH_KERNEL_OFFSET = "1024"
FLASH_ROFS_OFFSET = "10240"
FLASH_RWFS_OFFSET = "65532"
SOCSEC_SIGN_ENABLE = "0"

FLASH_SIZE = "65536"

QB_MACHINE = "-machine gb200nvl-bmc"

SERIAL_CONSOLES = "115200;ttyS4"

MACHINE_FEATURES += "\
    obmc-host-ipmi \
    "

PREFERRED_PROVIDER_virtual/obmc-host-ipmi-hw = "phosphor-ipmi-ssif"

VIRTUAL-RUNTIME_phosphor-ipmi-providers = ""

IMAGE_FEATURES:remove = " \
    obmc-chassis-mgmt \
    obmc-chassis-state-mgmt \
    obmc-fan-control \
    obmc-fan-mgmt \
    obmc-flash-mgmt \
    obmc-host-state-mgmt \
    obmc-ikvm \
"
```

## meta-nvidia/meta-nvl32-obmc/conf/layer.conf
```bitbake
# We have a conf and classes directory, add to BBPATH
BBPATH .= ":${LAYERDIR}"

# We have recipes-* directories, add to BBFILES
BBFILES += "${LAYERDIR}/recipes-*/*/*.bb \
            ${LAYERDIR}/recipes-*/*/*.bbappend \
            ${LAYERDIR}/recipes-*/*/*/*.bbappend \
            "

BBFILE_COLLECTIONS += "nvidia-nvl32-obmc-layer"
BBFILE_PATTERN_nvidia-nvl32-obmc-layer := "^${LAYERDIR}/"
LAYERSERIES_COMPAT_nvidia-nvl32-obmc-layer = "walnascar scarthgap"
```

## meta-nxp/conf/layer.conf
```bitbake
# We have a conf and classes directory, add to BBPATH
BBPATH .= ":${LAYERDIR}"

# We have recipes-* directories, add to BBFILES
BBFILES += "${LAYERDIR}/recipes-*/*/*.bb \
            ${LAYERDIR}/recipes-*/*/*.bbappend"

BBFILE_COLLECTIONS += "nxp-layer"
BBFILE_PATTERN_nxp-layer = "^${LAYERDIR}/"
BBFILE_PRIORITY_nxp-layer = "6"

LAYERVERSION_nxp-layer = "1"
LAYERSERIES_COMPAT_nxp-layer = "wrynose whinlatter"
```

## meta-openbmc-bsp/conf/layer.conf
```bitbake
# We have a conf and classes directory, add to BBPATH
BBPATH .= ":${LAYERDIR}"

BBFILES += "${LAYERDIR}/common/recipes-*/*/*.bb \
            ${LAYERDIR}/common/recipes-*/*/*.bbappend"

BBFILE_COLLECTIONS += "obmc-bsp"
BBFILE_PATTERN_obmc-bsp = ""
LAYERVERSION_obmc-bsp = "1"
```

## meta-openbmc-bsp/conf/machine/include/obmc-bsp-common.inc
```bitbake
#@TYPE: Machine
#@NAME: OpenBMC
#@DESCRIPTION: Common machine configuration for OpenBMC chips

MACHINE_EXTRA_RRECOMMENDS = " kernel-modules"
EXTRA_IMAGEDEPENDS += "u-boot"

KERNEL_CLASSES ?= "kernel-fitimage"
KERNEL_IMAGETYPES ?= "fitImage"
KERNEL_EXTRA_ARGS += "LOADADDR=${UBOOT_ENTRYPOINT}"

UBOOT_SUFFIX ?= "bin"

MACHINEOVERRIDES =. "openbmc:"

OBMC_PHOSPHOR_IMAGE_OVERLAY= "1"
IMAGE_FSTYPES += "cpio.${INITRAMFS_CTYPE}.u-boot"
OBMC_IMAGE_EXTRA_INSTALL_append = " u-boot-fw-utils"

IMAGE_CLASSES += "image_types_uboot"

INITRAMFS_CTYPE ?= "lzma"
INITRAMFS_FSTYPES += "cpio.${INITRAMFS_CTYPE}"
INITRAMFS_IMAGE = "obmc-phosphor-initramfs"

MACHINE_FEATURES_BACKFILL_CONSIDERED = "qemu-usermode"
```
