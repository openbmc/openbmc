## meta-lenovo/meta-hr855xg2/conf/local.conf.sample
```bitbake
#"Copyright (c) 2019-present Lenovo
#Licensed under BSD-3, see COPYING.BSD file for details."

MACHINE ??= "hr855xg2"
DISTRO ?= "openbmc-hr855xg2"
PACKAGE_CLASSES ?= "package_rpm"
SANITY_TESTED_DISTROS_append ?= " *"
EXTRA_IMAGE_FEATURES = "debug-tweaks"
USER_CLASSES ?= "buildstats image-mklibs image-prelink"
PATCHRESOLVE = "noop"
BB_DISKMON_DIRS = "\
    STOPTASKS,${TMPDIR},1G,100K \
    STOPTASKS,${DL_DIR},1G,100K \
    STOPTASKS,${SSTATE_DIR},1G,100K \
    STOPTASKS,/tmp,100M,100K \
    ABORT,${TMPDIR},100M,1K \
    ABORT,${DL_DIR},100M,1K \
    ABORT,${SSTATE_DIR},100M,1K \
    ABORT,/tmp,10M,1K"
CONF_VERSION = "1"
INHERIT += "extrausers"
EXTRA_USERS_PARAMS = " \
  usermod -p '\$1\$UGMqyqdG\$FZiylVFmRRfl9Z0Ue8G7e/' root; \
  "
```

## meta-lenovo/meta-hr855xg2/conf/machine/hr855xg2.conf
```bitbake
#"Copyright (c) 2019-present Lenovo
#Licensed under BSD-3, see COPYING.BSD file for details."

KMACHINE = "aspeed"
KERNEL_DEVICETREE = "${KMACHINE}-bmc-lenovo-${MACHINE}.dtb"

UBOOT_MACHINE = "ast_g5_phy_config"

require conf/machine/include/ast2500.inc
require conf/machine/include/obmc-bsp-common.inc
require conf/machine/include/lenovo.inc

FLASH_SIZE = "32768"

PREFERRED_PROVIDER_virtual/obmc-host-ipmi-hw = "phosphor-ipmi-bt"
PREFERRED_PROVIDER_virtual/obmc-chassis-mgmt = "packagegroup-lenovo-apps"
PREFERRED_PROVIDER_virtual/obmc-fan-mgmt = "packagegroup-lenovo-apps"
PREFERRED_PROVIDER_virtual/obmc-flash-mgmt = "packagegroup-lenovo-apps"
PREFERRED_PROVIDER_virtual/obmc-system-mgmt = "packagegroup-lenovo-apps"
```

## meta-mellanox/conf/layer.conf
```bitbake
# We have a conf and classes directory, add to BBPATH
BBPATH .= ":${LAYERDIR}"

BBFILE_COLLECTIONS += "mellanox"
BBFILE_PATTERN_mellanox = ""
```

## meta-microsoft/conf/layer.conf
```bitbake
# We have a conf and classes directory, add to BBPATH
BBPATH .= ":${LAYERDIR}"

BBFILE_COLLECTIONS += "microsoft-layer"
BBFILE_PATTERN_microsoft-layer = ""
LAYERSERIES_COMPAT_microsoft-layer = "dunfell gatesgarth"
```

## meta-microsoft/meta-olympus/conf/layer.conf
```bitbake
# We have a conf and classes directory, add to BBPATH
BBPATH .= ":${LAYERDIR}"

# We have recipes-* directories, add to BBFILES
BBFILES += "${LAYERDIR}/recipes-*/*/*.bb \
	${LAYERDIR}/recipes-*/*/*.bbappend"

BBFILE_COLLECTIONS += "olympus-layer"
BBFILE_PATTERN_olympus-layer = "^${LAYERDIR}/"
BBFILE_PRIORITY_olympus-layer = "6"

LAYERSERIES_COMPAT_olympus-layer = "dunfell gatesgarth"
```

## meta-microsoft/meta-olympus/conf/machine/olympus.conf
```bitbake
KMACHINE = "aspeed"
KERNEL_DEVICETREE = "${KMACHINE}-bmc-microsoft-${MACHINE}.dtb"

require conf/machine/include/ast2400.inc
require conf/machine/include/obmc-bsp-common.inc

UBOOT_MACHINE_olympus = "ast_g4_phy_config"
UBOOT_ENTRYPOINT = "0x40008000"
UBOOT_LOADADDRESS = "0x40008000"

FLASH_SIZE = "32768"
```

## meta-nuvoton/conf/layer.conf
```bitbake
# We have a conf and classes directory, add to BBPATH
BBPATH .= ":${LAYERDIR}"

BBFILES += "${LAYERDIR}/recipes-*/*/*.bb \
            ${LAYERDIR}/recipes-*/*/*.bbappend"

BBFILE_COLLECTIONS += "nuvoton-layer"
BBFILE_PATTERN_nuvoton-layer := "^${LAYERDIR}/"
LAYERVERSION_nuvoton-layer = "1"
LAYERSERIES_COMPAT_nuvoton-layer = "scarthgap styhead"
LAYERDEPENDS_nuvoton-layer:append:npcm8xx = " meta-arm"

BBFILES_DYNAMIC += " \
    meta-arm:${LAYERDIR}/dynamic-layers/arm-layer/recipes-*/*/*.bb \
    meta-arm:${LAYERDIR}/dynamic-layers/arm-layer/recipes-*/*/*.bbappend \
"
```

## meta-nuvoton/conf/machine/evb-npcm750.conf
```bitbake
KMACHINE = "nuvoton"
KERNEL_DEVICETREE = "${KMACHINE}-npcm750-evb.dtb"

UBOOT_MACHINE = "PolegSVB_config"
IGPS_MACHINE = "EB"

FLASH_SIZE = "32768"

require conf/machine/include/npcm7xx.inc
require conf/machine/include/obmc-bsp-common.inc
require conf/machine/include/obmc-evb-common.inc

IMAGE_FSTYPES = "cpio.${INITRAMFS_CTYPE}.u-boot mtd-static"
```

## meta-nuvoton/conf/machine/evb-npcm845.conf
```bitbake
KMACHINE = "nuvoton"
KERNEL_DEVICETREE = "nuvoton/${KMACHINE}-npcm845-evb.dtb"

UBOOT_MACHINE = "arbel_evb_defconfig"
UBOOT_DEVICETREE = "nuvoton-npcm845-evb"

IGPS_MACHINE = "EB"
DEVICE_GEN = "A1"

require conf/machine/include/npcm8xx.inc
require conf/machine/include/obmc-bsp-common.inc
require conf/machine/include/tpm2.inc

FLASH_SIZE = "65536"
FLASH_UBOOT_OFFSET:flash-65536 = "0"
FLASH_MANIFEST_OFFSET:flash-65536 = "3832"
FLASH_UBOOT_ENV_OFFSET:flash-65536 = "3840"
FLASH_KERNEL_OFFSET:flash-65536 = "4096"
FLASH_ROFS_OFFSET:flash-65536 = "12288"
FLASH_RWFS_OFFSET:flash-65536 = "61440"

IMAGE_FSTYPES += "cpio.${INITRAMFS_CTYPE}.u-boot"
IMAGE_FSTYPES += "${@bb.utils.contains('DISTRO_FEATURES', \
        'phosphor-mmc', \
        'wic.gz mmc-ext4-tar', \
        '', d)}"

MACHINE_FEATURES += "\
        obmc-phosphor-fan-mgmt \
        obmc-phosphor-chassis-mgmt \
        obmc-phosphor-flash-mgmt \
        obmc-host-ipmi \
        obmc-host-state-mgmt \
        obmc-chassis-state-mgmt \
        obmc-bmc-state-mgmt \
        "

KCS_DEVICE = "ipmi-kcs1"

DISTRO_FEATURES:append = " ext2"
MACHINE_FEATURES:append = " ext2"

VIRTUAL-RUNTIME_obmc-host-state-manager ?= "x86-power-control"
VIRTUAL-RUNTIME_obmc-chassis-state-manager ?= "x86-power-control"

PREFERRED_PROVIDER_virtual/obmc-chassis-mgmt = "packagegroup-evb-npcm845-apps"
PREFERRED_PROVIDER_virtual/obmc-fan-mgmt = "packagegroup-evb-npcm845-apps"
PREFERRED_PROVIDER_virtual/obmc-flash-mgmt = "packagegroup-evb-npcm845-apps"
PREFERRED_PROVIDER_virtual/obmc-system-mgmt = "packagegroup-evb-npcm845-apps"
PREFERRED_PROVIDER_virtual/obmc-host-ipmi-hw = "phosphor-ipmi-kcs"
PREFERRED_PROVIDER_virtual/phosphor-led-manager-config-native = "evb-npcm845-led-manager-config-native"

# Remove unneeded binaries from image
IMAGE_FEATURES:remove = "obmc-fan-control"
IMAGE_FEATURES:remove = "obmc-health-monitor"

MACHINE_EXTRA_RRECOMMENDS = "kernel-modules"
```

## meta-nuvoton/conf/machine/include/igps-keys.inc
```bitbake
# There are two valid types: "openssl" or "HSM".
# Currently, default support openssl only.
SIGN_TYPE ?= "openssl"

KEY_BB_INDEX ?= "1"
SKMT_BL31_KEY_INDEX ?= "1"
SKMT_BL32_KEY_INDEX ?= "1"
SKMT_BL33_KEY_INDEX ?= "1"

KEY_BB_ID ?= "11"
KEY_BL31_ID ?= "11"
KEY_OPTEE_ID ?= "11"
KEY_UBOOT_ID ?= "11"

KEY_FOLDER ?= ""
KEY_FOLDER_DEFAULT ?= "${DEPLOY_DIR_IMAGE}/${SIGN_TYPE}"
KEY_BB ?= "skmt_ecc_key_1.der"
KEY_BL31 ?= "skmt_ecc_key_1.der"
KEY_OPTEE ?= "skmt_ecc_key_1.der"
KEY_UBOOT ?= "skmt_ecc_key_1.der"
```

## meta-nuvoton/conf/machine/include/keys.inc
```bitbake
KEY_SIGN ?= "openssl"

KEY_BB_INDEX ?= "1"
KEY_BL31_INDEX ?= "1"
KEY_OPTEE_INDEX ?= "1"
KEY_UBOOT_INDEX ?= "1"

KEY_BB_ID ?= "11"
KEY_BL31_ID ?= "11"
KEY_OPTEE_ID ?= "11"
KEY_UBOOT_ID ?= "11"

KEY_BB ?= "${HOME}/keys/openssl/skmt_ecc_key_1.der"
KEY_BL31 ?= "${HOME}/keys/openssl/skmt_ecc_key_1.der"
KEY_OPTEE ?= "${HOME}/keys/openssl/skmt_ecc_key_1.der"
KEY_UBOOT ?= "${HOME}/keys/openssl/skmt_ecc_key_1.der"
```

## meta-nuvoton/conf/machine/include/npcm7xx.inc
```bitbake
#@TYPE: Machine
#@NAME: Nuvoton NPCM7XX
#@DESCRIPTION: Common machine configuration for Nuvoton NPCM7XX Chip

require conf/machine/include/nuvoton.inc

KERNEL_IMAGETYPE ?= "uImage"
KERNEL_EXTRA_ARGS ?= "UIMAGE_LOADADDR=0x00008000"

UBOOT_MACHINE ?= "PolegSVB_config"
UBOOT_ENTRYPOINT ?= "0x00008000"
UBOOT_LOADADDRESS ?= "0x00008000"

FLASH_UBOOT_OFFSET = "0"
FLASH_UBOOT_ENV_OFFSET = "1024"
FLASH_KERNEL_OFFSET = "2048"
FLASH_UBI_OFFSET = "${FLASH_KERNEL_OFFSET}"
FLASH_ROFS_OFFSET = "7680"
FLASH_RWFS_OFFSET = "30720"

# UBI volume sizes in KB unless otherwise noted.
FLASH_UBI_RWFS_SIZE = "6144"
FLASH_UBI_RWFS_TXT_SIZE = "6MiB"

DEFAULTTUNE ?= "arm7a-novfp"

SERIAL_CONSOLES = "115200;ttyS3"

SOC_FAMILY = "npcm7xx"
include conf/machine/include/soc-family.inc
MACHINEOVERRIDES .= ":npcm7xx"

require conf/machine/include/tune-arm7a-novfp.inc
```

## meta-nuvoton/conf/machine/include/npcm8xx.inc
```bitbake
#@TYPE: Machine
#@NAME: Nuvoton NPCM8XX
#@DESCRIPTION: Common machine configuration for Nuvoton NPCM8XX Chip

require conf/machine/include/nuvoton.inc

KERNEL_IMAGETYPE ?= "Image"
KERNEL_EXTRA_ARGS ?= "UIMAGE_LOADADDR=0x00008000"

UBOOT_MACHINE ?= "ArbelEVB_defconfig"
UBOOT_ENTRYPOINT ?= "0"
UBOOT_LOADADDRESS ?= "0"

FLASH_SIZE ?= "32768"
FLASH_UBOOT_OFFSET ?= "0"
FLASH_KERNEL_OFFSET ?= "2048"
FLASH_ROFS_OFFSET ?= "8192"
FLASH_RWFS_OFFSET ?= "31744"

# UBI volume sizes in KB unless otherwise noted.
FLASH_UBI_RWFS_SIZE ?= "6144"
FLASH_UBI_RWFS_TXT_SIZE ?= "6MiB"

SERIAL_CONSOLES ?= "115200;ttyS0"

BB_ALIGN ?= "4096"
ATF_ALIGN ?= "4096"
OPTEE_ALIGN ?= "4096"
UBOOT_ALIGN ?= "4096"
ALIGN_END ?= "4096"

SOC_FAMILY = "npcm8xx"
include conf/machine/include/soc-family.inc
MACHINEOVERRIDES .= ":npcm8xx"

require conf/machine/include/arm/armv8a/tune-cortexa35.inc

PREFERRED_VERSION_trusted-firmware-a = "2.6.0"

UBOOT_MKIMAGE:append:npcm8xx = " -E -B 8"

COMPATIBLE_MACHINE:npcm8xx = "npcm8xx"
TFA_PLATFORM = "npcm845x"

# Nuvoton prefers optee for BL32.
TFA_SPD = "opteed"

# Nuvoton prefers u-boot as BL33.
TFA_UBOOT = "1"

# Nuvoton prefers TFA default build is BL31.
TFA_BUILD_TARGET = "bl31"

OPTEEMACHINE ?= "nuvoton"
```

## meta-nuvoton/conf/machine/include/nuvoton.inc
```bitbake
PREFERRED_PROVIDER_virtual/kernel ?= "linux-nuvoton"
PREFERRED_PROVIDER_virtual/bootloader ?= "u-boot-nuvoton"
PREFERRED_PROVIDER_u-boot ?= "u-boot-nuvoton"
PREFERRED_PROVIDER_u-boot-fw-utils ?= "u-boot-fw-utils-nuvoton"

WKS_FILE ?= "emmc-nuvoton.wks.in"
WKS_FILE_DEPENDS ?= " \
    virtual/kernel \
"
WKS_RWFS_SIZE ??= "256M"
WKS_ROFS_SIZE ??= "256M"
IMAGE_BOOT_FILES ?= "fitImage-${INITRAMFS_IMAGE}-${MACHINE}-${MACHINE};fitImage"
IMAGE_FSTYPES:remove:df-phosphor-mmc = "mtd-static mtd-static-tar mtd-static-alltar"

MACHINEOVERRIDES .= ":nuvoton"
MACHINE_EXTRA_RRECOMMENDS += "udev-nuvoton-mtd-partitions"
MACHINE_FEATURES += "hw-rng"
```

## meta-nuvoton/recipes-kernel/linux/linux-nuvoton/npcm8xx_defconfig
```kconfig
CONFIG_SYSVIPC=y
CONFIG_POSIX_MQUEUE=y
CONFIG_NO_HZ_IDLE=y
CONFIG_HIGH_RES_TIMERS=y
CONFIG_IRQ_TIME_ACCOUNTING=y
CONFIG_BSD_PROCESS_ACCT=y
CONFIG_BSD_PROCESS_ACCT_V3=y
CONFIG_TASK_XACCT=y
CONFIG_TASK_IO_ACCOUNTING=y
CONFIG_IKCONFIG=y
CONFIG_IKCONFIG_PROC=y
CONFIG_MEMCG=y
CONFIG_BLK_CGROUP=y
CONFIG_CGROUP_PIDS=y
CONFIG_CPUSETS=y
CONFIG_CGROUP_DEVICE=y
CONFIG_CGROUP_CPUACCT=y
CONFIG_USER_NS=y
CONFIG_SCHED_AUTOGROUP=y
CONFIG_BLK_DEV_INITRD=y
CONFIG_KALLSYMS_ALL=y
CONFIG_MODULES=y
CONFIG_MODULE_UNLOAD=y
CONFIG_ARCH_NPCM=y
CONFIG_ARCH_NPCM8XX=y
CONFIG_SMP=y
CONFIG_NET=y
CONFIG_PACKET=y
CONFIG_UNIX=y
CONFIG_INET=y
CONFIG_IP_PNP=y
CONFIG_IP_PNP_DHCP=y
CONFIG_IP_PNP_BOOTP=y
CONFIG_UEVENT_HELPER_PATH="/sbin/hotplug"
CONFIG_DEVTMPFS=y
CONFIG_MTD=y
CONFIG_MTD_BLOCK=y
CONFIG_MTD_RAM=y
CONFIG_MTD_COMPLEX_MAPPINGS=y
CONFIG_MTD_SPI_NOR=y
CONFIG_OF_OVERLAY=y
CONFIG_BLK_DEV_LOOP=y
CONFIG_BLK_DEV_NBD=y
CONFIG_BLK_DEV_RAM=y
CONFIG_BLK_DEV_RAM_COUNT=1
CONFIG_BLK_DEV_RAM_SIZE=8192
CONFIG_NPCM_LPC_BPC=y
CONFIG_NPCM_PCI_MBOX=y
CONFIG_SCSI=y
CONFIG_BLK_DEV_SD=y
CONFIG_NETDEVICES=y
CONFIG_STMMAC_ETH=y
CONFIG_BROADCOM_PHY=y
CONFIG_PINCTRL_NPCM8XX=y
CONFIG_I2C=y
CONFIG_I2C_CHARDEV=y
CONFIG_I2C_SLAVE=y
CONFIG_I2C_NPCM=y
CONFIG_I3C=y
CONFIG_I3CDEV=y
CONFIG_SVC_I3C_MASTER=y
CONFIG_SERIAL_8250=y
CONFIG_SERIAL_8250_CONSOLE=y
CONFIG_SERIAL_OF_PLATFORM=y
CONFIG_NPCM7XX_KCS_IPMI_BMC=y
CONFIG_HW_RANDOM=y
CONFIG_HW_RANDOM_NPCM=y
CONFIG_SPI=y
CONFIG_SPI_NPCM_PSPI=y
CONFIG_SPI_NPCM_FIU=y
CONFIG_GPIO_SYSFS=y
CONFIG_GPIO_GENERIC_PLATFORM=y
CONFIG_SENSORS_LM75=y
CONFIG_SENSORS_NPCM8XX=y
CONFIG_SENSORS_TMP102=y
CONFIG_WATCHDOG=y
CONFIG_NPCM7XX_WATCHDOG=y
CONFIG_USB_HIDDEV=y
CONFIG_USB=y
CONFIG_USB_ANNOUNCE_NEW_DEVICES=y
CONFIG_USB_EHCI_HCD=y
CONFIG_USB_EHCI_ROOT_HUB_TT=y
CONFIG_USB_OHCI_HCD=y
CONFIG_USB_STORAGE=y
CONFIG_USB_CHIPIDEA=y
CONFIG_USB_CHIPIDEA_UDC=y
CONFIG_USB_GADGET=y
CONFIG_USB_NPCM_UDC=y
CONFIG_USB_CONFIGFS=y
CONFIG_USB_CONFIGFS_F_HID=y
CONFIG_MMC=y
CONFIG_MMC_SDHCI=y
CONFIG_MMC_SDHCI_NPCM=y
CONFIG_ROMFS_FS=y
CONFIG_ROOT_NFS=y
CONFIG_NLS_CODEPAGE_437=y
CONFIG_NLS_ISO8859_1=y
CONFIG_MAGIC_SYSRQ=y
CONFIG_CRYPTO=y
CONFIG_CRYPTO_CBC=y
CONFIG_CRYPTO_ECB=y
CONFIG_CRYPTO_CTR=y
CONFIG_CRYPTO_CRC32C=y
CONFIG_CRYPTO_DEFLATE=y
CONFIG_CRYPTO_LZO=y
CONFIG_CRYPTO_USER_API_SKCIPHER=y
CONFIG_CRYPTO_DEV_NPCM=y
CONFIG_CRYPTO_DEV_NPCM_AES=y
CONFIG_CRYPTO_DEV_NPCM_SHA=y
CONFIG_CRYPTO_HMAC=y
CONFIG_CRYPTO_SHA256=y
CONFIG_CRYPTO_USER_API_HASH=y
CONFIG_NPCM750_OTP=y
CONFIG_ARM_CRYPTO=y
CONFIG_PCI=y
CONFIG_PCIE_NPCM=y
CONFIG_PECI=y
CONFIG_PECI_NPCM=y
CONFIG_SENSORS_PECI_CPUTEMP=y
CONFIG_SENSORS_PECI_DIMMTEMP=y
CONFIG_RESET_NPCM=y
CONFIG_SENSORS_NPCM7XX=y

CONFIG_IPMI_KCS_BMC_CDEV_IPMI=y
CONFIG_IPMI_KCS_BMC=y
CONFIG_NPCM7XX_KCS_IPMI_BMC=y
CONFIG_NPCM_VDM=y
CONFIG_REGULATOR=y
CONFIG_REGULATOR_FIXED_VOLTAGE=y
CONFIG_THERMAL=y
CONFIG_NPCM_THERMAL=y
CONFIG_DEBUG_INFO=y
CONFIG_DEBUG_KERNEL=y
CONFIG_MDIO_BITBANG=y
CONFIG_MDIO_GPIO=y
CONFIG_TMPFS=y
CONFIG_EXPERT=y

CONFIG_WATCHDOG_SYSFS=y

# Enable misc VCD/ECE driver for KVM
# CONFIG_NPCM750_VCD is not set
# CONFIG_NPCM750_ECE is not set

# Enable JTAG Master Support
CONFIG_NPCM8XX_JTAG_MASTER=y

# Enable OpenBMC FS support
CONFIG_OVERLAY_FS=y
CONFIG_JFFS2_FS=y
CONFIG_JFFS2_SUMMARY=y
CONFIG_JFFS2_FS_XATTR=y
CONFIG_SQUASHFS=y
CONFIG_SQUASHFS_XZ=y
CONFIG_SQUASHFS_DECOMP_MULTI=y
CONFIG_DEBUG_FS=y

# Enable EDAC support
CONFIG_EDAC_SUPPORT=y
CONFIG_EDAC=y
CONFIG_EDAC_NPCM=y
CONFIG_RAS=y

# Enable RemotePorc driver support
CONFIG_REMOTEPROC=y
CONFIG_NPCM8XX_REMOTEPROC=y

# Enable SGPIO Driver support
CONFIG_GPIOLIB=y
CONFIG_GPIO_NPCM_SGPIO=y

# Enable ADC
CONFIG_NPCM_ADC=y
CONFIG_IIO=y
CONFIG_SENSORS_IIO_HWMON=y

# CONFIG_VGA_ARB is not set
# CONFIG_VGA_ARB_MAX_GPUS is not set
CONFIG_COMMON_CLK_NPCM8XX=y
CONFIG_MMC_SDHCI_PLTFM=y
CONFIG_NTFS_FS=y
CONFIG_INPUT_MISC=y

CONFIG_NPCM_MBOX=y

# Enable TEE
CONFIG_TEE=y
CONFIG_OPTEE=y
```

## meta-nvidia/conf/layer.conf
```bitbake
# We have a conf and classes directory, add to BBPATH
BBPATH .= ":${LAYERDIR}"

# We have recipes-* directories, add to BBFILES
BBFILES += "${LAYERDIR}/recipes-*/*/*.bb \
            ${LAYERDIR}/recipes-*/*/*.bbappend"

BBFILE_COLLECTIONS += "nvidia-layer"
BBFILE_PATTERN_nvidia-layer := "^${LAYERDIR}/"
LAYERSERIES_COMPAT_nvidia-layer := "scarthgap styhead"
```

## meta-nvidia/conf/machine/include/nvidia.inc
```bitbake
DISTROOVERRIDES .= ":nvidia"

MACHINE_FEATURES += "\
        obmc-bmc-state-mgmt \
        obmc-phosphor-fan-mgmt \
        obmc-phosphor-flash-mgmt \
"

VIRTUAL-RUNTIME_skeleton_workbook = "${MACHINE}-config"

PREFERRED_PROVIDER_virtual/obmc-chassis-mgmt = "packagegroup-nvidia-apps"
PREFERRED_PROVIDER_virtual/obmc-fan-mgmt = "packagegroup-nvidia-apps"
PREFERRED_PROVIDER_virtual/obmc-flash-mgmt = "packagegroup-nvidia-apps"
PREFERRED_PROVIDER_virtual/obmc-inventory-data ?= "${VIRTUAL-RUNTIME_skeleton_workbook}"
PREFERRED_PROVIDER_virtual/obmc-system-mgmt = "packagegroup-nvidia-apps"

IMAGE_FEATURES:append = " allow-root-login"

SERIAL_CONSOLES:nvidia = "115200;ttyS4"
```

## meta-nvidia/meta-gb200nvl-obmc/conf/layer.conf
```bitbake
# We have a conf and classes directory, add to BBPATH
BBPATH .= ":${LAYERDIR}"

# We have recipes-* directories, add to BBFILES
BBFILES += " \
    ${LAYERDIR}/recipes-*/*/*.bb \
    ${LAYERDIR}/recipes-*/*/*.bbappend \
    ${LAYERDIR}/recipes-*/*/*/*.bbappend \
"

BBFILE_COLLECTIONS += "nvidia-gb200nvl-obmc-layer"
BBFILE_PATTERN_nvidia-gb200nvl-obmc-layer = "^${LAYERDIR}/"

LAYERSERIES_COMPAT_nvidia-gb200nvl-obmc-layer = "scarthgap styhead"
```
