## upstream-layers/meta-arm/meta-arm-bsp/recipes-kernel/linux/files/corstone1000/defconfig
```kconfig
CONFIG_LOCALVERSION="-yocto-standard"
# CONFIG_LOCALVERSION_AUTO is not set
CONFIG_HIGH_RES_TIMERS=y
CONFIG_PREEMPT=y
CONFIG_LOG_BUF_SHIFT=13
CONFIG_LOG_CPU_MAX_BUF_SHIFT=13
CONFIG_RELAY=y
CONFIG_BOOT_CONFIG=y
CONFIG_ARCH_VEXPRESS=y
CONFIG_CMDLINE="console=ttyAMA0 loglevel=9"
# CONFIG_SUSPEND is not set
# CONFIG_STACKPROTECTOR is not set
CONFIG_MODULES=y
# CONFIG_CORE_DUMP_DEFAULT_ELF_HEADERS is not set
CONFIG_NET=y
CONFIG_PACKET=y
CONFIG_UNIX=y
CONFIG_INET=y
CONFIG_IP_PNP=y
CONFIG_IP_PNP_DHCP=y
CONFIG_IP_PNP_BOOTP=y
CONFIG_SYN_COOKIES=y
CONFIG_NET_SCHED=y
CONFIG_DEVTMPFS=y
CONFIG_EFI_BOOTLOADER_CONTROL=y
CONFIG_EFI_CAPSULE_LOADER=y
CONFIG_EFI_TEST=y
CONFIG_RESET_ATTACK_MITIGATION=y
CONFIG_SCSI=y
CONFIG_BLK_DEV_SD=y
# CONFIG_BLK_DEV_BSG is not set
CONFIG_NETDEVICES=y
# CONFIG_NET_VENDOR_ALACRITECH is not set
# CONFIG_NET_VENDOR_AMAZON is not set
# CONFIG_NET_VENDOR_AMD is not set
# CONFIG_NET_VENDOR_AQUANTIA is not set
# CONFIG_NET_VENDOR_ARC is not set
# CONFIG_NET_VENDOR_BROADCOM is not set
# CONFIG_NET_VENDOR_CADENCE is not set
# CONFIG_NET_VENDOR_CAVIUM is not set
# CONFIG_NET_VENDOR_CORTINA is not set
# CONFIG_NET_VENDOR_EZCHIP is not set
# CONFIG_NET_VENDOR_GOOGLE is not set
# CONFIG_NET_VENDOR_HISILICON is not set
# CONFIG_NET_VENDOR_HUAWEI is not set
# CONFIG_NET_VENDOR_INTEL is not set
# CONFIG_NET_VENDOR_MARVELL is not set
# CONFIG_NET_VENDOR_MICREL is not set
# CONFIG_NET_VENDOR_MICROCHIP is not set
# CONFIG_NET_VENDOR_MICROSEMI is not set
# CONFIG_NET_VENDOR_NI is not set
# CONFIG_NET_VENDOR_NATSEMI is not set
# CONFIG_NET_VENDOR_NETRONOME is not set
# CONFIG_NET_VENDOR_PENSANDO is not set
# CONFIG_NET_VENDOR_QUALCOMM is not set
# CONFIG_NET_VENDOR_RENESAS is not set
# CONFIG_NET_VENDOR_ROCKER is not set
# CONFIG_NET_VENDOR_SAMSUNG is not set
# CONFIG_NET_VENDOR_SEEQ is not set
# CONFIG_NET_VENDOR_SOLARFLARE is not set
CONFIG_SMC91X=y
CONFIG_SMSC911X=y
# CONFIG_NET_VENDOR_SOCIONEXT is not set
# CONFIG_NET_VENDOR_STMICRO is not set
# CONFIG_NET_VENDOR_SYNOPSYS is not set
# CONFIG_NET_VENDOR_VIA is not set
# CONFIG_NET_VENDOR_WIZNET is not set
# CONFIG_NET_VENDOR_XILINX is not set
# CONFIG_SERIO_SERPORT is not set
CONFIG_SERIAL_AMBA_PL011=y
CONFIG_SERIAL_AMBA_PL011_CONSOLE=y
CONFIG_USB=y
CONFIG_USB_STORAGE=y
CONFIG_USB_UAS=y
CONFIG_USB_ISP1760=y
CONFIG_RTC_CLASS=y
CONFIG_RTC_DRV_PL031=y
CONFIG_TEE=y
CONFIG_OPTEE=y
CONFIG_VFAT_FS=y
CONFIG_TMPFS=y
CONFIG_CONFIGFS_FS=y
CONFIG_NLS_CODEPAGE_437=y
CONFIG_NLS_CODEPAGE_860=y
CONFIG_NLS_ISO8859_1=y
CONFIG_NLS_ISO8859_15=y
CONFIG_NLS_UTF8=y
CONFIG_LIBCRC32C=y
# CONFIG_SECTION_MISMATCH_WARN_ONLY is not set
CONFIG_DEBUG_FS=y
CONFIG_PANIC_TIMEOUT=5
CONFIG_REGULATOR=y
# CONFIG_REGULATOR_DEBUG is not set
CONFIG_REGULATOR_FIXED_VOLTAGE=y
# CONFIG_REGULATOR_VIRTUAL_CONSUMER is not set
# CONFIG_REGULATOR_USERSPACE_CONSUMER is not set
# CONFIG_REGULATOR_GPIO is not set
# CONFIG_REGULATOR_VCTRL is not set
# CONFIG_REGULATOR_VEXPRESS is not set
CONFIG_MMC=y
# CONFIG_PWRSEQ_EMMC is not set
CONFIG_PWRSEQ_SIMPLE=y
CONFIG_MMC_BLOCK=y
CONFIG_MMC_BLOCK_MINORS=8
# CONFIG_SDIO_UART is not set
# CONFIG_MMC_TEST is not set
# CONFIG_MMC_DEBUG is not set
CONFIG_MMC_ARMMMCI=y
# CONFIG_MMC_STM32_SDMMC is not set
# CONFIG_MMC_SDHCI is not set
# CONFIG_MMC_DW is not set
# CONFIG_MMC_VUB300 is not set
# CONFIG_MMC_USHC is not set
# CONFIG_MMC_USDHI6ROL0 is not set
# CONFIG_MMC_CQHCI is not set
# CONFIG_MMC_HSQ is not set
# CONFIG_MMC_MTK is not set
CONFIG_EXT2_FS=y
# CONFIG_EXT2_FS_XATTR is not set
CONFIG_EXT3_FS=y
CONFIG_EXT4_FS=y
# CONFIG_EXT4_FS_POSIX_ACL is not set
# CONFIG_EXT4_FS_SECURITY is not set
# CONFIG_EXT4_DEBUG is not set
```

## upstream-layers/meta-arm/meta-arm/conf/machine/include/arm/arch-armv8-7a.inc
```bitbake
DEFAULTTUNE ?= "armv8-7a"

TUNEVALID[armv8-7a] = "Enable instructions for ARMv8.7-a"
TUNE_CCARGS_MARCH .= "${@bb.utils.contains('TUNE_FEATURES', 'armv8-7a', ' -march=armv8.7-a', '', d)}"
MACHINEOVERRIDES =. "${@bb.utils.contains('TUNE_FEATURES', 'armv8-7a', 'armv8-7a:', '', d)}"

require conf/machine/include/arm/arch-armv8a.inc

# Little Endian base configs
AVAILTUNES += "armv8-7a"
ARMPKGARCH:tune-armv8-7a                    ?= "armv8-7a"
TUNE_FEATURES:tune-armv8-7a                  = "aarch64 armv8-7a"
PACKAGE_EXTRA_ARCHS:tune-armv8-7a            = "${PACKAGE_EXTRA_ARCHS:tune-armv8a} armv8-7a"
BASE_LIB:tune-armv8-7a                       = "lib64"
```

## upstream-layers/meta-arm/meta-arm/conf/machine/include/arm/arch-armv8-9a.inc
```bitbake
DEFAULTTUNE ?= "armv8-9a"

TUNEVALID[armv8-9a] = "Enable instructions for ARMv8.9-a"
TUNE_CCARGS_MARCH .= "${@bb.utils.contains('TUNE_FEATURES', 'armv8-9a', ' -march=armv8.9-a', '', d)}"
MACHINEOVERRIDES =. "${@bb.utils.contains('TUNE_FEATURES', 'armv8-9a', 'armv8-9a:', '', d)}"

require conf/machine/include/arm/arch-armv8a.inc

# Little Endian base configs
AVAILTUNES += "armv8-9a"
ARMPKGARCH:tune-armv8-9a                    ?= "armv8-9a"
TUNE_FEATURES:tune-armv8-9a                  = "aarch64 armv8-9a"
PACKAGE_EXTRA_ARCHS:tune-armv8-9a            = "${PACKAGE_EXTRA_ARCHS:tune-armv8a} armv8-9a"
BASE_LIB:tune-armv8-9a                       = "lib64"
```

## upstream-layers/meta-arm/meta-arm/conf/machine/include/arm/arch-armv9-1a.inc
```bitbake
DEFAULTTUNE ?= "armv9-1a"

TUNEVALID[armv9-1a] = "Enable instructions for ARMv9.1-a"
TUNE_CCARGS_MARCH .= "${@bb.utils.contains('TUNE_FEATURES', 'armv9-1a', ' -march=armv9.1-a', '', d)}"
MACHINEOVERRIDES =. "${@bb.utils.contains('TUNE_FEATURES', 'armv9-1a', 'armv9-1a:', '', d)}"

require conf/machine/include/arm/arch-armv9a.inc

AVAILTUNES                                  += "armv9-1a"
ARMPKGARCH:tune-armv9-1a                    ?= "armv9-1a"
TUNE_FEATURES:tune-armv9-1a                  = "aarch64 armv9-1a"
PACKAGE_EXTRA_ARCHS:tune-armv9-1a            = "${PACKAGE_EXTRA_ARCHS:tune-armv9a} armv9-1a"
BASE_LIB:tune-armv9-1a                       = "lib64"
```

## upstream-layers/meta-arm/meta-arm/conf/machine/include/arm/arch-armv9-2a.inc
```bitbake
DEFAULTTUNE ?= "armv9-2a"

TUNEVALID[armv9-2a] = "Enable instructions for ARMv9.2-a"
TUNE_CCARGS_MARCH .= "${@bb.utils.contains('TUNE_FEATURES', 'armv9-2a', ' -march=armv9.2-a', '', d)}"
MACHINEOVERRIDES =. "${@bb.utils.contains('TUNE_FEATURES', 'armv9-2a', 'armv9-2a:', '', d)}"

require conf/machine/include/arm/arch-armv9a.inc

AVAILTUNES                                  += "armv9-2a"
ARMPKGARCH:tune-armv9-2a                    ?= "armv9-2a"
TUNE_FEATURES:tune-armv9-2a                  = "aarch64 armv9-2a"
PACKAGE_EXTRA_ARCHS:tune-armv9-2a            = "${PACKAGE_EXTRA_ARCHS:tune-armv9a} armv9-2a"
BASE_LIB:tune-armv9-2a                       = "lib64"
```

## upstream-layers/meta-arm/meta-arm/conf/machine/include/arm/arch-armv9-3a.inc
```bitbake
DEFAULTTUNE ?= "armv9-3a"

TUNEVALID[armv9-3a] = "Enable instructions for ARMv9.3-a"
TUNE_CCARGS_MARCH .= "${@bb.utils.contains('TUNE_FEATURES', 'armv9-3a', ' -march=armv9.3-a', '', d)}"
MACHINEOVERRIDES =. "${@bb.utils.contains('TUNE_FEATURES', 'armv9-3a', 'armv9-3a:', '', d)}"

require conf/machine/include/arm/arch-armv9a.inc

AVAILTUNES                                  += "armv9-3a"
ARMPKGARCH:tune-armv9-3a                    ?= "armv9-3a"
TUNE_FEATURES:tune-armv9-3a                  = "aarch64 armv9-3a"
PACKAGE_EXTRA_ARCHS:tune-armv9-3a            = "${PACKAGE_EXTRA_ARCHS:tune-armv9a} armv9-3a"
BASE_LIB:tune-armv9-3a                       = "lib64"
```

## upstream-layers/meta-arm/meta-arm/conf/machine/include/arm/arch-armv9-4a.inc
```bitbake
DEFAULTTUNE ?= "armv9-4a"

TUNEVALID[armv9-4a] = "Enable instructions for ARMv9.4-a"
TUNE_CCARGS_MARCH .= "${@bb.utils.contains('TUNE_FEATURES', 'armv9-4a', ' -march=armv9.4-a', '', d)}"
MACHINEOVERRIDES =. "${@bb.utils.contains('TUNE_FEATURES', 'armv9-4a', 'armv9-4a:', '', d)}"

require conf/machine/include/arm/arch-armv9a.inc

AVAILTUNES                                  += "armv9-4a"
ARMPKGARCH:tune-armv9-4a                    ?= "armv9-4a"
TUNE_FEATURES:tune-armv9-4a                  = "aarch64 armv9-4a"
PACKAGE_EXTRA_ARCHS:tune-armv9-4a            = "${PACKAGE_EXTRA_ARCHS:tune-armv8a} armv9-4a"
BASE_LIB:tune-armv9-4a                       = "lib64"
```

## upstream-layers/meta-arm/meta-arm/conf/machine/include/arm/arch-armv9-5a.inc
```bitbake
DEFAULTTUNE ?= "armv9-5a"

TUNEVALID[armv9-5a] = "Enable instructions for ARMv9.5-a"
TUNE_CCARGS_MARCH .= "${@bb.utils.contains('TUNE_FEATURES', 'armv9-5a', ' -march=armv9.5-a', '', d)}"
MACHINEOVERRIDES =. "${@bb.utils.contains('TUNE_FEATURES', 'armv9-5a', 'armv9-5a:', '', d)}"

require conf/machine/include/arm/arch-armv9a.inc

AVAILTUNES                                  += "armv9-5a"
ARMPKGARCH:tune-armv9-5a                    ?= "armv9-5a"
TUNE_FEATURES:tune-armv9-5a                  = "aarch64 armv9-5a"
PACKAGE_EXTRA_ARCHS:tune-armv9-5a            = "${PACKAGE_EXTRA_ARCHS:tune-armv8a} armv9-5a"
BASE_LIB:tune-armv9-5a                       = "lib64"
```

## upstream-layers/meta-arm/meta-arm/conf/machine/qemuarm64-secureboot.conf
```bitbake
MACHINEOVERRIDES =. "qemuarm64:"

require ${COREBASE}/meta/conf/machine/qemuarm64.conf

KMACHINE = "qemuarm64"

# secure=on can't ever use KVM, so force it off
QEMU_USE_KVM = ""

QB_MACHINE = "-machine virt,secure=on,acpi=off"
QB_MEM = "-m 1024"
QB_DEFAULT_FSTYPE = "wic.qcow2"
QB_DEFAULT_BIOS = "flash.bin"
QB_FSINFO = "wic:no-kernel-in-fs"
QB_ROOTFS_OPT = ""
QB_KERNEL_ROOT = "/dev/vda2"

IMAGE_FSTYPES += "wic wic.qcow2"

WKS_FILE ?= "qemuarm64.wks"
WKS_FILE_DEPENDS:append = " trusted-firmware-a"
IMAGE_BOOT_FILES = "${KERNEL_IMAGETYPE}"

MACHINE_FEATURES += "optee-ftpm"
```

## upstream-layers/meta-arm/meta-arm/files/wic/qemuarm.wks
```
bootloader --ptable gpt --configfile="qemuarm.cfg"

part /boot --ondisk=vda --align 64 --size=100M --active --source bootimg-partition --fstype=ext4 --label boot --sourceparams="loader=u-boot"
part /     --ondisk=vda                                 --source rootfs            --fstype=ext4 --label root
```

## upstream-layers/meta-openembedded/meta-filesystems/conf/layer.conf
```bitbake
# We have a conf and classes directory, add to BBPATH
BBPATH .= ":${LAYERDIR}"

# We have recipes-* directories, add to BBFILES
BBFILES += "${LAYERDIR}/recipes-*/*/*.bb \
	${LAYERDIR}/recipes-*/*/*.bbappend"

BBFILE_COLLECTIONS += "filesystems-layer"
BBFILE_PATTERN_filesystems-layer = "^${LAYERDIR}/"
BBFILE_PRIORITY_filesystems-layer = "5"

# This should only be incremented on significant changes that will
# cause compatibility issues with other layers
LAYERVERSION_filesystems-layer = "1"

LAYERDEPENDS_filesystems-layer = "core openembedded-layer networking-layer"

LAYERSERIES_COMPAT_filesystems-layer = "walnascar whinlatter"

BBFILES_DYNAMIC += " \
    meta-python:${LAYERDIR}/dynamic-layers/meta-python/recipes-*/*/*.bb \
"

# List of known non-reproducible package of the meta-filesystems layer
# Please keep this list sorted
OEQA_REPRODUCIBLE_EXCLUDED_PACKAGES += " \
    e2tools-ptest \
"
```

## upstream-layers/meta-openembedded/meta-networking/conf/layer.conf
```bitbake
# We have a conf and classes directory, add to BBPATH
BBPATH .= ":${LAYERDIR}"

# We have a packages directory, add to BBFILES
BBFILES += "${LAYERDIR}/recipes-*/*/*.bb \
            ${LAYERDIR}/recipes-*/*/*.bbappend"

BBFILE_COLLECTIONS += "networking-layer"
BBFILE_PATTERN_networking-layer := "^${LAYERDIR}/"
BBFILE_PRIORITY_networking-layer = "5"

# This should only be incremented on significant changes that will
# cause compatibility issues with other layers
LAYERVERSION_networking-layer = "1"

LAYERDEPENDS_networking-layer = "core meta-python openembedded-layer"

LAYERSERIES_COMPAT_networking-layer = "walnascar whinlatter"

LICENSE_PATH += "${LAYERDIR}/licenses"

SIGGEN_EXCLUDE_SAFE_RECIPE_DEPS += " \
  wireguard-tools->wireguard-module \
  mdio-tools->mdio-netlink \
  ot-br-posix->ipset \
"
BBFILES_DYNAMIC += " \
    meta-python:${LAYERDIR}/dynamic-layers/meta-python/recipes-*/*/*.bb \
"

# List of known non-reproducible package of the meta-networking layer
# Please keep this list sorted
OEQA_REPRODUCIBLE_EXCLUDED_PACKAGES += " \
    babeld \
    babeld-dbg \
    dhcp-relay-staticdev \
    ettercap-src \
    freediameter \
    freeradius \
    htpdate-doc \
    libbearssl-staticdev \
    libmosquitto1 \
    libowfat-staticdev \
    libruli-staticdev \
    mosquitto \
    ncftp \
    ncp \
    ncp-dbg \
    ndisc6-dbg \
    ndisc6-misc \
    ndisc6-ndisc6 \
    ndisc6-rdisc6 \
    ndisc6-rdnssd \
    ndisc6-rltraceroute6 \
    netsniff-ng-doc \
    ntopng \
    ntopng-dbg \
    ntpsec-src \
    openl2tp \
    opensaf \
    phytool \
    phytool-dbg \
    postfix-cfg \
    rp-pppoe \
    traceroute \
    traceroute-dbg \
    udpcast-doc \
    unbound-doc \
    znc \
"
```
