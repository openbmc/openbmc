## poky/meta/conf/machine/include/arm/arch-armv8-2a.inc
```bitbake
DEFAULTTUNE ?= "armv8-2a"

TUNEVALID[armv8-2a] = "Enable instructions for ARMv8-a"
TUNE_CCARGS .= "${@bb.utils.contains('TUNE_FEATURES', 'armv8-2a', ' -march=armv8.2-a', '', d)}"
# TUNE crypto will be handled by arch-armv8a.inc below
MACHINEOVERRIDES =. "${@bb.utils.contains('TUNE_FEATURES', 'armv8-2a', 'armv8-2a:', '', d)}"

require conf/machine/include/arm/arch-armv8a.inc

# Little Endian base configs
AVAILTUNES += "armv8-2a armv8-2a-crypto"
ARMPKGARCH_tune-armv8-2a                    ?= "armv8-2a"
ARMPKGARCH_tune-armv8-2a-crypto             ?= "armv8-2a"
TUNE_FEATURES_tune-armv8-2a                  = "aarch64 armv8-2a"
TUNE_FEATURES_tune-armv8-2a-crypto           = "${TUNE_FEATURES_tune-armv8-2a} crypto"
PACKAGE_EXTRA_ARCHS_tune-armv8-2a            = "${PACKAGE_EXTRA_ARCHS_tune-armv8a} armv8-2a"
PACKAGE_EXTRA_ARCHS_tune-armv8-2a-crypto     = "${PACKAGE_EXTRA_ARCHS_tune-armv8-2a} armv8-2a-crypto"
BASE_LIB_tune-armv8-2a                       = "lib64"
BASE_LIB_tune-armv8-2a-crypto                = "lib64"
```

## poky/meta/conf/machine/include/arm/arch-armv8-3a.inc
```bitbake
DEFAULTTUNE ?= "armv8-3a"

TUNEVALID[armv8-3a] = "Enable instructions for ARMv8.3-a"
TUNE_CCARGS_MARCH .= "${@bb.utils.contains('TUNE_FEATURES', 'armv8-3a', ' -march=armv8.3-a', '', d)}"
# TUNE crypto will be handled by arch-armv8a.inc below
MACHINEOVERRIDES =. "${@bb.utils.contains('TUNE_FEATURES', 'armv8-3a', 'armv8-3a:', '', d)}"

require conf/machine/include/arm/arch-armv8a.inc

AVAILTUNES                                  += "armv8-3a armv8-3a-crypto armv8-3a-crypto-sve"
ARMPKGARCH:tune-armv8-3a                    ?= "armv8-3a"
ARMPKGARCH:tune-armv8-3a-crypto             ?= "armv8-3a"
ARMPKGARCH:tune-armv8-3a-crypto-sve         ?= "armv8-3a"
TUNE_FEATURES:tune-armv8-3a                  = "aarch64 armv8-3a"
TUNE_FEATURES:tune-armv8-3a-crypto           = "${TUNE_FEATURES:tune-armv8-3a} crypto"
TUNE_FEATURES:tune-armv8-3a-crypto-sve       = "${TUNE_FEATURES:tune-armv8-3a-crypto} sve"
PACKAGE_EXTRA_ARCHS:tune-armv8-3a            = "${PACKAGE_EXTRA_ARCHS:tune-armv8a} armv8-3a"
PACKAGE_EXTRA_ARCHS:tune-armv8-3a-crypto     = "${PACKAGE_EXTRA_ARCHS:tune-armv8-3a} armv8-3a-crypto"
PACKAGE_EXTRA_ARCHS:tune-armv8-3a-crypto-sve = "${PACKAGE_EXTRA_ARCHS:tune-armv8-3a-crypto} armv8-3a-crypto-sve"
BASE_LIB:tune-armv8-3a                       = "lib64"
BASE_LIB:tune-armv8-3a-crypto                = "lib64"
BASE_LIB:tune-armv8-3a-crypto-sve            = "lib64"
```

## poky/meta/conf/machine/include/arm/arch-armv8-4a.inc
```bitbake
DEFAULTTUNE ?= "armv8-4a"

TUNEVALID[armv8-4a] = "Enable instructions for ARMv8.4-a"
TUNE_CCARGS_MARCH .= "${@bb.utils.contains('TUNE_FEATURES', 'armv8-4a', ' -march=armv8.4-a', '', d)}"
# TUNE crypto will be handled by arch-armv8a.inc below
MACHINEOVERRIDES =. "${@bb.utils.contains('TUNE_FEATURES', 'armv8-4a', 'armv8-4a:', '', d)}"

require conf/machine/include/arm/arch-armv8a.inc

# Little Endian base configs
AVAILTUNES += "armv8-4a armv8-4a-crypto"
ARMPKGARCH:tune-armv8-4a                    ?= "armv8-4a"
ARMPKGARCH:tune-armv8-4a-crypto             ?= "armv8-4a"
TUNE_FEATURES:tune-armv8-4a                  = "aarch64 armv8-4a"
TUNE_FEATURES:tune-armv8-4a-crypto           = "${TUNE_FEATURES:tune-armv8-4a} crypto"
PACKAGE_EXTRA_ARCHS:tune-armv8-4a            = "${PACKAGE_EXTRA_ARCHS:tune-armv8a} armv8-4a"
PACKAGE_EXTRA_ARCHS:tune-armv8-4a-crypto     = "${PACKAGE_EXTRA_ARCHS:tune-armv8-4a} armv8-4a-crypto"
BASE_LIB:tune-armv8-4a                       = "lib64"
BASE_LIB:tune-armv8-4a-crypto                = "lib64"
```

## poky/meta/conf/machine/include/arm/arch-armv8-6a.inc
```bitbake
DEFAULTTUNE ?= "armv8-6a"

TUNEVALID[armv8-6a] = "Enable instructions for ARMv8.6-a"
TUNE_CCARGS_MARCH .= "${@bb.utils.contains('TUNE_FEATURES', 'armv8-6a', ' -march=armv8.6-a', '', d)}"
# TUNE crypto will be handled by arch-armv8a.inc below
MACHINEOVERRIDES =. "${@bb.utils.contains('TUNE_FEATURES', 'armv8-6a', 'armv8-6a:', '', d)}"

require conf/machine/include/arm/arch-armv8a.inc

AVAILTUNES                                  += "armv8-6a armv8-6a-crypto armv8-6a-crypto-sve"
ARMPKGARCH:tune-armv8-6a                    ?= "armv8-6a"
ARMPKGARCH:tune-armv8-6a-crypto             ?= "armv8-6a"
ARMPKGARCH:tune-armv8-6a-crypto-sve         ?= "armv8-6a"
TUNE_FEATURES:tune-armv8-6a                  = "aarch64 armv8-6a"
TUNE_FEATURES:tune-armv8-6a-crypto           = "${TUNE_FEATURES:tune-armv8-6a} crypto"
TUNE_FEATURES:tune-armv8-6a-crypto-sve       = "${TUNE_FEATURES:tune-armv8-6a-crypto} sve"
PACKAGE_EXTRA_ARCHS:tune-armv8-6a            = "${PACKAGE_EXTRA_ARCHS:tune-armv8a} armv8-6a"
PACKAGE_EXTRA_ARCHS:tune-armv8-6a-crypto     = "${PACKAGE_EXTRA_ARCHS:tune-armv8-6a} armv8-6a-crypto"
PACKAGE_EXTRA_ARCHS:tune-armv8-6a-crypto-sve = "${PACKAGE_EXTRA_ARCHS:tune-armv8-6a-crypto} armv8-6a-crypto-sve"
BASE_LIB:tune-armv8-6a                       = "lib64"
BASE_LIB:tune-armv8-6a-crypto                = "lib64"
BASE_LIB:tune-armv8-6a-crypto-sve            = "lib64"
```

## poky/meta/conf/machine/include/arm/arch-armv8a.inc
```bitbake
DEFAULTTUNE ?= "armv8a-crc"

TUNEVALID[armv8a] = "Enable instructions for ARMv8-a"
TUNE_CCARGS_MARCH .= "${@bb.utils.contains('TUNE_FEATURES', 'armv8a', ' -march=armv8-a', '', d)}"
MACHINEOVERRIDES =. "${@bb.utils.contains('TUNE_FEATURES', 'armv8a', 'armv8a:', '', d)}"

require conf/machine/include/arm/arch-arm64.inc
require conf/machine/include/arm/feature-arm-crc.inc
require conf/machine/include/arm/feature-arm-crypto.inc

# Little Endian base configs
AVAILTUNES += "armv8a armv8a-crc armv8a-crc-crypto armv8a-crypto"
ARMPKGARCH:tune-armv8a                    ?= "armv8a"
ARMPKGARCH:tune-armv8a-crc                ?= "armv8a"
ARMPKGARCH:tune-armv8a-crypto             ?= "armv8a"
ARMPKGARCH:tune-armv8a-crc-crypto         ?= "armv8a"
TUNE_FEATURES:tune-armv8a                  = "aarch64 armv8a"
TUNE_FEATURES:tune-armv8a-crc              = "${TUNE_FEATURES:tune-armv8a} crc"
TUNE_FEATURES:tune-armv8a-crypto           = "${TUNE_FEATURES:tune-armv8a} crypto"
TUNE_FEATURES:tune-armv8a-crc-crypto       = "${TUNE_FEATURES:tune-armv8a-crc} crypto"
PACKAGE_EXTRA_ARCHS:tune-armv8a            = "aarch64 armv8a"
PACKAGE_EXTRA_ARCHS:tune-armv8a-crc        = "${PACKAGE_EXTRA_ARCHS:tune-armv8a} armv8a-crc"
PACKAGE_EXTRA_ARCHS:tune-armv8a-crypto     = "${PACKAGE_EXTRA_ARCHS:tune-armv8a} armv8a-crypto"
PACKAGE_EXTRA_ARCHS:tune-armv8a-crc-crypto = "${PACKAGE_EXTRA_ARCHS:tune-armv8a-crc} armv8a-crypto armv8a-crc-crypto"
BASE_LIB:tune-armv8a                       = "lib64"
BASE_LIB:tune-armv8a-crc                   = "lib64"
BASE_LIB:tune-armv8a-crypto                = "lib64"
BASE_LIB:tune-armv8a-crc-crypto            = "lib64"
```

## poky/meta/conf/machine/include/arm/arch-armv8m-main.inc
```bitbake
#
# Defaults for ARMv8-m.main
#
DEFAULTTUNE ?= "armv8m-main"

require conf/machine/include/arm/arch-armv8m-base.inc

TUNEVALID[armv8m-main] = "Enable instructions for ARMv8-m.main"
TUNE_CCARGS .= "${@bb.utils.contains('TUNE_FEATURES', 'armv8m-main', ' -march=armv8-m.main${MARCH_DSP}${MARCH_FPU}', '', d)}"
MACHINEOVERRIDES =. "${@bb.utils.contains('TUNE_FEATURES', 'armv8m-main', 'armv8m-main:', '', d)}"

TUNECONFLICTS[armv8m-main] = "armv4 armv5 armv6 armv7a"

# FIXME - below taken from meta/conf/machine/include/arm/arch-armv5-dsp.inc and should be put into something more generic
TUNEVALID[dsp] = "ARM DSP functionality"
ARMPKGSFX_DSP = "${@bb.utils.contains('TUNE_FEATURES', [ 'dsp' ], 'e', '', d)}"
MARCH_DSP = "${@bb.utils.contains('TUNE_FEATURES', [ 'dsp' ], '+dsp', '+nodsp', d)}"

# FIXME - Below belongs in meta/conf/machine/include/arm/feature-arm-neon.inc
TUNEVALID[vfpv5spd16] = "Enable Vector Floating Point Version 5, Single Precision. with 16 registers (fpv5-sp-d16) unit."
TUNE_CCARGS_MFPU .= "${@bb.utils.contains('TUNE_FEATURES', 'vfpv5spd16', 'fpv5-sp-d16', '', d)}"
MARCH_FPU = "${@bb.utils.contains('TUNE_FEATURES', [ 'vfpv5spd16' ], '+fp', '+nofp', d)}"

AVAILTUNES                                      += "armv8m-main armv8m-mainearmv8m-main-vfpv5spd16 armv8m-maine-vfpv5spd16"
ARMPKGARCH:tune-armv8m-main                      = "armv8m-main"
ARMPKGARCH:tune-armv8m-maine                     = "armv8m-main"
ARMPKGARCH:tune-armv8m-main-vfpv5spd16           = "armv8m-main"
ARMPKGARCH:tune-armv8m-maine-vfpv5spd16          = "armv8m-main"
TUNE_FEATURES:tune-armv8m-main                   = "armv8m-main"
TUNE_FEATURES:tune-armv8m-maine                  = "${TUNE_FEATURES:tune-armv8m-main} dsp"
TUNE_FEATURES:tune-armv8m-main-vfpv5spd16        = "${TUNE_FEATURES:tune-armv8m-main} vfpv5spd16"
TUNE_FEATURES:tune-armv8m-maine-vfpv5spd16       = "${TUNE_FEATURES:tune-armv8m-main-vfpv5spd16} dsp"
PACKAGE_EXTRA_ARCHS:tune-armv8m-main             = "armv8m-main"
PACKAGE_EXTRA_ARCHS:tune-armv8m-maine            = "${PACKAGE_EXTRA_ARCHS:tune-armv8m-main} armv8m-maine"
PACKAGE_EXTRA_ARCHS:tune-armv8m-main-vfpv5spd16  = "${PACKAGE_EXTRA_ARCHS:tune-armv8m-main} armv8m-main-fpv5-spd16"
PACKAGE_EXTRA_ARCHS:tune-armv8m-maine-vfpv5spd16 = "${PACKAGE_EXTRA_ARCHS:tune-armv8m-main} armv8m-maine-fpv5-spd16"
```

## poky/meta/conf/machine/include/arm/arch-armv8r.inc
```bitbake
#
# Defaults for ARMv8-r
#
DEFAULTTUNE ?= "armv8r"

TUNEVALID[armv8r] = "Enable instructions for ARMv8-r"
TUNE_CCARGS_MARCH .= "${@bb.utils.contains('TUNE_FEATURES', 'armv8r', ' -march=armv8-r', '', d)}"
MACHINEOVERRIDES =. "${@bb.utils.contains('TUNE_FEATURES', 'armv8r', 'armv8r:', '', d)}"

require conf/machine/include/arm/arch-arm64.inc
require conf/machine/include/arm/feature-arm-crc.inc
require conf/machine/include/arm/feature-arm-crypto.inc
require conf/machine/include/arm/feature-arm-sve.inc

# All ARMv8 has floating point hardware built in.  Null it here to avoid any confusion for 32bit.
TARGET_FPU_32 = ""

AVAILTUNES += "armv8r armv8r-crc armv8r-crypto armv8r-simd armv8r-crc-crypto armv8r-crc-simd armv8r-crc-crypto-simd"
ARMPKGARCH:tune-armv8r                          = "armv8r"
ARMPKGARCH:tune-armv8r-crc                      = "armv8r"
ARMPKGARCH:tune-armv8r-crypto                   = "armv8r"
ARMPKGARCH:tune-armv8r-simd                     = "armv8r"
ARMPKGARCH:tune-armv8r-crc-crypto               = "armv8r"
ARMPKGARCH:tune-armv8r-crc-simd                 = "armv8r"
ARMPKGARCH:tune-armv8r-crc-crypto-simd          = "armv8r"
TUNE_FEATURES:tune-armv8r                       = "armv8r"
TUNE_FEATURES:tune-armv8r-crc                   = "${TUNE_FEATURES:tune-armv8r} crc"
TUNE_FEATURES:tune-armv8r-crypto                = "${TUNE_FEATURES:tune-armv8r} crypto"
TUNE_FEATURES:tune-armv8r-simd                  = "${TUNE_FEATURES:tune-armv8r} simd"
TUNE_FEATURES:tune-armv8r-crc-crypto            = "${TUNE_FEATURES:tune-armv8r-crc} crypto"
TUNE_FEATURES:tune-armv8r-crc-simd              = "${TUNE_FEATURES:tune-armv8r-crc} simd"
TUNE_FEATURES:tune-armv8r-crc-crypto-simd       = "${TUNE_FEATURES:tune-armv8r-crc-crypto} simd"
PACKAGE_EXTRA_ARCHS:tune-armv8r                 = "armv8r"
PACKAGE_EXTRA_ARCHS:tune-armv8r-crc             = "${PACKAGE_EXTRA_ARCHS:tune-armv8r} armv8r-crc"
PACKAGE_EXTRA_ARCHS:tune-armv8r-crypto          = "${PACKAGE_EXTRA_ARCHS:tune-armv8r} armv8r-crypto"
PACKAGE_EXTRA_ARCHS:tune-armv8r-simd            = "${PACKAGE_EXTRA_ARCHS:tune-armv8r} armv8r-simd"
PACKAGE_EXTRA_ARCHS:tune-armv8r-crc-simd        = "${PACKAGE_EXTRA_ARCHS:tune-armv8r-crc} armv8r-simd armv8r-crc-simd"
PACKAGE_EXTRA_ARCHS:tune-armv8r-crc-crypto-simd = "${PACKAGE_EXTRA_ARCHS:tune-armv8r-crc-simd} armv8r-crc-crypto-simd"
```

## poky/meta/conf/machine/include/arm/arch-armv9a.inc
```bitbake
DEFAULTTUNE ?= "armv9a"

TUNEVALID[armv9a] = "Enable instructions for ARMv9-a"
TUNE_CCARGS_MARCH .= "${@bb.utils.contains('TUNE_FEATURES', 'armv9a', ' -march=armv9-a', '', d)}"
MACHINEOVERRIDES =. "${@bb.utils.contains('TUNE_FEATURES', 'armv9a', 'armv9a:', '', d)}"

require conf/machine/include/arm/arch-arm64.inc
require conf/machine/include/arm/feature-arm-crypto.inc

# Little Endian base configs
AVAILTUNES += "armv9a armv9a-crypto"
ARMPKGARCH:tune-armv9a                     ?= "armv9a"
ARMPKGARCH:tune-armv9a-crypto              ?= "armv9a"
TUNE_FEATURES:tune-armv9a                  = "aarch64 armv9a"
TUNE_FEATURES:tune-armv9a-crypto           = "${TUNE_FEATURES:tune-armv9a} crypto"
PACKAGE_EXTRA_ARCHS:tune-armv9a            = "aarch64 armv9a"
PACKAGE_EXTRA_ARCHS:tune-armv9a-crypto     = "${PACKAGE_EXTRA_ARCHS:tune-armv9a} armv9a-crypto"
BASE_LIB:tune-armv9a                       = "lib64"
BASE_LIB:tune-armv9a-crypto                = "lib64"
```

## poky/meta/conf/machine/include/arm/armv4/tune-strongarm1100.inc
```bitbake
DEFAULTTUNE ?= "strongarm"

require conf/machine/include/arm/arch-armv4.inc

TUNEVALID[strongarm] = "Enable Strongarm 1100 series processor optimizations"
TUNE_CCARGS .= "${@bb.utils.contains('TUNE_FEATURES', 'strongarm', ' -mcpu=strongarm1100', '', d)}"
MACHINEOVERRIDES =. "${@bb.utils.contains('TUNE_FEATURES', 'strongarm', 'armv4:', '', d)}"

AVAILTUNES += "strongarm"
ARMPKGARCH:tune-strongarm = "strongarm"
TUNE_FEATURES:tune-strongarm = "arm strongarm"
PACKAGE_EXTRA_ARCHS:tune-strongarm = "${PACKAGE_EXTRA_ARCHS:tune-armv4} strongarm"
```

## poky/meta/conf/machine/include/arm/armv5/tune-arm926ejs.inc
```bitbake
DEFAULTTUNE ?= "armv5te"

require conf/machine/include/arm/arch-armv5-dsp.inc

TUNEVALID[arm926ejs] = "Enable arm926ejs specific processor optimizations"
TUNE_CCARGS .= "${@bb.utils.contains('TUNE_FEATURES', 'arm926ejs', ' -mcpu=arm926ej-s', '', d)}"
MACHINEOVERRIDES =. "${@bb.utils.contains('TUNE_FEATURES', 'arm926ejs', 'armv5:', '', d)}"

AVAILTUNES += "arm926ejs"
ARMPKGARCH:tune-arm926ejs = "arm926ejs"
# mcpu is used so don't use armv5te as we don't want march
TUNE_FEATURES:tune-arm926ejs = "arm thumb dsp arm926ejs"
PACKAGE_EXTRA_ARCHS:tune-arm926ejs = "${PACKAGE_EXTRA_ARCHS:tune-armv5te} arm926ejste arm926ejse"
```

## poky/meta/conf/machine/include/arm/armv5/tune-xscale.inc
```bitbake
DEFAULTTUNE ?= "armv5te"

require conf/machine/include/arm/arch-armv5-dsp.inc

TUNEVALID[xscale] = "Enable PXA255/PXA26x Xscale specific processor optimizations"
TUNE_CCARGS .= "${@bb.utils.contains('TUNE_FEATURES', 'xscale', ' -mcpu=xscale', '', d)}"
MACHINEOVERRIDES =. "${@bb.utils.contains('TUNE_FEATURES', 'xscale', 'armv5:', '', d)}"

AVAILTUNES += "xscale"
ARMPKGARCH:tune-xscale = "xscale"
# mcpu is used so don't use armv5te as we don't want march
TUNE_FEATURES:tune-xscale = "arm thumb dsp xscale"
PACKAGE_EXTRA_ARCHS:tune-xscale = "${PACKAGE_EXTRA_ARCHS:tune-armv5te} xscale xscalet xscalee xscalete"

AVAILTUNES += "xscale-be"
ARMPKGARCH:tune-xscale-be = "xscale"
# mcpu is used so don't use armv5te as we don't want march
TUNE_FEATURES:tune-xscale-be = "${TUNE_FEATURES:tune-xscale} bigendian"
PACKAGE_EXTRA_ARCHS:tune-xscale-be = "${PACKAGE_EXTRA_ARCHS:tune-armv5teb} xscaleb xscaletb xscaleeb xscaleteb"
```

## poky/meta/conf/machine/include/arm/armv6/tune-arm1176jz-s.inc
```bitbake
DEFAULTTUNE ?= "arm1176jzs"

require conf/machine/include/arm/arch-armv6.inc

TUNEVALID[arm1176jzs] = "Enable arm1176jzs specific processor optimizations"
TUNE_CCARGS .= "${@bb.utils.contains('TUNE_FEATURES', 'arm1176jzs', ' -mcpu=arm1176jz-s', '', d)}"
MACHINEOVERRIDES =. "${@bb.utils.contains('TUNE_FEATURES', 'arm1176jzs', 'armv6:', '', d)}"

AVAILTUNES += "arm1176jzs"
ARMPKGARCH:tune-arm1176jzs = "arm1176jzs"
TUNE_FEATURES:tune-arm1176jzs = "arm thumb arm1176jzs"
PACKAGE_EXTRA_ARCHS:tune-arm1176jzs = "${PACKAGE_EXTRA_ARCHS:tune-armv6t-novfp} arm1176jzs arm1176jzst"

AVAILTUNES += "arm1176jzs-be"
ARMPKGARCH:tune-arm1176jzs-be = "${ARMPKGARCH:tune-arm1176jzs}"
TUNE_FEATURES:tune-arm1176jzs-be = "${TUNE_FEATURES:tune-arm1176jzs} bigendian"
PACKAGE_EXTRA_ARCHS:tune-arm1176jzs-be = "${PACKAGE_EXTRA_ARCHS:tune-armv6tb-novfp} arm1176jzsb arm1176jzstb"
```
