## poky/meta/conf/distro/include/init-manager-mdev-busybox.inc
```bitbake
# enable mdev/busybox for init
DISTRO_FEATURES_BACKFILL_CONSIDERED_append = " systemd sysvinit"
VIRTUAL-RUNTIME_dev_manager ??= "busybox-mdev"
VIRTUAL-RUNTIME_init_manager ??= "busybox"
VIRTUAL-RUNTIME_initscripts ??= "initscripts"
VIRTUAL-RUNTIME_keymaps ??= "keymaps"
VIRTUAL-RUNTIME_login_manager ??= "busybox"
```

## poky/meta/conf/distro/include/init-manager-none.inc
```bitbake
VIRTUAL-RUNTIME_init_manager ??= "sysvinit"
VIRTUAL-RUNTIME_initscripts ??= "initscripts"
VIRTUAL-RUNTIME_login_manager ??= "busybox"
```

## poky/meta/conf/distro/include/init-manager-systemd.inc
```bitbake
# Use systemd for system initialization
DISTRO_FEATURES:append = " systemd usrmerge"
DISTRO_FEATURES_BACKFILL_CONSIDERED:append = " sysvinit"
VIRTUAL-RUNTIME_init_manager ??= "systemd"
VIRTUAL-RUNTIME_initscripts ??= "systemd-compat-units"
VIRTUAL-RUNTIME_login_manager ??= "shadow-base"
VIRTUAL-RUNTIME_dev_manager ??= "systemd"
# systemd hardcodes /root in its source codes, other values are not offically supported
ROOT_HOME ?= "/root"
```

## poky/meta/conf/distro/include/init-manager-sysvinit.inc
```bitbake
# Use sysvinit for system initialization
DISTRO_FEATURES:append = " sysvinit"
DISTRO_FEATURES_BACKFILL_CONSIDERED:append = " systemd"
VIRTUAL-RUNTIME_init_manager ??= "sysvinit"
VIRTUAL-RUNTIME_initscripts ??= "initscripts"
VIRTUAL-RUNTIME_login_manager ??= "busybox"
```

## poky/meta/conf/distro/include/lto.inc
```bitbake
# To enable LTO, add following in local.conf
# require conf/distro/include/lto.inc
# DISTRO_FEATURES:append = " lto"
#

# Disable LTO for following packages
LTO:pn-glibc = ""
LTO:pn-gcc-runtime = ""
LTO:pn-libgcc-initial = ""
LTO:pn-libgcc = ""
LTO:pn-libaio = ""
LTO:pn-libpam = ""
LTO:pn-elfutils = ""
LTO:pn-perl = ""
LTO:pn-busybox = ""
LTO:pn-libxcrypt = ""
LTO:pn-curl = ""
LTO:pn-libcap = ""
LTO:pn-libproxy = ""
LTO:pn-libbsd = ""
LTO:pn-perf = ""
# webkit is not linking properly with LTO, disable until next time
LTO:pn-webkitgtk = ""
LTO:pn-xserver-xorg = ""
LTO:pn-grub = ""
LTO:pn-grub-efi = ""

# Custom LTO flags
# disable partitioning/streaming algorithm since its uses ASM
# constructs not compatible with lto
LTOEXTRA:pn-alsa-lib = "-flto-partition=none"

LTOEXTRA ?= ""

# Override it for additional or different options if needed e.g.
# with clang thin-lto might be better for compile speed
#
# ffat-lto-objects
# object files that contain both the intermediate
# language and the object code. This makes them
# usable for both LTO linking and normal linking
#
# -fuse-linker-plugin
# ensures that libraries participate in LTO by supplying intermediate
# code from .a files to linker
LTO ?= "-flto -ffat-lto-objects -fuse-linker-plugin ${LTOEXTRA}"

SELECTED_OPTIMIZATION:append = "${@bb.utils.contains('DISTRO_FEATURES', 'lto', ' ${LTO}', '', d)}"
TARGET_LDFLAGS:append:class-target = "${@bb.utils.contains('DISTRO_FEATURES', 'lto', ' ${LTO}', '', d)}"

SELECTED_OPTIMIZATION[vardeps] += "LTO LTOEXTRA"
```

## poky/meta/conf/distro/include/no-gplv3.inc
```bitbake
#
# This include file is to document commonly used configuration options to minimise
# GPLv3 content in images.
#
# The intent is to allow some images/configurations to build, not everything. There
# will be a cost in reduced functionality.

# Settings for full-cmdline
RDEPENDS:packagegroup-core-full-cmdline-utils:remove = "bash bc coreutils cpio ed findutils gawk grep mc mc-shell mc-helpers mc-helpers-perl sed tar time"
RDEPENDS:packagegroup-core-full-cmdline-dev-utils:remove = "diffutils m4 make patch"
RDEPENDS:packagegroup-core-full-cmdline-multiuser:remove = "gzip"

# Settings for weston
# direct gpl3 dependencies
RRECOMMENDS:packagegroup-base-vfat:remove = "dosfstools"
PACKAGECONFIG:remove:pn-bluez5 = "readline"

# dnf pulls in gpg which is gpl3; it also pulls in python3-rpm which pulls in rpm-build which pulls in bash
# so install rpm but not dnf
IMAGE_FEATURES:remove:pn-core-image-weston = "package-management"
CORE_IMAGE_EXTRA_INSTALL:pn-core-image-weston += "rpm"
IMAGE_FEATURES:remove:pn-core-image-full-cmdline = "package-management"
CORE_IMAGE_EXTRA_INSTALL:pn-core-image-full-cmdline += "rpm"

# matchbox-terminal depends on vte, which is gpl3
CORE_IMAGE_BASE_INSTALL:remove:pn-core-image-weston = "matchbox-terminal"

# Some python-tests use bash outside of ptest
RDEPENDS:${PN}-tests:remove:class-target:pn-python3 = "${MLPREFIX}bash"
INSANE_SKIP:${PN}-tests:pn-python3 = "file-rdeps"
```

## poky/meta/conf/distro/include/no-static-libs.inc
```bitbake
DISABLE_STATIC ?= " --disable-static"

# qemu aborts on unrecognised option
DISABLE_STATIC:pn-qemu = ""
DISABLE_STATIC:pn-qemu-native = ""
DISABLE_STATIC:pn-nativesdk-qemu = ""
DISABLE_STATIC:pn-qemu-system-native = ""
# needed by gdb
DISABLE_STATIC:pn-readline = ""
# openjade/sgml-common have build issues without static libs
DISABLE_STATIC:pn-sgml-common-native = ""
DISABLE_STATIC:pn-openjade-native = ""
# openssl has build issues without static libs
DISABLE_STATIC:pn-openssl = ""
DISABLE_STATIC:pn-openssl-native = ""
DISABLE_STATIC:pn-nativesdk-openssl = ""
# libssp-static-dev included in build-appliance
DISABLE_STATIC:pn-gcc-runtime = ""
# libusb1-native is used to build static dfu-util-native
DISABLE_STATIC:pn-libusb1-native = ""

EXTRA_OECONF:append = "${DISABLE_STATIC}"

EXTRA_OECMAKE:append:pn-libical = " -DSHARED_ONLY=True"
EXTRA_OECMAKE:append:pn-libjpeg-turbo = " -DENABLE_STATIC=False"
EXTRA_OECMAKE:append:pn-libjpeg-turbo-native = " -DENABLE_STATIC=False"

EXCONFIG_ARGS:append:pn-ncurses = " --without-normal"
EXCONFIG_ARGS:append:pn-ncurses-native = " --without-normal"
EXCONFIG_ARGS:append:pn-nativesdk-ncurses = " --without-normal"
```

## poky/meta/conf/distro/include/ptest-packagelists.inc
```bitbake
#
# Lists of the ptests in OE-Core, sorted into two sets by the time they take
#
# ptests which take less than ~30s each
#
PTESTS_FAST = "\
    acl \
    apr-util \
    attr \
    babeltrace \
    babeltrace2 \
    bc \
    bluez5 \
    busybox \
    cpio \
    diffstat \
    diffutils \
    ethtool \
    expat \
    expect \
    findutils \
    flex \
    gawk \
    gdbm \
    gdk-pixbuf \
    glib-networking \
    gzip \
    json-c \
    json-glib \
    libconvert-asn1-perl \
    libexif \
    libgpg-error\
    libnl \
    libpcre \
    libssh2 \
    libtest-fatal-perl \
    libtest-needs-perl \
    libtest-warnings-perl \
    libtimedate-perl \
    libtry-tiny-perl \
    libusb1 \
    libxml-namespacesupport-perl \
    libxml-parser-perl \
    libxml-perl \
    libxml-sax-base-perl \
    libxml-sax-perl \
    libxml-simple-perl \
    libxml2 \
    libxmlb \
    logrotate \
    lua \
    lzo \
    m4 \
    nettle \
    opkg \
    popt \
    python3-atomicwrites \
    python3-attrs \
    python3-bcrypt \
    python3-calver \
    python3-hypothesis \
    python3-idna \
    python3-jinja2 \
    python3-jsonpointer \
    python3-libarchive-c \
    python3-license-expression \
    python3-mako \
    python3-markupsafe \
    python3-more-itertools \
    python3-packaging \
    python3-pluggy \
    python3-pefile \
    python3-pyasn1 \
    python3-pytz \
    python3-pyyaml \
    python3-rpds-py \
    python3-trove-classifiers \
    python3-uritools \
    python3-wcwidth \
    python3-webcolors \
    qemu \
    quilt \
    sed \
    slang \
    wayland \
    xz \
    zlib \
"
PTESTS_FAST:append:libc-glibc = " glibc-y2038-tests"
PTESTS_PROBLEMS:remove:libc-glibc = "glibc-y2038-tests"
PTESTS_FAST:remove:mips64 = "qemu"
PTESTS_PROBLEMS:append:mips64 = " qemu"
PTESTS_FAST:remove:riscv32 = "qemu"
PTESTS_PROBLEMS:append:riscv32 = " qemu"

PTESTS_SLOW = "\
    apr \
    bzip2 \
    coreutils \
    curl \
    dbus \
    e2fsprogs \
    elfutils \
    gettext \
    glib-2.0 \
    gnutls \
    gstreamer1.0 \
    less \
    libevent \
    libgcrypt \
    libmodule-build-perl \
    libseccomp \
    lttng-tools \
    lz4 \
    openssh \
    openssl \
    parted \
    perl \
    python3 \
    python3-cffi \
    python3-click \
    python3-cryptography \
    python3-xmltodict \
    strace \
    tar \
    tcl \
    tcl8 \
    util-linux \
"

# python3 ptests hang on qemuriscv64
PTESTS_SLOW:remove:riscv64 = "python3"
PTESTS_PROBLEMS:append:riscv64 = " python3"
PTESTS_SLOW:remove:riscv32 = "lttng-tools strace "
PTESTS_PROBLEMS:append:riscv32 = " lttng-tools strace"
PTESTS_SLOW:append:libc-musl = " libc-test"

#    ruby \ # Timeout
#    rt-tests \ # Needs to be checked whether it runs at all
#    bash \ # Test outcomes are non-deterministic by design
#    ifupdown \ # Tested separately in lib/oeqa/selftest/cases/imagefeatures.py
#    libinput \ # Tests need an unloaded system to be reliable
#    libpam \ # Needs pam DISTRO_FEATURE
#    mdadm \ # tests are flaky in AB.
#    numactl \ # qemu not (yet) configured for numa; all tests are skipped
#    python3-numpy \ # requires even more RAM and (possibly) disk space; multiple failures

PTESTS_PROBLEMS = "\
    ruby \
    rt-tests \
    bash \
    ifupdown \
    libinput \
    libpam \
    mdadm \
    numactl \
    python3-license-expression \
    python3-numpy \
"
```

## poky/meta/conf/distro/include/rust_security_flags.inc
```bitbake
# Build errors with PIE options enabled
SECURITY_CFLAGS:pn-rust-native = "${SECURITY_NO_PIE_CFLAGS}"
SECURITY_CFLAGS:pn-rust-cross-${TARGET_ARCH} = "${SECURITY_NO_PIE_CFLAGS}"
SECURITY_CFLAGS:pn-rust = "${SECURITY_NO_PIE_CFLAGS}"
SECURITY_CFLAGS:pn-rust-llvm = "${SECURITY_NO_PIE_CFLAGS}"

SECURITY_LDFLAGS:pn-rust-cross-arm = " -lssp_nonshared -lssp"
```

## poky/meta/conf/distro/include/rust_versions.inc
```bitbake
# include this in your distribution to easily switch between versions
# just by changing RUST_VERSION variable

RUST_VERSION ?= "1.51.0"

PREFERRED_VERSION_cargo ?= "${RUST_VERSION}"
PREFERRED_VERSION_cargo-native ?= "${RUST_VERSION}"
PREFERRED_VERSION_libstd-rs ?= "${RUST_VERSION}"
PREFERRED_VERSION_rust ?= "${RUST_VERSION}"
PREFERRED_VERSION_rust-cross-${TARGET_ARCH} ?= "${RUST_VERSION}"
PREFERRED_VERSION_rust-llvm ?= "${RUST_VERSION}"
PREFERRED_VERSION_rust-llvm-native ?= "${RUST_VERSION}"
PREFERRED_VERSION_rust-native ?= "${RUST_VERSION}"
```

## poky/meta/conf/distro/include/security_flags.inc
```bitbake
# Setup extra CFLAGS and LDFLAGS which have 'security' benefits. These
# don't work universally, there are recipes which can't use one, the other
# or both so an override is maintained here. The idea would be over
# time to reduce this list to nothing.
# From a Yocto Project perspective, this file is included and tested
# in the DISTRO="poky" configuration.

GCCPIE ?= "--enable-default-pie"
# If static PIE is known to work well, GLIBCPIE="--enable-static-pie" can be set

# _FORTIFY_SOURCE requires -O1 or higher, so disable in debug builds as they use
# -O0 which then results in a compiler warning.
OPTLEVEL = "${@bb.utils.filter('SELECTED_OPTIMIZATION', '-O0 -O1 -O2 -O3 -Ofast -Og -Os -Oz -O', d)}"

lcl_maybe_fortify ?= "${@oe.utils.conditional('OPTLEVEL','-O0','','${OPTLEVEL} -D_FORTIFY_SOURCE=2',d)}"

# Error on use of format strings that represent possible security problems
SECURITY_STRINGFORMAT ?= "-Wformat -Wformat-security -Werror=format-security"

# Inject pie flags into compiler flags if not configured with gcc itself
# especially useful with external toolchains
SECURITY_PIE_CFLAGS ?= "${@'' if '${GCCPIE}' else '-pie -fPIE'}"

SECURITY_NOPIE_CFLAGS ?= "-no-pie -fno-PIE"

SECURITY_STACK_PROTECTOR ?= "-fstack-protector-strong"

SECURITY_CFLAGS ?= "${SECURITY_STACK_PROTECTOR} ${SECURITY_PIE_CFLAGS} ${lcl_maybe_fortify} ${SECURITY_STRINGFORMAT}"
SECURITY_NO_PIE_CFLAGS ?= "${SECURITY_STACK_PROTECTOR} ${lcl_maybe_fortify} ${SECURITY_STRINGFORMAT}"

SECURITY_LDFLAGS ?= "-Wl,-z,relro,-z,now"
SECURITY_X_LDFLAGS ?= "-Wl,-z,relro"

# powerpc does not get on with pie for reasons not looked into as yet
GCCPIE:powerpc = ""
GLIBCPIE:powerpc = ""
SECURITY_CFLAGS:remove:powerpc = "${SECURITY_PIE_CFLAGS}"
SECURITY_CFLAGS:pn-libgcc:powerpc = ""

SECURITY_CFLAGS:pn-glibc = ""
SECURITY_CFLAGS:pn-glibc-testsuite = ""
SECURITY_CFLAGS:pn-gcc-runtime = ""
SECURITY_CFLAGS:pn-grub = ""
SECURITY_CFLAGS:pn-grub-efi = ""
SECURITY_CFLAGS:pn-mkelfimage:x86 = ""

SECURITY_CFLAGS:pn-valgrind = "${SECURITY_NOPIE_CFLAGS}"
SECURITY_LDFLAGS:pn-valgrind = ""
SECURITY_CFLAGS:pn-sysklogd = "${SECURITY_NOPIE_CFLAGS}"
SECURITY_LDFLAGS:pn-sysklogd = ""

# Recipes which fail to compile when elevating -Wformat-security to an error
SECURITY_STRINGFORMAT:pn-busybox = ""
SECURITY_STRINGFORMAT:pn-gcc = ""

TARGET_CC_ARCH:append:class-target = " ${SECURITY_CFLAGS}"
TARGET_LDFLAGS:append:class-target = " ${SECURITY_LDFLAGS}"
TARGET_CC_ARCH:append:class-cross-canadian = " ${SECURITY_CFLAGS}"
TARGET_LDFLAGS:append:class-cross-canadian = " ${SECURITY_LDFLAGS}"

SECURITY_STACK_PROTECTOR:pn-gcc-runtime = ""
SECURITY_STACK_PROTECTOR:pn-glibc = ""
SECURITY_STACK_PROTECTOR:pn-glibc-testsuite = ""
SECURITY_STACK_PROTECTOR:pn-ltp = ""
# All xorg module drivers need to be linked this way as well and are
# handled in recipes-graphics/xorg-driver/xorg-driver-common.inc
SECURITY_LDFLAGS:pn-xserver-xorg = "${SECURITY_X_LDFLAGS}"

TARGET_CC_ARCH:append:pn-binutils = " ${SELECTED_OPTIMIZATION}"
TARGET_CC_ARCH:append:pn-gcc = " ${SELECTED_OPTIMIZATION}"
TARGET_CC_ARCH:append:pn-gdb = " ${SELECTED_OPTIMIZATION}"
```

## poky/meta/conf/distro/include/tclibc-baremetal.inc
```bitbake
#
# baremetal configuration
#

LIBCEXTENSION = ""

LIBCOVERRIDE = ":libc-baremetal"

ASSUME_PROVIDED += "virtual/libc virtual/libiconv virtual/crypt"

PREFERRED_PROVIDER_virtual/libc ?= "musl"
PREFERRED_PROVIDER_virtual/libiconv ?= "musl"
PREFERRED_PROVIDER_virtual/libintl ?= "gettext"
PREFERRED_PROVIDER_virtual/nativesdk-libintl ?= "nativesdk-glibc"
PREFERRED_PROVIDER_virtual/nativesdk-libiconv ?= "nativesdk-glibc"

USE_NLS ?= "no"
IMAGE_LINGUAS = ""
LIBC_DEPENDENCIES = ""

EXTRA_OECONF:pn-gcc-cross-${TARGET_ARCH}:append = " --without-headers"
DEPENDS:remove:pn-meta-toolchain = "virtual/libc virtual/compilerlibs"

# certain compiler libs cannot be used without libc, avoid the dependence on compilerlibs
BASEDEPENDS:remove:class-target = "virtual/compilerlibs"

TARGET_OS = "elf"
TARGET_OS:arm = "eabi"

TOOLCHAIN_HOST_TASK ?= "packagegroup-cross-canadian-${MACHINE} nativesdk-qemu nativesdk-sdk-provides-dummy"
TOOLCHAIN_HOST_TASK_ATTEMPTONLY ?= ""
TOOLCHAIN_TARGET_TASK ?= "libgcc-dev"
TOOLCHAIN_NEED_CONFIGSITE_CACHE:remove = "virtual/${MLPREFIX}libc zlib ncurses"

# disable stack protector by default (no-libc, no protector implementation)
SECURITY_STACK_PROTECTOR:libc-baremetal = ""
# disable pie security flags by default
SECURITY_CFLAGS:libc-baremetal = "${SECURITY_NOPIE_CFLAGS}"
SECURITY_LDFLAGS:libc-baremetal = ""
```

## poky/meta/conf/distro/include/tclibc-glibc.inc
```bitbake
#
# glibc specific configuration
#

LIBCEXTENSION = "${@['', '-gnu'][(d.getVar('ABIEXTENSION') or '') != '']}"

LIBCOVERRIDE = ":libc-glibc"

PREFERRED_PROVIDER_virtual/libiconv ?= "glibc"
PREFERRED_PROVIDER_virtual/nativesdk-libiconv ?= "nativesdk-glibc"
PREFERRED_PROVIDER_virtual/nativesdk-libintl ?= "nativesdk-glibc"
PREFERRED_PROVIDER_virtual/libintl ?= "glibc"
PREFERRED_PROVIDER_virtual/libc ?= "glibc"
PREFERRED_PROVIDER_virtual/nativesdk-libc ?= "nativesdk-glibc"
PREFERRED_PROVIDER_virtual/libc-locale ?= "glibc-locale"

CXXFLAGS += "-fvisibility-inlines-hidden"

LIBC_DEPENDENCIES = "libsegfault \
		     glibc \
		     glibc-dbg \
		     glibc-dev \
		     glibc-utils \
		     glibc-thread-db \
		     glibc-localedata-i18n \
		     glibc-gconv-ibm850 \
		     glibc-gconv-cp1252 \
		     glibc-gconv-iso8859-1 \
		     glibc-gconv-iso8859-15"
```
