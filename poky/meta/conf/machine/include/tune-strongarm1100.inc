## poky/meta/conf/machine/include/tune-strongarm1100.inc
```bitbake
DEFAULTTUNE ?= "armv4"

require conf/machine/include/arm/arch-armv4.inc

TUNEVALID[strongarm] = "Enable Strongarm 1100 series processor optimizations"
TUNE_CCARGS .= "${@bb.utils.contains('TUNE_FEATURES', 'strongarm', ' -mcpu=strongarm1100', '', d)}"
MACHINEOVERRIDES =. "${@bb.utils.contains('TUNE_FEATURES', 'strongarm', 'armv4:', '' ,d)}"

AVAILTUNES += "strongarm"
ARMPKGARCH_tune-strongarm = "strongarm"
TUNE_FEATURES_tune-strongarm = "arm strongarm"
PACKAGE_EXTRA_ARCHS_tune-strongarm = "${PACKAGE_EXTRA_ARCHS_tune-armv4} strongarm"
```

## poky/meta/conf/machine/include/tune-thunderx.inc
```bitbake
DEFAULTTUNE ?= "thunderx"
AVAILTUNES += "thunderx thunderx_be"

TUNEVALID[thunderx] = "Enable instructions for Cavium ThunderX"

TUNE_CCARGS .= "${@bb.utils.contains('TUNE_FEATURES', 'thunderx', ' -mcpu=thunderx', '',d)}"

require conf/machine/include/arm/arch-armv8a.inc

ARMPKGARCH_tune-thunderx ?= "thunderx"
ARMPKGARCH_tune-thunderx_be ?= "thunderx_be"

TUNE_FEATURES_tune-thunderx = "${TUNE_FEATURES_tune-aarch64} thunderx"
TUNE_FEATURES_tune-thunderx_be = "${TUNE_FEATURES_tune-thunderx} bigendian"
BASE_LIB_tune-thunderx = "lib64"
BASE_LIB_tune-thunderx_be = "lib64"

PACKAGE_EXTRA_ARCHS_tune-thunderx = "${PACKAGE_EXTRA_ARCHS_tune-armv8a-crc-crypto} thunderx"
PACKAGE_EXTRA_ARCHS_tune-thunderx_be = "aarch64_be thunderx_be"
```

## poky/meta/conf/machine/include/tune-xscale.inc
```bitbake
DEFAULTTUNE ?= "armv5te"

require conf/machine/include/arm/arch-armv5-dsp.inc

TUNEVALID[xscale] = "Enable PXA255/PXA26x Xscale specific processor optimizations"
TUNE_CCARGS .= "${@bb.utils.contains('TUNE_FEATURES', 'xscale', ' -mcpu=xscale', '', d)}"
MACHINEOVERRIDES =. "${@bb.utils.contains('TUNE_FEATURES', 'xscale', 'armv5:', '', d)}"

AVAILTUNES += "xscale"
ARMPKGARCH_tune-xscale = "xscale"
# mcpu is used so don't use armv5te as we don't want march
TUNE_FEATURES_tune-xscale = "arm thumb dsp xscale"
PACKAGE_EXTRA_ARCHS_tune-xscale = "${PACKAGE_EXTRA_ARCHS_tune-armv5te} xscale xscalet xscalee xscalete"

AVAILTUNES += "xscale-be"
ARMPKGARCH_tune-xscale-be = "xscale"
# mcpu is used so don't use armv5te as we don't want march
TUNE_FEATURES_tune-xscale-be = "${TUNE_FEATURES_tune-xscale} bigendian"
PACKAGE_EXTRA_ARCHS_tune-xscale-be = "${PACKAGE_EXTRA_ARCHS_tune-armv5teb} xscaleb xscaletb xscaleeb xscaleteb"
```

## poky/meta/conf/machine/include/x86/qemuboot-x86.inc
```bitbake
# For runqemu
IMAGE_CLASSES += "qemuboot"
QB_SMP = "-smp 4"
QB_CPU:x86 = "-cpu IvyBridge -machine q35"
QB_CPU_KVM:x86 = "-cpu IvyBridge -machine q35"

QB_CPU:x86-64 = "-cpu IvyBridge -machine q35"
QB_CPU_KVM:x86-64 = "-cpu IvyBridge -machine q35"

QB_AUDIO_DRV = "alsa"
QB_AUDIO_OPT = "-device AC97"
QB_KERNEL_CMDLINE_APPEND = "oprofile.timer=1 tsc=reliable no_timer_check rcupdate.rcu_expedited=1"
QB_OPT_APPEND = "-usb -device usb-tablet"
```

## poky/meta/conf/machine/include/x86/tune-c3.inc
```bitbake
require conf/machine/include/x86/arch-x86.inc

TUNEVALID[c3] = "VIA Cyrix III or VIA C3 specific optimizations"
TUNECONFLICTS[c3] = "m64 mx32"
TUNE_CCARGS .= "${@bb.utils.contains('TUNE_FEATURES', 'c3', ' -march=c3 -mtune=c3', '', d)}"

AVAILTUNES += "c3"
TUNE_FEATURES:tune-c3 = "${TUNE_FEATURES:tune-x86} c3"
BASE_LIBS:tune-c3 = "${BASE_LIB:tune-x86}"
# The following should likely be something other then i586...
TUNE_PKGARCH:tune-c3 = "i586"
PACKAGE_EXTRA_ARCHS:tune-c3 = "${PACKAGE_EXTRA_ARCHS:tune-x86} i386 i486 i586"
```

## poky/meta/conf/machine/include/x86/tune-core2.inc
```bitbake
# Settings for the GCC(1) cpu-type "core2":
#
#      Intel Core2 CPU with 64-bit extensions, MMX, SSE, SSE2, SSE3 and SSSE3
#      instruction set support.
#
# This tune is recommended for the Intel Core 2 CPU family, including Conroe,
# Merom and beyond, as well as the first Atom CPUs, Diamondville, and beyond.
#
DEFAULTTUNE ?= "core2-32"

# Include the previous tune to pull in PACKAGE_EXTRA_ARCHS
require conf/machine/include/x86/tune-i686.inc

# Extra tune features
TUNEVALID[core2] = "Enable core2 specific processor optimizations"
TUNE_CCARGS .= "${@bb.utils.contains('TUNE_FEATURES', 'core2', ' -march=core2 -mtune=core2 -msse3 -mfpmath=sse', '', d)}"

# Extra tune selections
AVAILTUNES += "core2-32"
TUNE_FEATURES:tune-core2-32 = "${TUNE_FEATURES:tune-x86} core2"
BASE_LIB:tune-core2-32 = "lib"
TUNE_PKGARCH:tune-core2-32 = "core2-32"
PACKAGE_EXTRA_ARCHS:tune-core2-32 = "${PACKAGE_EXTRA_ARCHS:tune-i686} core2-32"
QEMU_EXTRAOPTIONS_core2-32 = " -cpu n270"

AVAILTUNES += "core2-64"
TUNE_FEATURES:tune-core2-64 = "${TUNE_FEATURES:tune-x86-64} core2"
BASE_LIB:tune-core2-64 = "lib64"
TUNE_PKGARCH:tune-core2-64 = "core2-64"
PACKAGE_EXTRA_ARCHS:tune-core2-64 = "${PACKAGE_EXTRA_ARCHS:tune-x86-64} core2-64"
QEMU_EXTRAOPTIONS_core2-64 = " -cpu core2duo"

AVAILTUNES += "core2-64-x32"
TUNE_FEATURES:tune-core2-64-x32 = "${TUNE_FEATURES:tune-x86-64-x32} core2"
BASE_LIB:tune-core2-64-x32 = "libx32"
TUNE_PKGARCH:tune-core2-64-x32 = "core2-64-x32"
PACKAGE_EXTRA_ARCHS:tune-core2-64-x32 = "${PACKAGE_EXTRA_ARCHS:tune-x86-64-x32} core2-64-x32"
QEMU_EXTRAOPTIONS_core2-64-x32 = " -cpu core2duo"
```

## poky/meta/conf/machine/include/x86/tune-corei7.inc
```bitbake
# Settings for the GCC(1) cpu-type "nehalem":
#
#     Intel Nehalem CPU with 64-bit extensions, MMX, SSE, SSE2, SSE3, SSSE3, SSE4.1,
#     SSE4.2 and POPCNT instruction set support.
#
# This tune is recommended for Intel Nehalem and Silvermont (e.g. Bay Trail) CPUs
# (and beyond).
#
DEFAULTTUNE ?= "corei7-64"

# Include the previous tune to pull in PACKAGE_EXTRA_ARCHS
require conf/machine/include/x86/tune-core2.inc

# Extra tune features
TUNEVALID[corei7] = "Enable corei7 specific processor optimizations"
TUNE_CCARGS .= "${@bb.utils.contains('TUNE_FEATURES', 'corei7', ' -march=nehalem -mtune=generic -mfpmath=sse -msse4.2', '', d)}"

# Extra tune selections
AVAILTUNES += "corei7-32"
TUNE_FEATURES:tune-corei7-32 = "${TUNE_FEATURES:tune-x86} corei7"
BASE_LIB:tune-corei7-32 = "lib"
TUNE_PKGARCH:tune-corei7-32 = "corei7-32"
PACKAGE_EXTRA_ARCHS:tune-corei7-32 = "${PACKAGE_EXTRA_ARCHS:tune-core2-32} corei7-32"
QEMU_EXTRAOPTIONS_corei7-32 = " -cpu Nehalem,check=false"

AVAILTUNES += "corei7-64"
TUNE_FEATURES:tune-corei7-64 = "${TUNE_FEATURES:tune-x86-64} corei7"
BASE_LIB:tune-corei7-64 = "lib64"
TUNE_PKGARCH:tune-corei7-64 = "corei7-64"
PACKAGE_EXTRA_ARCHS:tune-corei7-64 = "${PACKAGE_EXTRA_ARCHS:tune-core2-64} corei7-64"
QEMU_EXTRAOPTIONS_corei7-64 = " -cpu Nehalem,check=false"

AVAILTUNES += "corei7-64-x32"
TUNE_FEATURES:tune-corei7-64-x32 = "${TUNE_FEATURES:tune-x86-64-x32} corei7"
BASE_LIB:tune-corei7-64-x32 = "libx32"
TUNE_PKGARCH:tune-corei7-64-x32 = "corei7-64-x32"
PACKAGE_EXTRA_ARCHS:tune-corei7-64-x32 = "${PACKAGE_EXTRA_ARCHS:tune-core2-64-x32} corei7-64-x32"
QEMU_EXTRAOPTIONS_corei7-64-x32 = " -cpu Nehalem,check=false"
```

## poky/meta/conf/machine/qemuarm.conf
```bitbake
#@TYPE: Machine
#@NAME: QEMU Arm Cortex-A15 machine
#@DESCRIPTION: Machine configuration for running an ARMv7 system on QEMU

require conf/machine/include/arm/armv7a/tune-cortexa15.inc
require conf/machine/include/qemu.inc

KERNEL_IMAGETYPE = "zImage"

UBOOT_MACHINE ?= "qemu_arm_defconfig"

SERIAL_CONSOLES ?= "115200;ttyAMA0 115200;hvc0"
SERIAL_CONSOLES_CHECK = "${SERIAL_CONSOLES}"

# For runqemu
QB_SYSTEM_NAME = "qemu-system-arm"
QB_MACHINE = "-machine virt,highmem=off"
QB_CPU = "-cpu cortex-a15"
QB_SMP = "-smp 4"
# Standard Serial console
QB_KERNEL_CMDLINE_APPEND = "vmalloc=256"
# For graphics to work we need to define the VGA device as well as the necessary USB devices
QB_GRAPHICS = "-device virtio-gpu-pci"
QB_OPT_APPEND = "-device qemu-xhci -device usb-tablet -device usb-kbd"
# Virtio Networking support
QB_TAP_OPT = "-netdev tap,id=net0,ifname=@TAP@,script=no,downscript=no"
QB_NETWORK_DEVICE = "-device virtio-net-device,netdev=net0,mac=@MAC@"
# Virtio block device
QB_ROOTFS_OPT = "-drive id=disk0,file=@ROOTFS@,if=none,format=raw -device virtio-blk-device,drive=disk0"
# Virtio serial console
QB_SERIAL_OPT = "-device virtio-serial-device -chardev null,id=virtcon -device virtconsole,chardev=virtcon"
QB_TCPSERIAL_OPT = "-device virtio-serial-device -chardev socket,id=virtcon,port=@PORT@,host=127.0.0.1 -device virtconsole,chardev=virtcon"

KMACHINE:qemuarm = "qemuarma15"
```

## poky/meta/conf/machine/qemuarm64.conf
```bitbake
#@TYPE: Machine
#@NAME: QEMU ARMv8 machine
#@DESCRIPTION: Machine configuration for running an ARMv8 system on QEMU

require conf/machine/include/arm/armv8a/tune-cortexa57.inc
require conf/machine/include/qemu.inc

KERNEL_IMAGETYPE = "Image"

UBOOT_MACHINE ?= "qemu_arm64_defconfig"

SERIAL_CONSOLES ?= "115200;ttyAMA0 115200;hvc0"
SERIAL_CONSOLES_CHECK = "${SERIAL_CONSOLES}"

# For runqemu
QB_SYSTEM_NAME = "qemu-system-aarch64"
QB_MACHINE = "-machine virt"
QB_CPU = "-cpu cortex-a57"
QB_SMP = "-smp 4"
QB_CPU_KVM = "-cpu host -machine gic-version=3"
# For graphics to work we need to define the VGA device as well as the necessary USB devices
QB_GRAPHICS = "-device virtio-gpu-pci"
QB_OPT_APPEND = "-device qemu-xhci -device usb-tablet -device usb-kbd"
# Virtio Networking support
QB_TAP_OPT = "-netdev tap,id=net0,ifname=@TAP@,script=no,downscript=no"
QB_NETWORK_DEVICE = "-device virtio-net-pci,netdev=net0,mac=@MAC@"
# Virtio block device
QB_ROOTFS_OPT = "-drive id=disk0,file=@ROOTFS@,if=none,format=raw -device virtio-blk-pci,drive=disk0"
# Virtio serial console
QB_SERIAL_OPT = "-device virtio-serial-pci -chardev null,id=virtcon -device virtconsole,chardev=virtcon"
QB_TCPSERIAL_OPT = "-device virtio-serial-pci -chardev socket,id=virtcon,port=@PORT@,host=127.0.0.1 -device virtconsole,chardev=virtcon"
```

## poky/meta/conf/machine/qemuarmv5.conf
```bitbake
#@TYPE: Machine
#@NAME: QEMU ARM9 machine
#@DESCRIPTION: Machine configuration for running an ARMv5 system on QEMU

require conf/machine/include/qemu.inc
require conf/machine/include/arm/armv5/tune-arm926ejs.inc

KERNEL_IMAGETYPE = "zImage"

SERIAL_CONSOLES ?= "115200;ttyAMA0 115200;ttyAMA1"

# For runqemu
QB_SYSTEM_NAME = "qemu-system-arm"
QB_MACHINE = "-machine versatilepb"
QB_KERNEL_CMDLINE_APPEND = "vmalloc=256"
QB_GRAPHICS = "-device virtio-gpu-pci"
QB_OPT_APPEND = "-device qemu-xhci -device usb-tablet -device usb-kbd"
QB_DTB = "${@oe.utils.version_less_or_equal('PREFERRED_VERSION_linux-yocto', '4.7', '', 'zImage-versatile-pb.dtb', d)}"

PREFERRED_VERSION_linux-yocto ??= "5.15%"
KMACHINE:qemuarmv5 = "arm-versatile-926ejs"
```

## poky/meta/conf/machine/qemuloongarch64.conf
```bitbake
#@TYPE: Machine
#@NAME: generic loongarch64 machine
#@DESCRIPTION: Machine configuration for running a generic loongarch64

require conf/machine/include/loongarch/qemuloongarch.inc

XVISOR_PLAT = "loongarch/virt64"

EXTRA_IMAGEDEPENDS += "u-boot"
UBOOT_MACHINE = "qemu-loongarch64_smode_defconfig"
UBOOT_ELF = "u-boot"
```

## poky/meta/conf/machine/qemumips.conf
```bitbake
#@TYPE: Machine
#@NAME: QEMU MIPS32 machine
#@DESCRIPTION: Machine configuration for running a MIPS system on QEMU

require conf/machine/include/qemu.inc
require conf/machine/include/tune-mips32r2.inc
require conf/machine/include/qemuboot-mips.inc

KERNEL_IMAGETYPE = "vmlinux"
KERNEL_ALT_IMAGETYPE = "vmlinux.bin"

UBOOT_MACHINE ?= "qemu_mips_defconfig"

SERIAL_CONSOLES ?= "115200;ttyS0 115200;ttyS1"

QB_SYSTEM_NAME = "qemu-system-mips"

QB_CPU = "-cpu 34Kf"
```

## poky/meta/conf/machine/qemumips64.conf
```bitbake
#@TYPE: Machine
#@NAME: QEMU MIPS64 machine
#@DESCRIPTION: Machine configuration for running a MIPS64 system on QEMU

require conf/machine/include/qemu.inc
require conf/machine/include/tune-mips64r2.inc
require conf/machine/include/qemuboot-mips.inc

QB_CPU = "-cpu MIPS64R2-generic"

KERNEL_IMAGETYPE = "vmlinux"
KERNEL_ALT_IMAGETYPE = "vmlinux.bin"

UBOOT_MACHINE ?= "qemu_mips64_defconfig"

SERIAL_CONSOLES ?= "115200;ttyS0 115200;ttyS1"

QB_SYSTEM_NAME = "qemu-system-mips64"
```

## poky/meta/conf/machine/qemuppc.conf
```bitbake
#@TYPE: Machine
#@NAME: qemu PPC Emulator setup
#@DESCRIPTION: Machine configuration for running an PPC system under qemu emulation

require conf/machine/include/qemu.inc
require conf/machine/include/tune-ppc7400.inc

TARGET_CC_KERNEL_ARCH = "-mno-spe"

KERNEL_IMAGETYPE = "vmlinux"

SERIAL_CONSOLES ?= "115200;ttyS0 115200;ttyS1"

# For runqemu
QB_SYSTEM_NAME = "qemu-system-ppc"
QB_MACHINE = "-machine mac99"
QB_CPU = "-cpu G4"
QB_KERNEL_CMDLINE_APPEND = "console=tty console=ttyS0"
# Add the 'virtio-rng-pci' device otherwise the guest may run out of entropy
QB_OPT_APPEND = "-show-cursor -usb -device usb-tablet -device virtio-rng-pci"
QB_TAP_OPT = "-netdev tap,id=net0,ifname=@TAP@,script=no,downscript=no"
```

## poky/meta/conf/machine/qemuppc64.conf
```bitbake
#@TYPE: Machine
#@NAME: QEMU PPC64 machine
#@DESCRIPTION: Machine configuration for running a PPC system on QEMU

require conf/machine/include/qemu.inc
require conf/machine/include/powerpc/tune-power9.inc

KERNEL_IMAGETYPE = "vmlinux"

SERIAL_CONSOLES ?= "115200;hvc0"

# For runqemu
QB_SYSTEM_NAME = "qemu-system-ppc64"
QB_MACHINE = "-machine pseries"
QB_CPU = "-cpu POWER9"
QB_SMP ?= "-smp 2"

QB_NFSROOTFS_EXTRA_OPT = "wsize=524288,rsize=524288"
QB_KERNEL_CMDLINE_APPEND = "console=hvc0 nohugevmalloc"
#QB_OPT_APPEND += "-device qemu-xhci -device usb-tablet -device usb-kbd"
QB_OPT_APPEND = "-usb -device usb-tablet"

MACHINE_EXTRA_RRECOMMENDS += " kernel-modules"
```

## poky/meta/conf/machine/qemuriscv32.conf
```bitbake
#@TYPE: Machine
#@NAME: generic riscv32 machine
#@DESCRIPTION: Machine configuration for running a generic riscv32

require conf/machine/include/riscv/qemuriscv.inc

DEFAULTTUNE = "riscv32"

PREFERRED_VERSION_openocd-native = "riscv"
PREFERRED_VERSION_openocd = "riscv"

XVISOR_PLAT = "riscv/virt32"

EXTRA_IMAGEDEPENDS += "u-boot"
UBOOT_MACHINE = "qemu-riscv32_smode_defconfig"
UBOOT_ELF = "u-boot"
```

## poky/meta/conf/machine/qemuriscv64.conf
```bitbake
#@TYPE: Machine
#@NAME: generic riscv64 machine
#@DESCRIPTION: Machine configuration for running a generic riscv64

require conf/machine/include/riscv/qemuriscv.inc

XVISOR_PLAT = "riscv/virt64"

EXTRA_IMAGEDEPENDS += "u-boot"
UBOOT_MACHINE = "qemu-riscv64_smode_defconfig"
UBOOT_ELF = "u-boot"
```

## poky/meta/conf/machine/qemux86-64.conf
```bitbake
#@TYPE: Machine
#@NAME: QEMU x86-64 machine
#@DESCRIPTION: Machine configuration for running an x86-64 system on QEMU

PREFERRED_PROVIDER_virtual/xserver ?= "xserver-xorg"
PREFERRED_PROVIDER_virtual/libgl ?= "mesa"
PREFERRED_PROVIDER_virtual/libgles1 ?= "mesa"
PREFERRED_PROVIDER_virtual/libgles2 ?= "mesa"

require conf/machine/include/qemu.inc
DEFAULTTUNE ?= "core2-64"
require conf/machine/include/tune-core2.inc
require conf/machine/include/qemuboot-x86.inc

UBOOT_MACHINE ?= "qemu-x86_64_defconfig"

KERNEL_IMAGETYPE = "bzImage"

SERIAL_CONSOLES ?= "115200;ttyS0 115200;ttyS1"

# Install swrast and glx if opengl is in DISTRO_FEATURES and x32 is not in use.
# This is because gallium swrast driver was found to crash X server on startup in qemu x32.
XSERVER = "xserver-xorg \
           ${@bb.utils.contains('DISTRO_FEATURES', 'opengl', \
           bb.utils.contains('TUNE_FEATURES', 'mx32', '', 'mesa-driver-swrast xserver-xorg-extension-glx', d), '', d)} \
           xf86-video-cirrus \
           xf86-video-fbdev \
           xf86-video-vmware \
           xf86-video-modesetting \
           xf86-video-vesa \
           xserver-xorg-module-libint10 \
           "

MACHINE_FEATURES += "x86 pci"

MACHINE_ESSENTIAL_EXTRA_RDEPENDS += "v86d"

MACHINE_EXTRA_RRECOMMENDS = "kernel-module-snd-ens1370 kernel-module-snd-rawmidi"

WKS_FILE ?= "qemux86-directdisk.wks"
do_image_wic[depends] += "syslinux:do_populate_sysroot syslinux-native:do_populate_sysroot mtools-native:do_populate_sysroot dosfstools-native:do_populate_sysroot"

#For runqemu
QB_SYSTEM_NAME = "qemu-system-x86_64"
```
