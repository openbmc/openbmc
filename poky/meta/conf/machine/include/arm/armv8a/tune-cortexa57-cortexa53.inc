## poky/meta/conf/machine/include/mips/tune-mips-74k.inc
```bitbake
DEFAULTTUNE ?= "mips32r2-74kc"

MIPSPKGSFX_MIPS16E ??= ""

require conf/machine/include/mips/tune-mips32r2.inc
require conf/machine/include/mips/feature-mips-mips16e.inc


TUNEVALID[74kc] = "Enable MIPS 74K with DSPr2 processor optimizations"
TUNE_CCARGS .= "${@bb.utils.contains("TUNE_FEATURES", "74kc", " -mtune=74kc", "", d)}"

AVAILTUNES += "mips32r2-74kc mips32r2-74kc-m16"
AVAILTUNES += "mips32r2el-74kc mips32r2el-74kc-m16"

# big endian: kc+dsp2=kc, kc+dsp2+mips16e=kc-m16
TUNE_FEATURES:tune-mips32r2-74kc = "${TUNE_FEATURES:tune-mips32r2-nf} 74kc"
TUNE_FEATURES:tune-mips32r2-74kc-m16 = "${TUNE_FEATURES:tune-mips32r2-74kc} mips16e"

MIPSPKGSFX_VARIANT:tune-mips32r2-74kc = "mips32r2-74kc"
PACKAGE_EXTRA_ARCHS:tune-mips32r2-74kc = "${PACKAGE_EXTRA_ARCHS:tune-mips32r2-nf} mips32r2-74kc-nf"
QEMU_EXTRAOPTIONS:tune-mips32r2-74kc-nf = " -cpu 24Kc"

MIPSPKGSFX_VARIANT:tune-mips32r2-74kc-m16 = "mips32r2-74kc${MIPSPKGSFX_MIPS16E}"
PACKAGE_EXTRA_ARCHS:tune-mips32r2-74kc-m16 = "${PACKAGE_EXTRA_ARCHS:tune-mips32r2-74kc} mips32r2-74kc-m16-nf"
QEMU_EXTRAOPTIONS:tune-mips32r2-74kc-m16-nf = " -cpu 24KEc"

# little endian: kc+dsp2=kc, kc+dsp2+mips16e=kc-m16
TUNE_FEATURES:tune-mips32r2el-74kc = "${TUNE_FEATURES:tune-mips32r2el-nf} 74kc"
TUNE_FEATURES:tune-mips32r2el-74kc-m16 = "${TUNE_FEATURES:tune-mips32r2el-74kc} mips16e"

MIPSPKGSFX_VARIANT:tune-mips32r2el-74kc = "mips32r2el-74kc"
PACKAGE_EXTRA_ARCHS:tune-mips32r2el-74kc = "${PACKAGE_EXTRA_ARCHS:tune-mips32r2el-nf} mips32r2el-74kc-nf"
QEMU_EXTRAOPTIONS:tune-mips32r2el-74kc-nf = " -cpu 24Kc"

MIPSPKGSFX_VARIANT:tune-mips32r2el-74kc-m16 = "mips32r2el-74kc${MIPSPKGSFX_MIPS16E}"
PACKAGE_EXTRA_ARCHS:tune-mips32r2el-74kc-m16 = "${PACKAGE_EXTRA_ARCHS:tune-mips32r2el-74kc} mips32r2el-74kc-m16-nf"
QEMU_EXTRAOPTIONS:tune-mips32r2el-74kc-m16-nf = " -cpu 24KEc"
```

## poky/meta/conf/machine/include/mips/tune-mips32r6.inc
```bitbake
DEFAULTTUNE ?= "mipsisa32r6el"

require conf/machine/include/mips/arch-mips.inc

TUNEVALID[mipsisa32r6] = "Enable mipsisa32r6 specific processor optimizations"
TUNECONFLICTS[mipsisa32r6] = "n64 n32"
TUNE_CCARGS .= "${@bb.utils.contains('TUNE_FEATURES', 'mipsisa32r6', ' -march=mips32r6', '', d)}"

# Base Tunes (Hard Float)
AVAILTUNES += "mipsisa32r6 mipsisa32r6el"

TUNE_FEATURES:tune-mipsisa32r6 = "o32 bigendian mipsisa32r6 fpu-hard r6"
MIPSPKGSFX_VARIANT:tune-mipsisa32r6 = "${TUNE_ARCH}"
PACKAGE_EXTRA_ARCHS:tune-mipsisa32r6 = "mipsisa32r6"

TUNE_FEATURES:tune-mipsisa32r6el = "o32 fpu-hard mipsisa32r6 r6"
MIPSPKGSFX_VARIANT:tune-mipsisa32r6el = "${TUNE_ARCH}"
PACKAGE_EXTRA_ARCHS:tune-mipsisa32r6el = "mipsisa32r6el"

# Soft Float
AVAILTUNES += "mipsisa32r6-nf mipsisa32r6el-nf"

TUNE_FEATURES:tune-mipsisa32r6-nf = "o32 bigendian mipsisa32r6 r6"
MIPSPKGSFX_VARIANT:tune-mipsisa32r6-nf = "${TUNE_ARCH}"
PACKAGE_EXTRA_ARCHS:tune-mipsisa32r6-nf = "mipsisa32r6-nf"

TUNE_FEATURES:tune-mipsisa32r6el-nf = "o32 mipsisa32r6 r6"
MIPSPKGSFX_VARIANT:tune-mipsisa32r6el-nf = "${TUNE_ARCH}"
PACKAGE_EXTRA_ARCHS:tune-mipsisa32r6el-nf = "mipsisa32r6el-nf"
```

## poky/meta/conf/machine/include/mips/tune-mips64r2.inc
```bitbake
DEFAULTTUNE ?= "mips64r2"

require conf/machine/include/mips/tune-mips64.inc

TUNEVALID[mips64r2] = "Enable mips64r2 specific processor optimizations"
TUNE_CCARGS .= "${@bb.utils.contains('TUNE_FEATURES', 'mips64r2', ' -march=mips64r2', '', d)}"

# Base tunes
AVAILTUNES += "mips64r2 mips64r2el"

TUNE_FEATURES:tune-mips64r2 = "${TUNE_FEATURES:tune-mips64} mips64r2"
BASE_LIB:tune-mips64r2 = "lib64"
MIPSPKGSFX_VARIANT:tune-mips64r2 = "mips64r2"
PACKAGE_EXTRA_ARCHS:tune-mips64r2 = "mips64 mips64r2"

TUNE_FEATURES:tune-mips64r2el = "${TUNE_FEATURES:tune-mips64el} mips64r2"
BASE_LIB:tune-mips64r2el = "lib64"
MIPSPKGSFX_VARIANT:tune-mips64r2el = "mips64r2el"
PACKAGE_EXTRA_ARCHS:tune-mips64r2el = "mips64el mips64r2el"

# MIPS 64r2 Soft Float
AVAILTUNES += "mips64r2-nf mips64r2el-nf"

TUNE_FEATURES:tune-mips64r2-nf = "${TUNE_FEATURES:tune-mips64-nf} mips64r2"
BASE_LIB:tune-mips64r2-nf = "lib64"
MIPSPKGSFX_VARIANT:tune-mips64r2-nf = "${TUNE_ARCH}"
PACKAGE_EXTRA_ARCHS:tune-mips64r2-nf = "mips64-nf mips64r2-nf"

TUNE_FEATURES:tune-mips64r2el-nf = "${TUNE_FEATURES:tune-mips64el-nf} mips64r2"
BASE_LIB:tune-mips64r2el-nf = "lib64"
MIPSPKGSFX_VARIANT:tune-mips64r2el-nf = "${TUNE_ARCH}"
PACKAGE_EXTRA_ARCHS:tune-mips64r2el-nf = "mips64el-nf mips64r2el-nf"

# MIPS 64r2 n32
AVAILTUNES += "mips64r2-n32 mips64r2el-n32"

TUNE_FEATURES:tune-mips64r2-n32 = "${TUNE_FEATURES:tune-mips64-n32} mips64r2"
BASE_LIB:tune-mips64r2-n32 = "lib32"
MIPSPKGSFX_VARIANT:tune-mips64r2-n32 = "${TUNE_ARCH}"
PACKAGE_EXTRA_ARCHS:tune-mips64r2-n32 = "mips64-n32 mips64r2-n32"

TUNE_FEATURES:tune-mips64r2el-n32 = "${TUNE_FEATURES:tune-mips64el-n32} mips64r2"
BASE_LIB:tune-mips64r2el-n32 = "lib32"
MIPSPKGSFX_VARIANT:tune-mips64r2el-n32 = "${TUNE_ARCH}"
PACKAGE_EXTRA_ARCHS:tune-mips64r2el-n32 = "mips64el-n32 mips64r2el-n32"

# MIPS 64r2 n32 and Soft Float
AVAILTUNES += "mips64r2-nf-n32 mips64r2el-nf-n32"

TUNE_FEATURES:tune-mips64r2-nf-n32 = "${TUNE_FEATURES:tune-mips64-nf-n32} mips64r2"
BASE_LIB:tune-mips64r2-nf-n32 = "lib32"
MIPSPKGSFX_VARIANT:tune-mips64r2-nf-n32 = "${TUNE_ARCH}"
PACKAGE_EXTRA_ARCHS:tune-mips64r2-nf-n32 = "mips64-nf-n32 mips64r2-nf-n32"

TUNE_FEATURES:tune-mips64r2el-nf-n32 = "${TUNE_FEATURES:tune-mips64el-nf-n32} mips64r2"
BASE_LIB:tune-mips64r2el-nf-n32 = "lib32"
MIPSPKGSFX_VARIANT:tune-mips64r2el-nf-n32 = "${TUNE_ARCH}"
PACKAGE_EXTRA_ARCHS:tune-mips64r2el-nf-n32 = "mips64el-nf-n32 mips64r2el-nf-n32"

# MIPS 64r2 o32
AVAILTUNES += "mips64r2-o32 mips64r2el-o32"

TUNE_FEATURES:tune-mips64r2-o32 = "${TUNE_FEATURES:tune-mips64-o32} mips64r2"
BASE_LIB:tune-mips64r2-o32 = "lib"
MIPSPKGSFX_VARIANT:tune-mips64r2-o32 = "${TUNE_ARCH}"
PACKAGE_EXTRA_ARCHS:tune-mips64r2-o32 = "mips mips64-o32 mips64r2-o32"

TUNE_FEATURES:tune-mips64r2el-o32 = "${TUNE_FEATURES:tune-mips64el-o32} mips64r2"
BASE_LIB:tune-mips64r2el-o32 = "lib"
MIPSPKGSFX_VARIANT:tune-mips64r2el-o32 = "${TUNE_ARCH}"
PACKAGE_EXTRA_ARCHS:tune-mips64r2el-o32 = "mipsel mips64el-o32 mips64r2el-o32"

# MIPS 64r2 o32 and Soft Float
AVAILTUNES += "mips64r2-nf-o32 mips64r2el-nf-o32"

TUNE_FEATURES:tune-mips64r2-nf-o32 = "${TUNE_FEATURES:tune-mips64-nf-o32} mips64r2"
BASE_LIB:tune-mips64r2-nf-o32 = "lib"
MIPSPKGSFX_VARIANT:tune-mips64r2-nf-o32 = "${TUNE_ARCH}"
PACKAGE_EXTRA_ARCHS:tune-mips64r2-nf-o32 = "mips-nf mips64r2-nf-o32"

TUNE_FEATURES:tune-mips64r2el-nf-o32 = "${TUNE_FEATURES:tune-mips64el-nf-o32} mips64r2"
BASE_LIB:tune-mips64r2el-nf-o32 = "lib"
MIPSPKGSFX_VARIANT:tune-mips64r2el-nf-o32 = "${TUNE_ARCH}"
PACKAGE_EXTRA_ARCHS:tune-mips64r2el-nf-o32 = "mipsel-nf mips64r2el-nf-o32"
```

## poky/meta/conf/machine/include/mips/tune-octeon.inc
```bitbake
DEFAULTTUNE ?="octeon2"

require conf/machine/include/mips/tune-mips64.inc

AVAILTUNES += "octeon2 octeon2_64 octeon3 octeon3_64"

TUNEVALID[octeon2] = "Enable optimization related to octeon2 support"
TUNE_CCARGS .= "${@bb.utils.contains('TUNE_FEATURES', 'octeon2', ' -march=octeon2 ', '',d)}"

TUNE_FEATURES:tune-octeon2 = "${TUNE_FEATURES:tune-mips64-n32} octeon2"
BASE_LIB:tune-octeon2 = "lib32"
MIPSPKGSFX_VARIANT:tune-octeon2 = "octeon2"
PACKAGE_EXTRA_ARCHS:tune-octeon2 = "mips64-n32 octeon2-n32"

TUNE_FEATURES:tune-octeon2_64 = "${TUNE_FEATURES:tune-mips64} octeon2"
BASE_LIB:tune-octeon2_64 = "lib64"
MIPSPKGSFX_VARIANT:tune-octeon2_64 = "octeon2_64"
PACKAGE_EXTRA_ARCHS:tune-octeon2_64 = "mips64 octeon2_64"


TUNEVALID[octeon3] = "Enable optimization related to octeon3 support"
TUNE_CCARGS .= "${@bb.utils.contains('TUNE_FEATURES', 'octeon3', ' -march=octeon3 ', '',d)}"

TUNE_FEATURES:tune-octeon3 = "${TUNE_FEATURES:tune-mips64-n32} octeon3"
BASE_LIB:tune-octeon3 = "lib32"
MIPSPKGSFX_VARIANT:tune-octeon3 = "octeon3"
PACKAGE_EXTRA_ARCHS:tune-octeon3 = "mips64-n32 octeon3-n32"

TUNE_FEATURES:tune-octeon3_64 = "${TUNE_FEATURES:tune-mips64} octeon3"
BASE_LIB:tune-octeon3_64 = "lib64"
MIPSPKGSFX_VARIANT:tune-octeon3_64 = "octeon3_64"
PACKAGE_EXTRA_ARCHS:tune-octeon3_64 = "mips64 octeon3_64"
```

## poky/meta/conf/machine/include/powerpc/arch-powerpc.inc
```bitbake
# Power Architecture definition
# Four defined ABIs, all combinations of:
# *) Hard/Soft Floating Point
# *) 32-bit/64-bit

DEFAULTTUNE ?= "powerpc"

TUNE_PKGARCH = "${TUNE_PKGARCH:tune-${DEFAULTTUNE}}"
ABIEXTENSION ?= ""

# Endian
TUNEVALID[bigendian] = "Use PowerPC Big Endian"

TUNE_CCARGS .= "${@bb.utils.contains("TUNE_FEATURES", "bigendian", " -mbig-endian", " -mlittle-endian", d)}"

TUNEVALID[m32] = "Power ELF32 standard ABI"
TUNE_CCARGS .= "${@bb.utils.contains('TUNE_FEATURES', 'm32', ' -m32', '', d)}"
TUNE_ARCH .= "${@bb.utils.contains('TUNE_FEATURES', 'm32', 'powerpc${ENDIAN_SFX}', '', d)}"
ENDIAN_SFX = "${@bb.utils.contains('TUNE_FEATURES', 'bigendian', '', 'le', d)}"

TUNEVALID[fpu-hard] = "Use hardware FPU."
TUNE_CCARGS .= "${@bb.utils.contains('TUNE_FEATURES', 'fpu-hard', ' -mhard-float', '', d)}"

TUNEVALID[fpu-soft] = "Use software FPU."
TUNE_CCARGS .= "${@bb.utils.contains('TUNE_FEATURES', 'fpu-soft', ' -msoft-float', '', d)}"
TARGET_FPU .= "${@bb.utils.contains('TUNE_FEATURES', 'fpu-soft', 'soft', '', d)}"

TUNEVALID[altivec] = "Altivec"

# Basic tune definitions
AVAILTUNES += "powerpc powerpc-nf powerpcle powerpcle-nf" 

TUNE_FEATURES:tune-powerpc-nf = "m32 fpu-soft bigendian"
BASE_LIB:tune-powerpc-nf = "lib"
TUNE_PKGARCH:tune-powerpc-nf = "powerpc-nf"
PACKAGE_EXTRA_ARCHS:tune-powerpc-nf = "powerpc-nf"

TUNE_FEATURES:tune-powerpc = "m32 fpu-hard bigendian"
BASE_LIB:tune-powerpc = "lib"
TUNE_PKGARCH:tune-powerpc = "powerpc"
PACKAGE_EXTRA_ARCHS:tune-powerpc = "powerpc"

TUNE_FEATURES:tune-powerpcle-nf = "m32 fpu-soft"
BASE_LIB:tune-powerpcle-nf = "lib"
TUNE_PKGARCH:tune-powerpcle-nf = "powerpcle-nf"
PACKAGE_EXTRA_ARCHS:tune-powerpcle-nf = "powerpcle-nf"

TUNE_FEATURES:tune-powerpcle = "m32 fpu-hard"
BASE_LIB:tune-powerpcle = "lib"
TUNE_PKGARCH:tune-powerpcle = "powerpcle"
PACKAGE_EXTRA_ARCHS:tune-powerpcle = "powerpcle"
```
