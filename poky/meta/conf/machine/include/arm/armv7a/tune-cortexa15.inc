## poky/meta/conf/machine/include/arm/armv8-2a/tune-cortexa75-cortexa55.inc
```bitbake
#
# Tune Settings for big.LITTLE Cortex-A75 - Cortex-A55
#
DEFAULTTUNE                                        ?= "cortexa75-cortexa55"

TUNEVALID[cortexa75-cortexa55] = "Enable big.LITTLE Cortex-A75.Cortex-A55 specific processor optimizations"
MACHINEOVERRIDES =. "${@bb.utils.contains("TUNE_FEATURES", "cortexa75-cortexa55", "cortexa75-cortexa55:", "", d)}"
TUNE_CCARGS .= "${@bb.utils.contains("TUNE_FEATURES", "cortexa75-cortexa55", " -mcpu=cortex-a75.cortex-a55", "", d)}"

require conf/machine/include/arm/arch-armv8-2a.inc

AVAILTUNES                                         += "cortexa75-cortexa55 cortexa75-cortexa55-crypto"
ARMPKGARCH:tune-cortexa75-cortexa55                 = "cortexa75-cortexa55"
ARMPKGARCH:tune-cortexa75-cortexa55-crypto          = "cortexa75-cortexa55-crypto"
# We do not want -march since -mcpu is added above to cover for it
TUNE_FEATURES:tune-cortexa75-cortexa55              = "aarch64 cortexa75-cortexa55"
TUNE_FEATURES:tune-cortexa75-cortexa55-crypto       = "${TUNE_FEATURES:tune-cortexa75-cortexa55} crypto"
PACKAGE_EXTRA_ARCHS:tune-cortexa75-cortexa55        = "${PACKAGE_EXTRA_ARCHS:tune-armv8-2a} cortexa75-cortexa55"
PACKAGE_EXTRA_ARCHS:tune-cortexa75-cortexa55-crypto = "${PACKAGE_EXTRA_ARCHS:tune-armv8-2a-crypto} cortexa75-cortexa55 cortexa75-cortexa55-crypto"
BASE_LIB:tune-cortexa75-cortexa55                   = "lib64"
BASE_LIB:tune-cortexa75-cortexa55-crypto            = "lib64"
```

## poky/meta/conf/machine/include/arm/armv8-2a/tune-cortexa75.inc
```bitbake
#
# Tune Settings for Cortex-A75
#
DEFAULTTUNE ?= "cortexa75"

TUNEVALID[cortexa75] = "Enable Cortex-A75 specific processor optimizations"
TUNE_CCARGS .= "${@bb.utils.contains('TUNE_FEATURES', 'cortexa75', ' -mcpu=cortex-a75', '', d)}"

require conf/machine/include/arm/arch-armv8-2a.inc

# Little Endian base configs
AVAILTUNES                                         += "cortexa75"
ARMPKGARCH:tune-cortexa75                           = "cortexa75"
# We do not want -march since -mcpu is added above to cover for it
TUNE_FEATURES:tune-cortexa75                        = "aarch64 crypto cortexa75"
PACKAGE_EXTRA_ARCHS:tune-cortexa75                  = "${PACKAGE_EXTRA_ARCHS:tune-armv8-2a-crypto} cortexa75"
BASE_LIB:tune-cortexa75                             = "lib64"
```

## poky/meta/conf/machine/include/arm/armv8-2a/tune-cortexa76-cortexa55.inc
```bitbake
#
# Tune Settings for big.LITTLE Cortex-A76 - Cortex-A55
#
DEFAULTTUNE                                        ?= "cortexa76-cortexa55"

TUNEVALID[cortexa76-cortexa55] = "Enable big.LITTLE Cortex-A76.Cortex-A55 specific processor optimizations"
MACHINEOVERRIDES =. "${@bb.utils.contains("TUNE_FEATURES", "cortexa76-cortexa55", "cortexa76-cortexa55:", "", d)}"
TUNE_CCARGS .= "${@bb.utils.contains("TUNE_FEATURES", "cortexa76-cortexa55", " -mcpu=cortex-a76.cortex-a55", "", d)}"

require conf/machine/include/arm/arch-armv8-2a.inc

AVAILTUNES                                         += "cortexa76-cortexa55 cortexa76-cortexa55-crypto"
ARMPKGARCH:tune-cortexa76-cortexa55                 = "cortexa76-cortexa55"
ARMPKGARCH:tune-cortexa76-cortexa55-crypto          = "cortexa76-cortexa55-crypto"
TUNE_FEATURES:tune-cortexa76-cortexa55              = "${TUNE_FEATURES:tune-armv8-2a} cortexa76-cortexa55"
TUNE_FEATURES:tune-cortexa76-cortexa55-crypto       = "${TUNE_FEATURES:tune-cortexa76-cortexa55} crypto"
PACKAGE_EXTRA_ARCHS:tune-cortexa76-cortexa55        = "${PACKAGE_EXTRA_ARCHS:tune-armv8-2a} cortexa76-cortexa55"
PACKAGE_EXTRA_ARCHS:tune-cortexa76-cortexa55-crypto = "${PACKAGE_EXTRA_ARCHS:tune-armv8-2a-crypto} cortexa76-cortexa55 cortexa76-cortexa55-crypto"
BASE_LIB:tune-cortexa76-cortexa55                   = "lib64"
BASE_LIB:tune-cortexa76-cortexa55-crypto            = "lib64"
```

## poky/meta/conf/machine/include/arm/armv8-2a/tune-cortexa76.inc
```bitbake
#
# Tune Settings for Cortex-A76
#
DEFAULTTUNE                                        ?= "cortexa76"

TUNEVALID[cortexa76] = "Enable Cortex-A76 specific processor optimizations"
TUNE_CCARGS .= "${@bb.utils.contains('TUNE_FEATURES', 'cortexa76', ' -mcpu=cortex-a76', '', d)}"

require conf/machine/include/arm/arch-armv8-2a.inc

# Little Endian base configs
AVAILTUNES                                         += "cortexa76"
ARMPKGARCH:tune-cortexa76                           = "cortexa76"
# We do not want -march since -mcpu is added above to cover for it
TUNE_FEATURES:tune-cortexa76                        = "aarch64 crypto cortexa76"
PACKAGE_EXTRA_ARCHS:tune-cortexa76                  = "${PACKAGE_EXTRA_ARCHS:tune-armv8-2a-crypto} cortexa76"
BASE_LIB:tune-cortexa76                             = "lib64"
```

## poky/meta/conf/machine/include/arm/armv8-2a/tune-cortexa76ae.inc
```bitbake
#
# Tune Settings for Cortex-A76AE
#
DEFAULTTUNE                                        ?= "cortexa76ae"

TUNEVALID[cortexa76ae] = "Enable Cortex-A76AE specific processor optimizations"
TUNE_CCARGS .= "${@bb.utils.contains('TUNE_FEATURES', 'cortexa76ae', ' -mcpu=cortex-a76ae', '', d)}"

require conf/machine/include/arm/arch-armv8-2a.inc

# Little Endian base configs
AVAILTUNES                                         += "cortexa76ae"
ARMPKGARCH:tune-cortexa76ae                         = "cortexa76ae"
TUNE_FEATURES:tune-cortexa76ae                      = "${TUNE_FEATURES:tune-armv8-2a-crypto} cortexa76ae"
PACKAGE_EXTRA_ARCHS:tune-cortexa76ae                = "${PACKAGE_EXTRA_ARCHS:tune-armv8-2a-crypto} cortexa76ae"
BASE_LIB:tune-cortexa76ae                           = "lib64"
```

## poky/meta/conf/machine/include/arm/armv8-2a/tune-cortexa77.inc
```bitbake
#
# Tune Settings for Cortex-A77
#
DEFAULTTUNE                                        ?= "cortexa77"

TUNEVALID[cortexa77] = "Enable Cortex-A77 specific processor optimizations"
TUNE_CCARGS .= "${@bb.utils.contains('TUNE_FEATURES', 'cortexa77', ' -mcpu=cortex-a77', '', d)}"

require conf/machine/include/arm/arch-armv8-2a.inc

# Little Endian base configs
AVAILTUNES                                         += "cortexa77"
ARMPKGARCH_tune-cortexa77                           = "cortexa77"
TUNE_FEATURES_tune-cortexa77                        = "${TUNE_FEATURES_tune-armv8-2a-crypto} cortexa77"
PACKAGE_EXTRA_ARCHS_tune-cortexa77                  = "${PACKAGE_EXTRA_ARCHS_tune-armv8-2a-crypto} cortexa77"
BASE_LIB_tune-cortexa77                             = "lib64"
```

## poky/meta/conf/machine/include/arm/armv8-2a/tune-cortexa78ae.inc
```bitbake
#
# Tune Settings for cortex-a78ae
#
DEFAULTTUNE ?= "cortexa78ae"

TUNEVALID[cortexa78ae] = "Enable cortex-a78ae specific processor optimizations"
TUNE_CCARGS .= "${@bb.utils.contains('TUNE_FEATURES', 'cortexa78ae', ' -mcpu=cortex-a78ae', '', d)}"

require conf/machine/include/arm/arch-armv8-2a.inc

AVAILTUNES                                           += "cortexa78ae"
ARMPKGARCH:tune-cortexa78ae                           = "cortexa78ae"
TUNE_FEATURES:tune-cortexa78ae                        = "aarch64 crypto cortexa78ae"
PACKAGE_EXTRA_ARCHS:tune-cortexa78ae                  = "${PACKAGE_EXTRA_ARCHS:tune-armv8-2a-crypto} cortexa78ae"
BASE_LIB:tune-cortexa78ae                             = "lib64"
```

## poky/meta/conf/machine/include/arm/armv8-2a/tune-cortexx1.inc
```bitbake
#
# Tune Settings for cortex-x1
#
DEFAULTTUNE ?= "cortexx1"

TUNEVALID[cortexx1] = "Enable cortex-x1 specific processor optimizations"
TUNE_CCARGS .= "${@bb.utils.contains('TUNE_FEATURES', 'cortexx1', ' -mcpu=cortex-x1', '', d)}"

require conf/machine/include/arm/arch-armv8-2a.inc

AVAILTUNES                                        += "cortexx1"
ARMPKGARCH:tune-cortexx1                           = "cortexx1"
TUNE_FEATURES:tune-cortexx1                        = "aarch64 crypto cortexx1"
PACKAGE_EXTRA_ARCHS:tune-cortexx1                  = "${PACKAGE_EXTRA_ARCHS:tune-armv8-2a-crypto} cortexx1"
BASE_LIB:tune-cortexx1                             = "lib64"
```

## poky/meta/conf/machine/include/arm/armv8-2a/tune-neoversee1.inc
```bitbake
#
# Tune Settings for Neoverse-E1
#
DEFAULTTUNE                                        ?= "neoversee1"

TUNEVALID[neoversee1] = "Enable Neoverse-E1 specific processor optimizations"
TUNE_CCARGS .= "${@bb.utils.contains('TUNE_FEATURES', 'neoversee1', ' -mcpu=neoverse-e1', '', d)}"

require conf/machine/include/arm/arch-armv8-2a.inc

# Little Endian base configs
AVAILTUNES                                         += "neoversee1"
ARMPKGARCH:tune-neoversee1                          = "neoversee1"
TUNE_FEATURES:tune-neoversee1                       = "${TUNE_FEATURES:tune-armv8-2a-crypto} neoversee1"
PACKAGE_EXTRA_ARCHS:tune-neoversee1                 = "${PACKAGE_EXTRA_ARCHS:tune-armv8-2a-crypto} neoversee1"
BASE_LIB:tune-neoversee1                            = "lib64"
```

## poky/meta/conf/machine/include/arm/armv8-2a/tune-neoversen1.inc
```bitbake
#
# Tune Settings for Neoverse-N1
#
DEFAULTTUNE                                        ?= "neoversen1"

TUNEVALID[neoversen1] = "Enable Neoverse-N1 specific processor optimizations"
# Note: Neoverse was called Ares, and GCC will accept "ares" in place of "neoverse-n1"
TUNE_CCARGS .= "${@bb.utils.contains('TUNE_FEATURES', 'neoversen1', ' -mcpu=neoverse-n1', '', d)}"

require conf/machine/include/arm/arch-armv8-2a.inc

# Little Endian base configs
AVAILTUNES                                         += "neoversen1"
ARMPKGARCH:tune-neoversen1                          = "neoversen1"
TUNE_FEATURES:tune-neoversen1                       = "${TUNE_FEATURES:tune-armv8-2a-crypto} neoversen1"
PACKAGE_EXTRA_ARCHS:tune-neoversen1                 = "${PACKAGE_EXTRA_ARCHS:tune-armv8-2a-crypto} neoversen1"
BASE_LIB:tune-neoversen1                            = "lib64"
```

## poky/meta/conf/machine/include/arm/armv8-2a/tune-octeontx2.inc
```bitbake
DEFAULTTUNE ?= "octeontx2"

TUNEVALID[octeontx2] = "Enable Marvell octeontx2 specific processor optimizations"
TUNE_CCARGS .= "${@bb.utils.contains('TUNE_FEATURES', 'octeontx2', ' -mcpu=octeontx2', '', d)}"

require conf/machine/include/arm/arch-armv8-2a.inc

# Little Endian base configs
AVAILTUNES += "octeontx2"
ARMPKGARCH:tune-octeontx2             = "octeontx2"
TUNE_FEATURES:tune-octeontx2          = "${TUNE_FEATURES:tune-armv8-2a-crypto} octeontx2"
PACKAGE_EXTRA_ARCHS:tune-octeontx2    = "${PACKAGE_EXTRA_ARCHS:tune-armv8-2a-crypto} octeontx2"
BASE_LIB:tune-octeontx2               = "lib64"
```

## poky/meta/conf/machine/include/arm/armv8-m/tune-cortexm23.inc
```bitbake
#
# Tune Settings for Cortex-M23
#
DEFAULTTUNE ?= "cortexm23"

TUNEVALID[cortexm23] = "Enable Cortex-M23 specific processor optimizations"
TUNE_CCARGS .= "${@bb.utils.contains('TUNE_FEATURES', 'cortexm23', ' -mcpu=cortex-m23', '', d)}"

require conf/machine/include/arm/arch-armv8m-base.inc

AVAILTUNES                          += "cortexm23"
ARMPKGARCH:tune-cortexm23            = "cortexm23"
TUNE_FEATURES:tune-cortexm23         = "${TUNE_FEATURES:tune-armv8m-base} cortexm23"
PACKAGE_EXTRA_ARCHS:tune-cortexm23   = "${PACKAGE_EXTRA_ARCHS:tune-armv8m-base} cortexm23"
```

## poky/meta/conf/machine/include/arm/armv8-m/tune-cortexm35p.inc
```bitbake
#
# Tune Settings for Cortex-M35P
#
DEFAULTTUNE ?= "cortexm35p"

TUNEVALID[cortexm35p] = "Enable Cortex-M35p specific processor optimizations"
TUNE_CCARGS .= "${@bb.utils.contains('TUNE_FEATURES', 'cortexm35p', ' -mcpu=cortex-m35p', '', d)}"

require conf/machine/include/arm/arch-armv8m-main.inc

# GCC thnks that DSP and VFP are required, but Arm docs say it is
# optional.  So forcing below so that compiling works, but this should
# be fixed in GCC
AVAILTUNES                          += "cortexm35p"
ARMPKGARCH:tune-cortexm35p           = "cortexm35p"
TUNE_FEATURES:tune-cortexm35p        = "${TUNE_FEATURES:tune-armv8m-maine-vfpv5spd16} cortexm35p"
PACKAGE_EXTRA_ARCHS:tune-cortexm35p  = "${PACKAGE_EXTRA_ARCHS:tune-armv8m-maine-vfpv5spd16} cortexm35pe-fpv5-spd16"
```

## poky/meta/conf/machine/include/arm/armv8a/tune-cortexa32.inc
```bitbake
DEFAULTTUNE ?= "cortexa32"

TUNEVALID[cortexa32] = "Enable Cortex-A32 specific processor optimizations"
TUNE_CCARGS .= "${@bb.utils.contains('TUNE_FEATURES', 'cortexa32', ' -mcpu=cortex-a32', '', d)}"

require conf/machine/include/arm/arch-armv8a.inc

# Little Endian base configs
AVAILTUNES += "cortexa32 cortexa32-crypto"
ARMPKGARCH:tune-cortexa32             = "cortexa32"
ARMPKGARCH:tune-cortexa32-crypto      = "cortexa32"
# We do not want -march since -mcpu is added above to cover for it
TUNE_FEATURES:tune-cortexa32          = "armv8a cortexa32 crc callconvention-hard neon"
TUNE_FEATURES:tune-cortexa32-crypto   = "${TUNE_FEATURES:tune-cortexa32} crypto"
PACKAGE_EXTRA_ARCHS:tune-cortexa32             = "${PACKAGE_EXTRA_ARCHS:tune-armv8a-crc} cortexa32 cortexa32hf-neon"
PACKAGE_EXTRA_ARCHS:tune-cortexa32-crypto      = "${PACKAGE_EXTRA_ARCHS:tune-armv8a-crc-crypto} cortexa32 cortexa32hf-neon cortexa32hf-neon-crypto"
BASE_LIB:tune-cortexa32               = "lib"
BASE_LIB:tune-cortexa32-crypto        = "lib"
```

## poky/meta/conf/machine/include/arm/armv8a/tune-cortexa34.inc
```bitbake
#
# Tune Settings for Cortex-A34
#
DEFAULTTUNE ?= "cortexa34"

TUNEVALID[cortexa34] = "Enable Cortex-A34 specific processor optimizations"
TUNE_CCARGS .= "${@bb.utils.contains('TUNE_FEATURES', 'cortexa34', ' -mcpu=cortex-a34', '', d)}"

require conf/machine/include/arm/arch-armv8a.inc

# Little Endian base configs
AVAILTUNES                                += "cortexa34 cortexa34-crypto"
ARMPKGARCH_tune-cortexa34                  = "cortexa34"
ARMPKGARCH_tune-cortexa34-crypto           = "cortexa34"
TUNE_FEATURES_tune-cortexa34               = "${TUNE_FEATURES_tune-armv8a-crc} cortexa34"
TUNE_FEATURES_tune-cortexa34-crypto        = "${TUNE_FEATURES_tune-cortexa34} crypto"
PACKAGE_EXTRA_ARCHS_tune-cortexa34         = "${PACKAGE_EXTRA_ARCHS_tune-armv8a-crc} cortexa34"
PACKAGE_EXTRA_ARCHS_tune-cortexa34-crypto  = "${PACKAGE_EXTRA_ARCHS_tune-armv8a-crc-crypto} cortexa34 cortexa34-crypto"
BASE_LIB_tune-cortexa34                    = "lib64"
BASE_LIB_tune-cortexa34-crypto             = "lib64"
```

## poky/meta/conf/machine/include/arm/armv8a/tune-cortexa35.inc
```bitbake
DEFAULTTUNE ?= "cortexa35"

TUNEVALID[cortexa35] = "Enable Cortex-A35 specific processor optimizations"
TUNE_CCARGS .= "${@bb.utils.contains('TUNE_FEATURES', 'cortexa35', ' -mcpu=cortex-a35', '', d)}"

require conf/machine/include/arm/arch-armv8a.inc

# Little Endian base configs
AVAILTUNES += "cortexa35 cortexa35-crypto"
ARMPKGARCH:tune-cortexa35             = "cortexa35"
ARMPKGARCH:tune-cortexa35-crypto      = "cortexa35"
TUNE_FEATURES:tune-cortexa35          = "${TUNE_FEATURES:tune-armv8a-crc} cortexa35"
TUNE_FEATURES:tune-cortexa35-crypto   = "${TUNE_FEATURES:tune-cortexa35} crypto"
PACKAGE_EXTRA_ARCHS:tune-cortexa35             = "${PACKAGE_EXTRA_ARCHS:tune-armv8a-crc} cortexa35"
PACKAGE_EXTRA_ARCHS:tune-cortexa35-crypto      = "${PACKAGE_EXTRA_ARCHS:tune-armv8a-crc-crypto} cortexa35 cortexa35-crypto"
BASE_LIB:tune-cortexa35               = "lib64"
BASE_LIB:tune-cortexa35-crypto        = "lib64"
```
