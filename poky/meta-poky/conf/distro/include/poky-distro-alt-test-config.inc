## poky/meta-yocto-bsp/conf/machine/edgerouter.conf
```bitbake
#@TYPE: Machine
#@NAME: Edgerouter
#@DESCRIPTION: Edgerouter

require conf/machine/include/tune-mips64.inc

MACHINE_FEATURES = "pci ext2 ext3 serial"

KERNEL_IMAGETYPE = "vmlinux"
KERNEL_ALT_IMAGETYPE = "vmlinux.bin"
KERNEL_IMAGE_STRIP_EXTRA_SECTIONS  = ".comment"

PREFERRED_PROVIDER_virtual/kernel ?= "linux-yocto"
PREFERRED_VERSION_linux-yocto ?= "4.18%"

SERIAL_CONSOLES = "115200;ttyS0"
USE_VT ?= "0"

MACHINE_EXTRA_RRECOMMENDS = "kernel-modules"

IMAGE_FSTYPES ?= "jffs2 tar.bz2 wic wic.bmap"
JFFS2_ERASEBLOCK = "0x10000"

WKS_FILE ?= "edgerouter.wks"
IMAGE_BOOT_FILES ?= "vmlinux;vmlinux.64"
do_image_wic[depends] += "mtools-native:do_populate_sysroot dosfstools-native:do_populate_sysroot"
```

## poky/meta-yocto-bsp/conf/machine/genericarm64.conf
```bitbake
#@TYPE: Machine
#@NAME: genericarm64
#@DESCRIPTION: Generic Arm64 machine for typical SystemReady IR/ES platforms, which
#have working firmware and boot via EFI.

require conf/machine/include/arm/arch-armv8a.inc

# Arm Base System Architecture says v8.0+ is allowed, but FEAT_CRC32 is required
DEFAULTTUNE = "armv8a-crc"

MACHINE_FEATURES = "acpi alsa bluetooth efi keyboard pci qemu-usermode rtc screen usbhost vfat wifi"

KERNEL_IMAGETYPE = "Image"
PREFERRED_PROVIDER_virtual/kernel ?= "linux-yocto"

# Install all the kernel modules into the rootfs
MACHINE_EXTRA_RRECOMMENDS += "kernel-modules"
# Install selected pieces of firmware
MACHINE_EXTRA_RRECOMMENDS += "linux-firmware-wl12xx linux-firmware-wl18xx linux-firmware-rtl-nic"

# Use an initramfs and populate it with the kernel modules and key firmware
INITRAMFS_IMAGE ?= "core-image-initramfs-boot"
PACKAGE_INSTALL:append:pn-core-image-initramfs-boot = " ${MACHINE_EXTRA_RRECOMMENDS}"

IMAGE_FSTYPES ?= "wic"
WKS_FILE ?= "genericarm64.wks.in"

EFI_PROVIDER ?= "${@bb.utils.contains("DISTRO_FEATURES", "systemd", "systemd-boot", "grub-efi", d)}"

# Try to bring up one physical serial console, or a virtualized serial console
SERIAL_CONSOLES ?= "115200;ttyAMA0 115200;hvc0"

# Allow u-boot to be built for use with qemu-system-aarch64.
# This u-boot is _not_ suitable for use with real hardware, and the expectation
# of this machine is that real hardware comes with the firmware pre-loaded.
UBOOT_MACHINE = "qemu_arm64_defconfig"

# runqemu configuration to run a genericarm64 image inside a qemu-system-aarch64. You will need
# to build u-boot explicitly.
IMAGE_CLASSES += "qemuboot"
QB_SYSTEM_NAME = "qemu-system-aarch64"
# Boot the virtual machine with either an emulated Cortex-A76, or the host if using KVM
QB_MACHINE = "-machine virt"
QB_CPU = "-cpu cortex-a76"
QB_CPU_KVM = "-cpu host -machine gic-version=3"
QB_SMP = "-smp 4"
# Boot into U-Boot and let that scan the disk for the next step, don't pass any kernel or filesystem hints
QB_DEFAULT_BIOS = "u-boot.bin"
QB_DEFAULT_KERNEL = "none"
QB_DEFAULT_FSTYPE = "wic"
QB_FSINFO = "wic:no-kernel-in-fs"
# Mount the wic rootfs as a virtio block device
QB_ROOTFS_OPT = "-drive id=root,file=@ROOTFS@,if=none,format=raw -device virtio-blk-pci,drive=root"
# Virtio graphics
QB_GRAPHICS = "-device virtio-gpu-pci"
# Virtio serial consoles
QB_SERIAL_OPT = "-device virtio-serial-pci -chardev null,id=virtcon -device virtconsole,chardev=virtcon"
QB_TCPSERIAL_OPT = "-device virtio-serial-pci -chardev socket,id=virtcon,port=@PORT@,host=127.0.0.1,nodelay=on -device virtconsole,chardev=virtcon"
# Virtio networking
QB_TAP_OPT = "-netdev tap,id=net0,ifname=@TAP@,script=no,downscript=no"
```

## poky/meta-yocto-bsp/conf/machine/genericx86-64.conf
```bitbake
#@TYPE: Machine
#@NAME: Generic x86_64
#@DESCRIPTION: Machine configuration for generic x86_64 (64-bit) PCs and servers. Supports a moderately wide range of drivers that should boot and be usable on "typical" hardware.

DEFAULTTUNE ?= "core2-64"
require conf/machine/include/x86/tune-x86-64-v3.inc
require conf/machine/include/genericx86-common.inc

#For runqemu
QB_SYSTEM_NAME = "qemu-system-x86_64"
```

## poky/meta-yocto-bsp/conf/machine/genericx86.conf
```bitbake
#@TYPE: Machine
#@NAME: Generic x86
#@DESCRIPTION: Machine configuration for generic x86 (32-bit) PCs. Supports a moderately wide range of drivers that should boot and be usable on "typical" hardware.

DEFAULTTUNE ?= "core2-32"
require conf/machine/include/tune-core2.inc
require conf/machine/include/genericx86-common.inc

MACHINE_ESSENTIAL_EXTRA_RRECOMMENDS += "gma500-gfx-check"
#For runqemu
QB_SYSTEM_NAME = "qemu-system-i386"
```

## poky/meta-yocto-bsp/conf/machine/include/genericx86-common.inc
```bitbake
include conf/machine/include/x86/x86-base.inc
require conf/machine/include/x86/qemuboot-x86.inc
MACHINE_FEATURES += "wifi efi pcbios"

PREFERRED_VERSION_linux-yocto ?= "5.15%"
PREFERRED_PROVIDER_virtual/kernel ?= "linux-yocto"
PREFERRED_PROVIDER_virtual/xserver ?= "xserver-xorg"
XSERVER ?= "${XSERVER_X86_BASE} \
            ${XSERVER_X86_EXT} \
            ${XSERVER_X86_I915} \
            ${XSERVER_X86_I965} \
            ${XSERVER_X86_FBDEV} \
            ${XSERVER_X86_VESA} \
            ${XSERVER_X86_MODESETTING} \
           "

MACHINE_EXTRA_RRECOMMENDS += "kernel-modules linux-firmware"

GLIBC_ADDONS = "nptl"

EXTRA_OECONF:append:pn-matchbox-panel-2 = " --with-battery=acpi"

IMAGE_FSTYPES += "wic wic.bmap"
WKS_FILE ?= "genericx86.wks.in"
EFI_PROVIDER ??= "grub-efi"
do_image_wic[depends] += "gptfdisk-native:do_populate_sysroot"
do_image_wic[recrdeptask] += "do_bootimg"
```

## poky/meta-yocto-bsp/conf/machine/mpc8315e-rdb.conf
```bitbake
#@TYPE: Machine
#@DESCRIPTION: Machine configuration for running

TARGET_FPU = ""

require conf/machine/include/tune-ppce300c3.inc

KERNEL_IMAGETYPE = "uImage"

EXTRA_IMAGEDEPENDS += "u-boot"
UBOOT_MACHINE = "MPC8315ERDB_config"

SERIAL_CONSOLES = "115200;ttyS0"

MACHINE_FEATURES = "keyboard pci ext2 ext3 serial"

PREFERRED_VERSION_linux-yocto ?= "4.18%"
PREFERRED_PROVIDER_virtual/kernel ?= "linux-yocto"

PREFERRED_PROVIDER_virtual/xserver ?= "xserver-xorg"
XSERVER ?= "xserver-xorg \
            xf86-video-fbdev"

UBOOT_ENTRYPOINT = "0x00000000"

KERNEL_DEVICETREE = "mpc8315erdb.dtb"

MACHINE_EXTRA_RRECOMMENDS = "kernel-modules"

IMAGE_FSTYPES ?= "jffs2 tar.bz2"
JFFS2_ERASEBLOCK = "0x4000"

IMAGE_FSTYPES += "wic wic.bmap"
WKS_FILE ?= 'mpc8315e-rdb.wks'
IMAGE_BOOT_FILES ?= "u-boot.bin uImage mpc8315erdb.dtb;dtb"
```

## poky/meta-yocto-bsp/wic/beaglebone-yocto.wks
```
# short-description: Create SD card image for Beaglebone
# long-description: Creates a partitioned SD card image for Beaglebone.
# Boot files are located in the first vfat partition.

part /boot --source bootimg-partition --ondisk mmcblk0 --fstype=vfat --label boot --active --align 4 --size 16 --sourceparams="loader=u-boot" --use-uuid
part / --source rootfs --ondisk mmcblk --fstype=ext4 --label root --align 4 --use-uuid
bootloader --append="console=ttyS0,115200"
```

## poky/meta-yocto-bsp/wic/edgerouter.wks
```
# short-description: Create SD card image for Edgerouter
# long-description: Create a partitioned SD card image for MIPS64 Edgerouter reference hardware.
part /boot --source bootimg-partition --ondisk sda --fstype=vfat --label boot --active --align 4 --size 16
part / --source rootfs --ondisk sda --fstype=ext4 --label root --align 4
```

## poky/meta/conf/distro/defaultsetup.conf
```bitbake
include conf/distro/include/default-providers.inc
include conf/distro/include/default-versions.inc
include conf/distro/include/default-distrovars.inc
include conf/distro/include/maintainers.inc
include conf/distro/include/time64.inc
require conf/distro/include/tcmode-${TCMODE}.inc
require conf/distro/include/tclibc-${TCLIBC}.inc

require conf/distro/include/uninative-flags.inc

# Allow single libc distros to disable this code
TCLIBCAPPEND ?= "-${TCLIBC}"
TMPDIR .= "${TCLIBCAPPEND}"

USER_CLASSES ?= ""
PACKAGE_CLASSES ?= "package_ipk"
INHERIT_DISTRO ?= "debian devshell sstate license remove-libtool create-spdx"
INHERIT += "${PACKAGE_CLASSES} ${USER_CLASSES} ${INHERIT_DISTRO}"

INIT_MANAGER ??= "none"
require conf/distro/include/init-manager-${INIT_MANAGER}.inc
```
