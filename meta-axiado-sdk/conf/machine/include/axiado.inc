## meta-axiado-sdk/conf/machine/include/axiado.inc
```bitbake
# Copyright (c) 2021-24 Axiado Corporation (or its affiliates). All rights reserved.

SOC_FAMILY = "axiado-ax3000"
include conf/machine/include/soc-family.inc
include conf/machine/include/arm/arch-arm64.inc

require VERSION.inc
LATEST_RELEASE_VERSION = "release/release-${COMPONENT_VERSION_MAJOR}.${COMPONENT_VERSION_MINOR}.${COMPONENT_PATCHLEVEL}"

PREFERRED_PROVIDER_virtual/kernel ?= "linux-axiado"
PREFERRED_VERSION_linux-axiado ?= "6.6.16+git"
PREFERRED_PROVIDER_virtual/bootloader ?= "u-boot-axiado"
PREFERRED_PROVIDER_u-boot ?= "u-boot-axiado"
PREFERRED_VERSION_u-boot-axiado ?= "2022.01+git"
PREFERRED_PROVIDER_u-boot-fw-utils ?= "libubootenv"

INITRAMFS_CTYPE ?= "xz"
INITRAMFS_FSTYPES = "cpio.${INITRAMFS_CTYPE}"
IMAGE_FSTYPES = "${INITRAMFS_FSTYPES}"

KERNEL_CLASSES ?= "kernel-fitimage"

# Build var, valid values are ["dbg", "dev", "prod"]
# Dbg builds initramfs image with filesystem + kernel in a single image and u-boot
# Dev builds kernel-fitImage and eMMC image with wic filesystem and u-boot
# Prod builds kernel-fitImage and eMMC image with wic filesystem and Axiado-signed u-boot
# For modifying this value, add BUILD_VAR = "dev" in local.conf file under build/<machine>
BUILD_VAR ??= "prod"
require conf/machine/include/axiado-${BUILD_VAR}.inc

INITRAMFS_IMAGE_BUNDLE = "1"

DEFAULTTUNE:ax3000 ?= "aarch64"

KERNEL_IMAGETYPES ?= "${KERNEL_IMAGETYPE}"

UBOOT_ENTRYPOINT ?= "0x3E000000"
UBOOT_LOADADDRESS ?= "0x3E000000"
UBOOT_DTB_LOADADDRESS ?= "0x3FF00000"

#this is needed by emmc, avoid removing it.
BAD_RECOMMENDATIONS:remove = "e2fsprogs-e2fsck"
```

## meta-axiado-sdk/meta-common/conf/layer.conf
```bitbake
# We have a conf and classes directory, add to BBPATH
BBPATH .= ":${LAYERDIR}"

# We have recipes-* directories, add to BBFILES
BBFILES += "${LAYERDIR}/recipes-*/*/*.bbappend"

BBFILE_COLLECTIONS += "axiado-common-sdk"
BBFILE_PATTERN_axiado-common-sdk := "^${LAYERDIR}/"
LAYERSERIES_COMPAT_axiado-common-sdk := "whinlatter walnascar"
```

## meta-axiado-sdk/meta-evk/conf/layer.conf
```bitbake
# We have a conf and classes directory, add to BBPATH
BBPATH .= ":${LAYERDIR}"

# We have recipes-* directories, add to BBFILES
BBFILES += "${LAYERDIR}/recipes-*/*.bbappend \
            ${LAYERDIR}/recipes-*/*/*.bbappend \
            ${LAYERDIR}/recipes-*/*/*/*.bbappend"

BBFILE_COLLECTIONS += "evk-axiado"
BBFILE_PATTERN_evk-axiado = "^${LAYERDIR}/"
LAYERSERIES_COMPAT_evk-axiado = "whinlatter walnascar"
```

## meta-axiado-sdk/meta-evk/conf/machine/evk-axiado-github.conf
```bitbake
KERNEL_DEVICETREE = "axiado/ax3000-scm3003-evk-axiado.dtb"
KERNEL_DEVICETREE += "axiado/ax3000-scm3002-evk-axiado.dtb"
KERNEL_DEVICETREE += "axiado/ax3080-evk-axiado.dtb"

SOC_REVISION = "revA"

# Conditional assignments for different board revisions
UBOOT_MACHINE_revA = "ax3000_evk_defconfig"
UBOOT_MACHINE_revB = "ax3000b0_evk_defconfig"

# Dynamically set KBUILD_DEFCONFIG based on SOC_REVISION
UBOOT_MACHINE = "${UBOOT_MACHINE_${SOC_REVISION}}"

# Fallback to default if SOC_REVISION is not set or doesn't match
UBOOT_MACHINE ??= "ax3000_evk_defconfig"

BUILD_VAR ?= "dev"

require conf/machine/include/axiado.inc
require conf/machine/include/obmc-evb-common.inc

PREFERRED_VERSION_u-boot-axiado = "2019.04+git"
PREFERRED_VERSION_linux-axiado = "6.6.106+git"
PREFERRED_VERSION_sysproxy = "0.1"
PREFERRED_VERSION_tdfu = "0.1"
PREFERRED_VERSION_anx7688-axiado = "0.1"
PREFERRED_VERSION_eipdrv-axiado = "0.1"
PREFERRED_VERSION_klogmgr = "0.1"
PREFERRED_VERSION_shimfwl-axiado = "0.1"

FLASH_SIZE = "65535"
SERIAL_CONSOLES = "115200;ttyPS3"

OBMC_COMPATIBLE_NAMES = "ax3000"
EXTENDED_VERSION = "${DISTRO_VERSION}"

# Install Kernel modules
MACHINE_EXTRA_RRECOMMENDS = "kernel-modules"

IMAGE_FEATURES:remove = " \
    obmc-chassis-mgmt \
    obmc-chassis-state-mgmt \
    obmc-fan-control \
    obmc-fan-mgmt \
    obmc-host-ipmi \
    obmc-host-state-mgmt \
"

VIRTUAL-RUNTIME_obmc-inventory-manager = "entity-manager"
VIRTUAL-RUNTIME_obmc-sensors-hwmon = "dbus-sensors"

# Fix sysproxy build error
DEBUG_PREFIX_MAP:remove = "-fcanon-prefix-map"
```

## meta-axiado-sdk/meta-evk/conf/machine/evk-axiado.conf
```bitbake
KERNEL_DEVICETREE = "axiado/axiado-evk-mt2.dtb"
KERNEL_DEVICETREE += "axiado/axiado-evk-sb2.dtb"
KERNEL_DEVICETREE += "axiado/ax3080a1s_hv2.dtb"

SOC_REVISION = "revA"

# Conditional assignments for different board revisions
UBOOT_MACHINE_revA = "ax3000_evk_defconfig"
UBOOT_MACHINE_revB = "ax3000b0_evk_defconfig"

# Dynamically set KBUILD_DEFCONFIG based on SOC_REVISION
UBOOT_MACHINE = "${UBOOT_MACHINE_${SOC_REVISION}}"

# Fallback to default if SOC_REVISION is not set or doesn't match
UBOOT_MACHINE ??= "ax3000_evk_defconfig"

require conf/machine/include/axiado.inc
require conf/machine/include/obmc-evb-common.inc

FLASH_SIZE = "65535"
SERIAL_CONSOLES = "115200;ttyPS3"

OBMC_COMPATIBLE_NAMES = "ax3000"
EXTENDED_VERSION = "${DISTRO_VERSION}"

# Install Kernel modules
MACHINE_EXTRA_RRECOMMENDS = "kernel-modules"

IMAGE_FEATURES:remove = " \
    obmc-chassis-mgmt \
    obmc-chassis-state-mgmt \
    obmc-fan-control \
    obmc-fan-mgmt \
    obmc-host-ipmi \
    obmc-host-state-mgmt \
    obmc-ikvm \
"

VIRTUAL-RUNTIME_obmc-inventory-manager = "entity-manager"
VIRTUAL-RUNTIME_obmc-sensors-hwmon = "dbus-sensors"

# Fix sysproxy build error
DEBUG_PREFIX_MAP:remove = "-fcanon-prefix-map"
```

## meta-bytedance/conf/layer.conf
```bitbake
# We have a conf and classes directory, add to BBPATH
BBPATH .= ":${LAYERDIR}"

# We have recipes-* directories, add to BBFILES
BBFILES += "${LAYERDIR}/recipes-*/*/*.bb \
            ${LAYERDIR}/recipes-*/*/*.bbappend"

BBFILE_COLLECTIONS += "bytedance-layer"
BBFILE_PATTERN_bytedance-layer = "^${LAYERDIR}/"
LAYERSERIES_COMPAT_bytedance-layer = "dunfell gatesgarth"
```

## meta-bytedance/meta-g220a/conf/bblayers.conf.sample
```bitbake
# LAYER_CONF_VERSION is increased each time build/conf/bblayers.conf
# changes incompatibly
LCONF_VERSION = "8"

BBPATH = "${TOPDIR}"
BBFILES ?= ""

BBLAYERS ?= " \
  ##OEROOT##/meta \
  ##OEROOT##/meta-openembedded/meta-oe \
  ##OEROOT##/meta-openembedded/meta-networking \
  ##OEROOT##/meta-openembedded/meta-perl \
  ##OEROOT##/meta-openembedded/meta-python \
  ##OEROOT##/meta-phosphor \
  ##OEROOT##/meta-aspeed \
  ##OEROOT##/meta-bytedance \
  ##OEROOT##/meta-bytedance/meta-g220a \
  "
BBLAYERS_NON_REMOVABLE ?= " \
  ##OEROOT##/meta \
  ##OEROOT##/meta-openembedded/meta-oe \
  ##OEROOT##/meta-openembedded/meta-networking \
  ##OEROOT##/meta-openembedded/meta-perl \
  ##OEROOT##/meta-openembedded/meta-python \
  ##OEROOT##/meta-phosphor \
  ##OEROOT##/meta-aspeed \
  ##OEROOT##/meta-bytedance \
  ##OEROOT##/meta-bytedance/meta-g220a \
  "
```

## meta-bytedance/meta-g220a/conf/layer.conf
```bitbake
# We have a conf and classes directory, add to BBPATH
BBPATH .= ":${LAYERDIR}"

# We have recipes-* directories, add to BBFILES
BBFILES += "${LAYERDIR}/recipes-*/*/*.bb \
            ${LAYERDIR}/recipes-*/*/*.bbappend"

BBFILE_COLLECTIONS += "g220a-layer"
BBFILE_PATTERN_g220a-layer := "^${LAYERDIR}/"
LAYERSERIES_COMPAT_g220a-layer = "scarthgap styhead"
```

## meta-bytedance/meta-g220a/conf/machine/g220a.conf
```bitbake
KMACHINE = "aspeed"
KERNEL_DEVICETREE = "${KMACHINE}-bmc-bytedance-${MACHINE}.dtb"

UBOOT_MACHINE = "evb-ast2500_defconfig"
UBOOT_DEVICETREE = "ast2500-evb"

FLASH_SIZE = "65536"

require conf/machine/include/ast2500.inc
require conf/machine/include/obmc-bsp-common.inc
require conf/distro/include/phosphor-aspeednic-use-mac2.inc

MACHINE_FEATURES += "\
        obmc-bmc-state-mgmt \
        obmc-chassis-state-mgmt \
        obmc-host-ipmi \
        obmc-host-state-mgmt \
        obmc-phosphor-chassis-mgmt \
        obmc-phosphor-fan-mgmt \
        obmc-phosphor-flash-mgmt \
        "

VIRTUAL-RUNTIME_obmc-inventory-manager = "entity-manager"
PREFERRED_PROVIDER_virtual/obmc-inventory-data = "entity-manager"

VIRTUAL-RUNTIME_obmc-host-state-manager ?= "x86-power-control"
VIRTUAL-RUNTIME_obmc-chassis-state-manager ?= "x86-power-control"

PREFERRED_PROVIDER_virtual/obmc-chassis-mgmt = "packagegroup-bytedance-apps"
PREFERRED_PROVIDER_virtual/obmc-fan-mgmt = "packagegroup-bytedance-apps"
PREFERRED_PROVIDER_virtual/obmc-flash-mgmt = "packagegroup-bytedance-apps"
PREFERRED_PROVIDER_virtual/obmc-host-ipmi-hw ?= "phosphor-ipmi-kcs"
PREFERRED_PROVIDER_virtual/obmc-system-mgmt = "packagegroup-bytedance-apps"

PREFERRED_PROVIDER_virtual/bootloader = "u-boot-aspeed-sdk"
PREFERRED_PROVIDER_u-boot = "u-boot-aspeed-sdk"
PREFERRED_PROVIDER_u-boot-fw-utils = "u-boot-fw-utils-aspeed-sdk"
```

## meta-delta/conf/layer.conf
```bitbake
# We have a conf and classes directory, add to BBPATH
BBPATH .= ":${LAYERDIR}"

# We have recipes-* directories, add to BBFILES
BBFILES += "${LAYERDIR}/meta-common/recipes-*/*/*.bb \
            ${LAYERDIR}/meta-common/recipes-*/*/*.bbappend"

BBFILE_COLLECTIONS += "delta-layer"
BBFILE_PATTERN_delta-layer = "^${LAYERDIR}/"
LAYERVERSION_delta-layer = "1"
LAYERSERIES_COMPAT_delta-layer = "scarthgap styhead"
```

## meta-delta/meta-ahe50dc/conf/layer.conf
```bitbake
# We have a conf and classes directory, add to BBPATH
BBPATH .= ":${LAYERDIR}"

# We have recipes-* directories, add to BBFILES
BBFILES += "${LAYERDIR}/recipes-*/*/*.bb \
            ${LAYERDIR}/recipes-*/*/*.bbappend"

BBFILE_COLLECTIONS += "ahe50dc-layer"
BBFILE_PATTERN_ahe50dc-layer = "^${LAYERDIR}/"
LAYERSERIES_COMPAT_ahe50dc-layer = "scarthgap styhead"
```

## meta-delta/meta-ahe50dc/conf/machine/ahe50dc.conf
```bitbake
KMACHINE = "aspeed"
KERNEL_DEVICETREE = "${KMACHINE}-bmc-delta-${MACHINE}.dtb"

UBOOT_MACHINE = "evb-ast2400_defconfig"
UBOOT_DEVICETREE = "ast2400-ahe-50dc"

FLASH_SIZE = "32768"

require conf/machine/include/ast2400.inc
require conf/machine/include/obmc-bsp-common.inc

PREFERRED_PROVIDER_virtual/obmc-chassis-mgmt = "packagegroup-delta-apps"
PREFERRED_PROVIDER_virtual/obmc-fan-mgmt = "packagegroup-delta-apps"
PREFERRED_PROVIDER_virtual/obmc-flash-mgmt = "packagegroup-delta-apps"
PREFERRED_PROVIDER_virtual/obmc-system-mgmt = "packagegroup-delta-apps"

PREFERRED_PROVIDER_virtual/bootloader = "u-boot-aspeed-sdk"
PREFERRED_PROVIDER_u-boot = "u-boot-aspeed-sdk"
PREFERRED_PROVIDER_u-boot-fw-utils = "u-boot-fw-utils-aspeed-sdk"

VIRTUAL-RUNTIME_obmc-inventory-manager = "entity-manager"
VIRTUAL-RUNTIME_obmc-sensors-hwmon = "dbus-sensors"

# features unneeded because ahe50dc doesn't have a host to manage
IMAGE_FEATURES:remove = " \
        obmc-chassis-mgmt \
        obmc-chassis-state-mgmt \
        obmc-console \
        obmc-host-ipmi \
        obmc-host-state-mgmt \
        obmc-ikvm \
        obmc-fan-control \
        obmc-fan-mgmt \
        "

SERIAL_CONSOLES:ahe50dc = "115200;ttyS2"
```

## meta-evb/conf/layer.conf
```bitbake
# We have a conf and classes directory, add to BBPATH
BBPATH .= ":${LAYERDIR}"

BBFILE_COLLECTIONS += "evb"
BBFILE_PATTERN_evb = ""

# Provide a variable that points the base of the evb layer.
EVBBASE = '${@os.path.normpath("${LAYERDIR}/")}'
```

## meta-evb/meta-evb-arm/meta-evb-fvp-base/conf/layer.conf
```bitbake
BBPATH .= ":${LAYERDIR}"

BBFILES += "\
${LAYERDIR}/recipes-*/*/*.bb \
${LAYERDIR}/recipes-*/*/*.bbappend \
"

BBFILE_COLLECTIONS += "evb-fvp-base"
BBFILE_PATTERN_evb-fvp-base = "^${LAYERDIR}/"
BBFILE_PRIORITY_evb-fvp-base = "6"
LAYERSERIES_COMPAT_evb-fvp-base = "scarthgap styhead"
```

## meta-evb/meta-evb-arm/meta-evb-fvp-base/conf/machine/fvp-config.inc
```bitbake
# Armv8-A Base Platform FVP Specific Parameters

FVP_PROVIDER ?= "fvp-base-a-aem-native"
FVP_EXE ?= "FVP_Base_RevC-2xAEMvA"

# Network
FVP_CONFIG[bp.hostbridge.interfaceName] = "enp97s0"
FVP_CONFIG[bp.hostbridge.userNetworking] = "1"
FVP_CONFIG[bp.virtio_net.hostbridge.interfaceName] = "tap1"

# Ethernet controller
FVP_CONFIG[bp.smsc_91c111.enabled] = "1"
FVP_CONFIG[bp.virtio_net.enabled] = "1"

# Disable dc4 device for uart 1-3
FVP_CONFIG[bp.pl011_uart1.enable_dc4] = "0"
FVP_CONFIG[bp.pl011_uart2.enable_dc4] = "0"
FVP_CONFIG[bp.pl011_uart3.enable_dc4] = "0"

# Set the baseline to ARMv8.4, as the default is 8.0.
FVP_CONFIG[cluster0.has_arm_v8-4] = "1"
FVP_CONFIG[cluster1.has_arm_v8-4] = "1"

# FVP Terminal/console outpot settings
FVP_CONFIG[bp.hostbridge.userNetPorts] = "4222=22,4223=443,4224=80"
FVP_CONSOLES[default] = "terminal_0"
FVP_TERMINALS[bp.terminal_0] ?= "Console"
FVP_TERMINALS[bp.terminal_1] ?= ""
FVP_TERMINALS[bp.terminal_2] ?= ""
FVP_TERMINALS[bp.terminal_3] ?= ""
# user can update ports as needed
FVP_CONFIG[bp.terminal_0.start_port] = "5064"
FVP_CONFIG[bp.terminal_1.start_port] = "5065"
FVP_CONFIG[bp.terminal_2.start_port] = "5066"
FVP_CONFIG[bp.terminal_3.start_port] = "5067"

# FIP image settings
# fip images can be inspected with 'fiptool' from TF-A
FVP_CONFIG[bp.secureflashloader.fname] = "bl1-fvp.bin"
FVP_CONFIG[bp.flashloader0.fname] = "fip-fvp.bin"
# enable randomness which is needed for various security related applications
FVP_CONFIG[bp.virtio_rng.enabled] = "1"
FVP_CONFIG[bp.virtio_rng.diagnostics] = "1"
FVP_CONFIG[cache_state_modelled] ?= "0"

# Enable MMC support
FVP_CONFIG[bp.mmc.p_mmc_file] = "obmc-phosphor-image-fvp.wic"
# use pad instead of silently truncate emmc image
FVP_CONFIG[bp.mmc.support_unpadded_images] = "1"
FVP_CONFIG[bp.mmc.diagnostics] = "0x1"
```

## meta-evb/meta-evb-arm/meta-evb-fvp-base/conf/machine/fvp.conf
```bitbake
#@TYPE: Machine
#@NAME: Armv8-A Base Platform FVP machine
#@DESCRIPTION: Machine configuration for Armv8-A Base Platform FVP model

include fvp-config.inc

require conf/distro/include/phosphor-mmc.inc
require conf/machine/include/arm/arch-armv8-4a.inc
require conf/distro/include/mctp.inc
require conf/distro/include/pldm.inc
require conf/machine/include/obmc-evb-common.inc
require conf/machine/include/obmc-bsp-common.inc

INHERIT += "fvpboot"

IMAGE_FSTYPES = "wic"
WKS_FILE = "emmc-fvp.wks.in"
IMAGE_BOOT_FILES = "fitImage-fvp.bin;fitImage"

SERIAL_CONSOLES = "115200;ttyAMA0"

PREFERRED_PROVIDER_virtual/kernel ?= "linux-yocto"
KERNEL_DEVICETREE = "arm/fvp-base-revc.dtb"
KERNEL_IMAGETYPE = "fitImage"

EXTRA_IMAGEDEPENDS += "trusted-firmware-a"

UBOOT_MACHINE = "vexpress_fvp_defconfig"

EXTRA_IMAGEDEPENDS += "u-boot"

FIT_ADDRESS_CELLS = "2"
UBOOT_LOADADDRESS = "0xa0000000"
UBOOT_ENTRYPOINT = "0xa0000000"

INITRAMFS_IMGAGE = "core-image-minimal-initramfs"
INITRAMFS_IMAGE_BUNDLE = "1"

IMAGE_INSTALL:append = "\
    ssh-pregen-hostkeys \
    pldm \
"

PREFERRED_PROVIDER_virtual/obmc-chassis-mgmt = "packagegroup-fvp-apps"
PREFERRED_PROVIDER_virtual/obmc-fan-mgmt = "packagegroup-fvp-apps"
PREFERRED_PROVIDER_virtual/obmc-flash-mgmt = "packagegroup-fvp-apps"
PREFERRED_PROVIDER_virtual/obmc-system-mgmt = "packagegroup-fvp-apps"
PREFERRED_PROVIDER_virtual/obmc-inventory-data = "packagegroup-fvp-apps"
PREFERRED_PROVIDER_virtual/obmc-user-mgmt = "packagegroup-fvp-apps"
PREFERRED_PROVIDER_virtual/obmc-host-ipmi-hw = "phosphor-ipmi-host"

# Disable "time jumped backwards" error as FVP could be out of sync with real time due to slower simulation
PACKAGECONFIG:remove:pn-systemd = "timesyncd"

MACHINE_FEATURES += "\
    obmc-host-ipmi \
"
```
