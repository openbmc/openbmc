## meta-amd/meta-daytonax/conf/layer.conf
```bitbake
# We have a conf and classes directory, add to BBPATH
BBPATH .= ":${LAYERDIR}"

# We have recipes-* directories, add to BBFILES
BBFILES += "${LAYERDIR}/recipes-*/*/*.bb \
	${LAYERDIR}/recipes-*/*/*.bbappend"

BBFILE_COLLECTIONS += "daytonax-layer"
BBFILE_PATTERN_daytonax-layer = "^${LAYERDIR}/"
BBFILE_PRIORITY_daytonax-layer = "6"

LAYERSERIES_COMPAT_daytonax-layer = "scarthgap styhead"
```

## meta-amd/meta-daytonax/conf/machine/daytonax.conf
```bitbake
KMACHINE = "aspeed"
KERNEL_DEVICETREE = "aspeed/${KMACHINE}-bmc-amd-${MACHINE}.dtb"

UBOOT_DEVICETREE = "ast2500-evb"
UBOOT_MACHINE = "evb-ast2500_defconfig"

require conf/machine/include/ast2500.inc
require conf/machine/include/obmc-bsp-common.inc
require conf/machine/include/amd.inc

SERIAL_CONSOLES = "115200;ttyS4"

FLASH_SIZE = "32768"

PREFERRED_PROVIDER_virtual/phosphor-led-manager-config-native = "daytonax-led-manager-config-native"
```

## meta-amd/meta-ethanolx/conf/layer.conf
```bitbake
# We have a conf and classes directory, add to BBPATH
BBPATH .= ":${LAYERDIR}"

# We have recipes-* directories, add to BBFILES
BBFILES += "${LAYERDIR}/recipes-*/*/*.bb \
	${LAYERDIR}/recipes-*/*/*.bbappend"

BBFILE_COLLECTIONS += "ethanolx-layer"
BBFILE_PATTERN_ethanolx-layer = "^${LAYERDIR}/"
BBFILE_PRIORITY_ethanolx-layer = "6"

LAYERSERIES_COMPAT_ethanolx-layer = "dunfell gatesgarth"
```

## meta-amd/meta-ethanolx/conf/machine/ethanolx.conf
```bitbake
KMACHINE = "aspeed"
KERNEL_DEVICETREE = "${KMACHINE}-bmc-amd-${MACHINE}.dtb"

UBOOT_DEVICETREE = "ast2500-evb"
UBOOT_MACHINE = "evb-ast2500_defconfig"

require conf/machine/include/ast2500.inc
require conf/machine/include/obmc-bsp-common.inc

SERIAL_CONSOLES = "115200;ttyS4"

FLASH_SIZE = "32768"

MACHINE_FEATURES += "\
        obmc-bmc-state-mgmt \
        obmc-chassis-state-mgmt \
        obmc-host-state-mgmt \
        obmc-phosphor-chassis-mgmt \
        obmc-host-ipmi \
        obmc-phosphor-fan-mgmt \
        obmc-phosphor-flash-mgmt \
        "

VIRTUAL-RUNTIME_skeleton_workbook = "${MACHINE}-config"
VIRTUAL-RUNTIME_obmc-host-state-manager ?= "x86-power-control"
VIRTUAL-RUNTIME_obmc-chassis-state-manager ?= "x86-power-control"
VIRTUAL-RUNTIME_obmc-sensors-hwmon ?= "dbus-sensors"

PREFERRED_PROVIDER_virtual/obmc-chassis-mgmt = "packagegroup-amd-apps"
PREFERRED_PROVIDER_virtual/obmc-fan-mgmt = "packagegroup-amd-apps"
PREFERRED_PROVIDER_virtual/obmc-flash-mgmt = "packagegroup-amd-apps"
PREFERRED_PROVIDER_virtual/obmc-host-ipmi-hw ?= "phosphor-ipmi-kcs"
PREFERRED_PROVIDER_virtual/obmc-inventory-data ?= "${VIRTUAL-RUNTIME_skeleton_workbook}"
PREFERRED_PROVIDER_virtual/obmc-system-mgmt = "packagegroup-amd-apps"
PREFERRED_PROVIDER_virtual/phosphor-led-manager-config-native = "ethanolx-led-manager-config-native"

OVERRIDES .= ":amd"
```

## meta-ampere/conf/layer.conf
```bitbake
# We have a conf and classes directory, add to BBPATH
BBPATH .= ":${LAYERDIR}"

# We have recipes-* directories, add to BBFILES
BBFILES += "${LAYERDIR}/meta-common/recipes-*/*/*.bb \
            ${LAYERDIR}/meta-common/recipes-*/*/*.bbappend"

BBFILE_COLLECTIONS += "ampere-layer"
BBFILE_PATTERN_ampere-layer := "^${LAYERDIR}/"
LAYERSERIES_COMPAT_ampere-layer = "scarthgap styhead"
```

## meta-ampere/meta-jade/conf/layer.conf
```bitbake
# We have a conf and classes directory, add to BBPATH
BBPATH .= ":${LAYERDIR}"

# We have recipes-* directories, add to BBFILES
BBFILES += "${LAYERDIR}/recipes-*/*/*.bb \
            ${LAYERDIR}/recipes-*/*/*.bbappend"

BBFILE_COLLECTIONS += "jade-layer"
BBFILE_PATTERN_jade-layer := "^${LAYERDIR}/"
LAYERSERIES_COMPAT_jade-layer = "dunfell gatesgarth"
```

## meta-ampere/meta-jade/conf/machine/mtjade.conf
```bitbake
KMACHINE = "aspeed"
KERNEL_DEVICETREE = "aspeed/${KMACHINE}-bmc-ampere-${MACHINE}.dtb"

UBOOT_MACHINE = "evb-ast2500_defconfig"
UBOOT_DEVICETREE = "ast2500-evb"

require conf/machine/include/ast2500.inc
require conf/machine/include/obmc-bsp-common.inc
require conf/distro/include/phosphor-aspeed-spi-master-mode.inc

# Reformat SPI flash layout to 64MB
FLASH_SIZE = "65536"

MACHINE_FEATURES += "\
        obmc-phosphor-chassis-mgmt \
        obmc-phosphor-flash-mgmt \
        obmc-phosphor-fan-mgmt \
        obmc-chassis-state-mgmt \
        obmc-host-state-mgmt \
        obmc-bmc-state-mgmt \
        obmc-host-ipmi \
        "

OBMC_COMPATIBLE_NAMES = "com.ampere.Hardware.Chassis.Model.MtJade"

OBMC_IMAGE_EXTRA_INSTALL:append = "\
                                   phosphor-ipmi-blobs \
                                   phosphor-ipmi-blobs-binarystore \
                                   mtjade-gpio-config \
                                   ac01-boot-progress \
                                  "

PREFERRED_PROVIDER_virtual/obmc-chassis-mgmt = "packagegroup-ampere-apps"
PREFERRED_PROVIDER_virtual/obmc-system-mgmt = "packagegroup-ampere-apps"
PREFERRED_PROVIDER_virtual/obmc-host-ipmi-hw = "phosphor-ipmi-ssif"
PREFERRED_PROVIDER_virtual/obmc-flash-mgmt = "packagegroup-ampere-apps"

VIRTUAL-RUNTIME_phosphor-ipmi-providers = ""
VIRTUAL-RUNTIME_obmc-sensors-hwmon = "dbus-sensors"
```

## meta-ampere/meta-jefferson/conf/layer.conf
```bitbake
# We have a conf and classes directory, add to BBPATH
BBPATH .= ":${LAYERDIR}"

# We have recipes-* directories, add to BBFILES
BBFILES += "${LAYERDIR}/recipes-*/*/*.bb \
            ${LAYERDIR}/recipes-*/*/*.bbappend"

BBFILE_COLLECTIONS += "jefferson-layer"
BBFILE_PATTERN_jefferson-layer := "^${LAYERDIR}/"
LAYERSERIES_COMPAT_jefferson-layer = "scarthgap styhead"
```

## meta-ampere/meta-mitchell/conf/layer.conf
```bitbake
# We have a conf and classes directory, add to BBPATH
BBPATH .= ":${LAYERDIR}"

# We have recipes-* directories, add to BBFILES
BBFILES += "${LAYERDIR}/recipes-*/*/*.bb \
            ${LAYERDIR}/recipes-*/*/*.bbappend"

BBFILE_COLLECTIONS += "mitchell-layer"
BBFILE_PATTERN_mitchell-layer := "^${LAYERDIR}/"
LAYERSERIES_COMPAT_mitchell-layer = "scarthgap styhead"
```

## meta-ampere/meta-mitchell/conf/machine/mtmitchell-dcscm.conf
```bitbake
KMACHINE = "aspeed"
KERNEL_DEVICETREE = "aspeed/${KMACHINE}-bmc-ampere-mtmitchell.dtb"
UBOOT_DEVICETREE = "ast2600-ampere"
UBOOT_MACHINE = "ast2600_openbmc_spl_defconfig"
SPL_BINARY = "spl/u-boot-spl.bin"
SOCSEC_SIGN_ENABLE = "0"

SERIAL_CONSOLES = "115200;ttyS4"

require conf/machine/include/ast2600.inc
require conf/machine/include/obmc-bsp-common.inc
require conf/distro/include/pldm.inc
require conf/distro/include/nfs.inc

FLASH_SIZE = "65536"

OBMC_COMPATIBLE_NAMES = "com.ampere.Hardware.Chassis.Model.MtMitchell"

MACHINE_FEATURES += "\
                          obmc-bmc-state-mgmt \
                          obmc-chassis-state-mgmt \
                          obmc-host-ipmi \
                          obmc-host-state-mgmt \
                          obmc-phosphor-chassis-mgmt \
                          obmc-phosphor-flash-mgmt \
                         "

OBMC_IMAGE_EXTRA_INSTALL:append = " \
                                   phosphor-ipmi-blobs \
                                   phosphor-ipmi-blobs-binarystore \
                                   util-linux \
                                   ampere-mctp-i2c-binding \
                                  "

PREFERRED_PROVIDER_virtual/obmc-chassis-mgmt = "packagegroup-ampere-apps"
PREFERRED_PROVIDER_virtual/obmc-system-mgmt = "packagegroup-ampere-apps"
PREFERRED_PROVIDER_virtual/obmc-flash-mgmt = "packagegroup-ampere-apps"
PREFERRED_PROVIDER_virtual/obmc-host-ipmi-hw = "phosphor-ipmi-ssif"

OVERRIDES .= ":ampere"
```

## meta-ampere/meta-mitchell/conf/machine/mtmitchell.conf
```bitbake
KMACHINE = "aspeed"
KERNEL_DEVICETREE = "${KMACHINE}-bmc-ampere-mtmitchell.dtb"
UBOOT_DEVICETREE = "ast2600-bletchley"
UBOOT_MACHINE = "ast2600_openbmc_spl_defconfig"
SPL_BINARY = "spl/u-boot-spl.bin"
SOCSEC_SIGN_ENABLE = "0"

SERIAL_CONSOLES = "115200;ttyS4"

require conf/machine/include/ast2600.inc
require conf/machine/include/obmc-bsp-common.inc

FLASH_SIZE = "65536"
VOLATILE_LOG_DIR = "no"

MACHINE_FEATURES += "\
                          obmc-bmc-state-mgmt \
                          obmc-chassis-state-mgmt \
                          obmc-host-ipmi \
                          obmc-host-state-mgmt \
                          obmc-phosphor-chassis-mgmt \
                          obmc-phosphor-flash-mgmt \
                         "

OBMC_IMAGE_EXTRA_INSTALL:append = " \
                                   ampere-utils \
                                   ampere-usbnet \
                                   phosphor-misc-usb-ctrl \
                                   ampere-platform-init \
                                   ampere-ipmi-oem \
                                   ampere-hostctrl \
                                   ampere-driver-binder \
                                   ampere-mac-update \
                                   phosphor-ipmi-blobs \
                                   phosphor-ipmi-blobs-binarystore \
                                   util-linux \
                                  "

PREFERRED_PROVIDER_virtual/obmc-chassis-mgmt = "packagegroup-obmc-ampere-apps"
PREFERRED_PROVIDER_virtual/obmc-system-mgmt = "packagegroup-obmc-ampere-apps"
PREFERRED_PROVIDER_virtual/obmc-flash-mgmt = "packagegroup-obmc-ampere-apps"
PREFERRED_PROVIDER_virtual/obmc-host-ipmi-hw = "phosphor-ipmi-ssif"
PREFERRED_PROVIDER_virtual/phosphor-led-manager-config-native = "ampere-led-manager-config-native"

OVERRIDES .= ":ampere"
```

## meta-arm/conf/layer.conf
```bitbake
# We have a conf and classes directory, add to BBPATH
BBPATH .= ":${LAYERDIR}"

# We have recipes-* directories, add to BBFILES
BBFILES += "${LAYERDIR}/recipes-*/*/*.bb \
            ${LAYERDIR}/recipes-*/*/*.bbappend"

BBFILE_COLLECTIONS += "arm"
BBFILE_PATTERN_arm = "^${LAYERDIR}/"
LAYERVERSION_arm = "1"

LAYERSERIES_COMPAT_arm = "dunfell gatesgarth"
```

## meta-arm/conf/machine/include/arm.inc
```bitbake
VIRTUAL-RUNTIME_skeleton_workbook = "${MACHINE}-config"

PREFERRED_PROVIDER_virtual/obmc-host-ipmi-hw = "phosphor-ipmi-bt"
PREFERRED_PROVIDER_virtual/obmc-chassis-mgmt = "packagegroup-arm-apps"
PREFERRED_PROVIDER_virtual/obmc-flash-mgmt = "packagegroup-arm-apps"
PREFERRED_PROVIDER_virtual/obmc-host-ctl ?= "obmc-op-control-host"
PREFERRED_PROVIDER_virtual/obmc-inventory-data ?= \
    "${VIRTUAL-RUNTIME_skeleton_workbook}"
PREFERRED_PROVIDER_virtual/phosphor-ipmi-fru-hostfw-config ?= \
    "hostboot-inventory-config-native"
PREFERRED_PROVIDER_virtual/openpower-fru-vpd-layout ?= \
    "openpower-fru-vpd-layout-native"
PREFERRED_PROVIDER_virtual/openpower-fru-inventory ?= \
    "openpower-fru-inventory-example-native"
PREFERRED_PROVIDER_virtual/openpower-fru-properties ?= \
    "openpower-fru-properties-example-native"
```

## meta-arm/meta-arm-bsp/conf/layer.conf
```bitbake
# We have a conf and classes directory, add to BBPATH
BBPATH .= ":${LAYERDIR}"

# We have recipes-* directories, add to BBFILES
BBFILES += "${LAYERDIR}/recipes-*/*/*.bb \
            ${LAYERDIR}/recipes-*/*/*.bbappend"

BBFILE_COLLECTIONS += "meta-arm-bsp"
BBFILE_PATTERN_meta-arm-bsp = "^${LAYERDIR}/"
BBFILE_PRIORITY_meta-arm-bsp = "5"

LAYERSERIES_COMPAT_meta-arm-bsp = "styhead walnascar"

LAYERDEPENDS_meta-arm-bsp = "core meta-arm"
# This won't be used by layerindex-fetch, but works everywhere else
LAYERDEPENDS_meta-arm-bsp:append:corstone1000 = " meta-python openembedded-layer efi-secure-boot"
LAYERDEPENDS_meta-arm-bsp:append:musca-b1 = " meta-python"
LAYERDEPENDS_meta-arm-bsp:append:musca-s1 = " meta-python"

# Additional license directories.
LICENSE_PATH += "${LAYERDIR}/custom-licenses"

BBFILES_DYNAMIC += " \
    meta-arm-systemready:${LAYERDIR}/dynamic-layers/meta-arm-systemready/*/*/*.bb \
    meta-arm-systemready:${LAYERDIR}/dynamic-layers/meta-arm-systemready/*/*/*.bbappend \
"

WARN_QA:append:layer-meta-arm-bsp = " patch-status"

addpylib ${LAYERDIR}/lib oeqa
```

## meta-arm/meta-arm-bsp/conf/machine/corstone1000-fvp.conf
```bitbake
#@TYPE: Machine
#@NAME: corstone1000-fvp machine
#@DESCRIPTION: Machine configuration for Corstone1000 64-bit FVP
require conf/machine/include/corstone1000.inc

TFA_TARGET_PLATFORM = "fvp"

TFM_PLATFORM_IS_FVP = "TRUE"

# testimage config
TEST_TARGET = "OEFVPTarget"
TEST_TARGET_IP = "127.0.0.1:2222"
DEFAULT_TEST_SUITES:append = " fvp_boot fvp_devices"

# FVP Config
FVP_PROVIDER ?= "fvp-corstone1000-native"
FVP_EXE ?= "FVP_Corstone-1000"
FVP_CONSOLES[default] = "host_terminal_0"
FVP_CONSOLES[tf-a] = "host_terminal_1"
FVP_CONSOLES[se] = "secenc_terminal"
FVP_CONSOLES[extsys] = "extsys_terminal"

#Disable Time Annotation
FASTSIM_DISABLE_TA = "0"

# FVP Parameters
FVP_CONFIG[se.trustedBootROMloader.fname] ?= "bl1.bin"
FVP_CONFIG[board.xnvm_size] ?= "64"
FVP_CONFIG[se.trustedSRAM_config] ?= "6"
FVP_CONFIG[se.BootROM_config] ?= "3"
FVP_CONFIG[board.hostbridge.interfaceName] ?= "tap0"
FVP_CONFIG[board.smsc_91c111.enabled] ?= "1"
FVP_CONFIG[board.hostbridge.userNetworking] ?= "true"
FVP_CONFIG[board.hostbridge.userNetPorts] ?= "5555=5555,8080=80,2222=22"
FVP_CONFIG[board.se_flash_size] ?= "8192"
FVP_CONFIG[diagnostics] ?= "4"
FVP_CONFIG[disable_visualisation] ?= "true"
FVP_CONFIG[se.nvm.update_raw_image] ?= "0"
FVP_CONFIG[se.cryptocell.USER_OTP_FILTERING_DISABLE] ?= "1"

# Boot image
FVP_DATA ?= "board.flash0=corstone1000-flash-firmware-image-${MACHINE}.wic@0x68000000"

# External system (cortex-M3)
FVP_CONFIG[extsys_harness0.extsys_flashloader.fname] ?= "es_flashfw.bin"

# FVP Terminals
FVP_TERMINALS[host.host_terminal_0] ?= "Normal World Console"
FVP_TERMINALS[host.host_terminal_1] ?= "Secure World Console"
FVP_TERMINALS[se.secenc_terminal] ?= "Secure Enclave Console"
FVP_TERMINALS[extsys0.extsys_terminal] ?= "Cortex M3"

# MMC card configuration
FVP_CONFIG[board.msd_mmc.card_type] ?= "SDHC"
FVP_CONFIG[board.msd_mmc.p_fast_access] ?= "0"
FVP_CONFIG[board.msd_mmc.diagnostics] ?= "0"
FVP_CONFIG[board.msd_mmc.p_max_block_count] ?= "0xFFFF"
FVP_CONFIG[board.msd_config.pl180_fifo_depth] ?= "16"
FVP_CONFIG[board.msd_mmc.support_unpadded_images] ?= "true"
FVP_CONFIG[board.msd_mmc.p_mmc_file] ?= "${IMAGE_NAME}.wic"

# MMC2 card configuration
FVP_CONFIG[board.msd_mmc_2.card_type] ?= "SDHC"
FVP_CONFIG[board.msd_mmc_2.p_fast_access] ?= "0"
FVP_CONFIG[board.msd_mmc_2.diagnostics] ?= "0"
FVP_CONFIG[board.msd_mmc_2.p_max_block_count] ?= "0xFFFF"
FVP_CONFIG[board.msd_config_2.pl180_fifo_depth] ?= "16"
FVP_CONFIG[board.msd_mmc_2.support_unpadded_images] ?= "true"
FVP_CONFIG[board.msd_mmc_2.p_mmc_file] ?= "corstone1000-esp-image-${MACHINE}.wic"

# Virtio-Net configuration
FVP_CONFIG[board.virtio_net.enabled] ?= "1"
FVP_CONFIG[board.virtio_net.hostbridge.interfaceName] ?= "eth1"
FVP_CONFIG[board.virtio_net.hostbridge.userNetworking] ?= "true"
FVP_CONFIG[board.virtio_net.hostbridge.userNetPorts] ?= "5555=5555,8080=80,2222=22"
FVP_CONFIG[board.virtio_net.transport] ?= "legacy"
```

## meta-arm/meta-arm-bsp/conf/machine/corstone1000-mps3.conf
```bitbake
#@TYPE: Machine
#@NAME: corstone1000-mps3 machine
#@DESCRIPTION: Machine configuration for Corstone1000 64-bit MPS3 FPGA board

require conf/machine/include/corstone1000.inc

TFA_TARGET_PLATFORM = "fpga"

PLATFORM_IS_FVP = "FALSE"
```
