## meta/conf/machine/include/tune-octeon.inc
```bitbake
DEFAULTTUNE ?="octeon2"

require conf/machine/include/tune-mips64.inc

AVAILTUNES += "octeon2 octeon2_64 octeon3 octeon3_64"

TUNEVALID[octeon2] = "Enable optimization related to octeon2 support"
TUNE_CCARGS .= "${@bb.utils.contains('TUNE_FEATURES', 'octeon2', ' -march=octeon2 ', '',d)}"

TUNE_FEATURES_tune-octeon2 = "${TUNE_FEATURES_tune-mips64-n32} octeon2"
BASE_LIB_tune-octeon2 = "lib32"
MIPSPKGSFX_VARIANT_tune-octeon2 = "octeon2"
PACKAGE_EXTRA_ARCHS_tune-octeon2 = "mips64-n32 octeon2-n32"

TUNE_FEATURES_tune-octeon2_64 = "${TUNE_FEATURES_tune-mips64} octeon2"
BASE_LIB_tune-octeon2_64 = "lib64"
MIPSPKGSFX_VARIANT_tune-octeon2_64 = "octeon2_64"
PACKAGE_EXTRA_ARCHS_tune-octeon2_64 = "mips64 octeon2_64"


TUNEVALID[octeon3] = "Enable optimization related to octeon3 support"
TUNE_CCARGS .= "${@bb.utils.contains('TUNE_FEATURES', 'octeon3', ' -march=octeon3 ', '',d)}"

TUNE_FEATURES_tune-octeon3 = "${TUNE_FEATURES_tune-mips64-n32} octeon3"
BASE_LIB_tune-octeon3 = "lib32"
MIPSPKGSFX_VARIANT_tune-octeon3 = "octeon3"
PACKAGE_EXTRA_ARCHS_tune-octeon3 = "mips64-n32 octeon3-n32"

TUNE_FEATURES_tune-octeon3_64 = "${TUNE_FEATURES_tune-mips64} octeon3"
BASE_LIB_tune-octeon3_64 = "lib64"
MIPSPKGSFX_VARIANT_tune-octeon3_64 = "octeon3_64"
PACKAGE_EXTRA_ARCHS_tune-octeon3_64 = "mips64 octeon3_64"
```

## meta/conf/machine/include/tune-xscale.inc
```bitbake
DEFAULTTUNE ?= "armv5te"

require conf/machine/include/arm/arch-armv5-dsp.inc

TUNEVALID[xscale] = "Enable PXA255/PXA26x Xscale specific processor optimizations"
TUNE_CCARGS .= "${@bb.utils.contains("TUNE_FEATURES", "xscale", " -mtune=xscale", "", d)}"

AVAILTUNES += "xscale"
ARMPKGARCH_tune-xscale = "xscale"
TUNE_FEATURES_tune-xscale = "${TUNE_FEATURES_tune-armv5te} xscale"
PACKAGE_EXTRA_ARCHS_tune-xscale = "${PACKAGE_EXTRA_ARCHS_tune-armv5te} xscale xscalet xscalee xscalete"

AVAILTUNES += "xscale-be"
ARMPKGARCH_tune-xscale-be = "xscale"
TUNE_FEATURES_tune-xscale-be = "${TUNE_FEATURES_tune-armv5teb} xscale bigendian"
PACKAGE_EXTRA_ARCHS_tune-xscale-be = "${PACKAGE_EXTRA_ARCHS_tune-armv5teb} xscaleb xscaletb xscaleeb xscaleteb"
```

## meta/conf/machine/qemuarm.conf
```bitbake
#@TYPE: Machine
#@NAME: arm_versatile_926ejs
#@DESCRIPTION: arm_versatile_926ejs

require conf/machine/include/qemu.inc
require conf/machine/include/tune-arm926ejs.inc
#require conf/machine/include/tune-arm1136jf-s.inc

KERNEL_IMAGETYPE = "zImage"

SERIAL_CONSOLES = "115200;ttyAMA0 115200;ttyAMA1"
```

## poky/bitbake/lib/layerindexlib/tests/testdata/layer4/conf/layer.conf
```bitbake
# We have a conf and classes directory, append to BBPATH
BBPATH .= ":${LAYERDIR}"

# We have a recipes directory, add to BBFILES
BBFILES += "${LAYERDIR}/recipes-*/*/*.bb ${LAYERDIR}/recipes-*/*/*.bbappend"

BBFILE_COLLECTIONS += "openembedded-layer"
BBFILE_PATTERN_openembedded-layer := "^${LAYERDIR}/"

# Define the priority for recipes (.bb files) from this layer,
# choosing carefully how this layer interacts with all of the
# other layers.

BBFILE_PRIORITY_openembedded-layer = "6"

# This should only be incremented on significant changes that will
# cause compatibility issues with other layers
LAYERVERSION_openembedded-layer = "1"

LAYERDEPENDS_openembedded-layer = "core"

LAYERSERIES_COMPAT_openembedded-layer = "sumo"
```

## poky/meta-poky/conf/distro/include/gcsections.inc
```bitbake
CFLAGS_SECTION_REMOVAL = "-ffunction-sections -fdata-sections"
LDFLAGS_SECTION_REMOVAL = "-Wl,--gc-sections"

# packages with build problems using sections
CFLAGS_SECTION_REMOVAL:pn-glibc = ""
LDFLAGS_SECTION_REMOVAL:pn-glibc = ""
CFLAGS_SECTION_REMOVAL:pn-cairo = ""
LDFLAGS_SECTION_REMOVAL:pn-cairo = ""
CFLAGS_SECTION_REMOVAL:pn-perl = ""
LDFLAGS_SECTION_REMOVAL:pn-perl = ""
CFLAGS_SECTION_REMOVAL:pn-grub-efi = ""
LDFLAGS_SECTION_REMOVAL:pn-grub-efi = ""
CFLAGS_SECTION_REMOVAL:pn-grub = ""
LDFLAGS_SECTION_REMOVAL:pn-grub = ""

# SDK packages with build problems using sections
CFLAGS_SECTION_REMOVAL:pn-nativesdk-glibc = ""
LDFLAGS_SECTION_REMOVAL:pn-nativesdk-glibc = ""
CFLAGS_SECTION_REMOVAL:pn-nativesdk-cairo = ""
LDFLAGS_SECTION_REMOVAL:pn-nativesdk-cairo = ""
CFLAGS_SECTION_REMOVAL:pn-nativesdk-mingw-w64-runtime = ""
LDFLAGS_SECTION_REMOVAL:pn-nativesdk-mingw-w64-runtime = ""
CFLAGS_SECTION_REMOVAL:pn-nativesdk-perl = ""
LDFLAGS_SECTION_REMOVAL:pn-nativesdk-perl = ""
CFLAGS_SECTION_REMOVAL:pn-nativesdk-mingw-w64-winpthreads = ""
LDFLAGS_SECTION_REMOVAL:pn-nativesdk-mingw-w64-winpthreads = ""

# set default for target
CFLAGS:append:class-target = " ${CFLAGS_SECTION_REMOVAL}"
CXXFLAGS:append:class-target = " ${CFLAGS_SECTION_REMOVAL}"
LDFLAGS:append:class-target = " ${LDFLAGS_SECTION_REMOVAL}"

# set default for nativesdk
CFLAGS:append:class-nativesdk = " ${CFLAGS_SECTION_REMOVAL}"
CXXFLAGS:append:class-nativesdk = " ${CFLAGS_SECTION_REMOVAL}"
LDFLAGS:append:class-nativesdk = " ${LDFLAGS_SECTION_REMOVAL}"
```
