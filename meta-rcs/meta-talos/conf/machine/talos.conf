## meta-rcs/meta-talos/conf/machine/talos.conf
```bitbake
KMACHINE = "aspeed"
KERNEL_DEVICETREE = "${KMACHINE}-bmc-opp-${MACHINE}.dtb"

UBOOT_MACHINE = "ast_g5_ncsi_config"

OBMC_MACHINE_FEATURES += "obmc-mrw"

OBMC_POWER_SUPPLY_INSTANCES = "0 1"

require conf/machine/include/ast2500.inc
require conf/machine/include/obmc-bsp-common.inc
require conf/machine/include/rcs.inc
require conf/machine/include/p9.inc

PHOSPHOR_MRW_URI = "git://scm.raptorcs.com/scm/git/talos-xml;protocol=https"
PHOSPHOR_MRW_REV = "572148010e4bf8dbf9c3578bd5c1ca17d13cee73"

# Inhibit phosphor-hwmon-config-mrw
VIRTUAL-RUNTIME_phosphor-hwmon-config = ""

# Inhibit phosphor-fan-presence-mrw-native
PREFERRED_PROVIDER_virtual/phosphor-fan-presence-config = \
    "phosphor-fan-presence-config-native"

# Inhibit phosphor-fan-control-fan-config-mrw-native
PREFERRED_PROVIDER_virtual/phosphor-fan-control-fan-config = \
    "phosphor-fan-control-fan-config-native"

DISTRO_FEATURES_append = "\
        obmc-openpower \
        obmc-openpower-extra \
        obmc-openpower-legacy \
        "
MACHINE_EXTRA_RDEPENDS += "obmc-ipl-status-led-monitor obmc-hardbeep"

# For kernel debug
# MACHINE_EXTRA_RDEPENDS += " kernel-modules"

PREFERRED_PROVIDER_virtual/phosphor-ipmi-fru-inventory = "talos-ipmi-inventory-map-native"
PREFERRED_PROVIDER_virtual/phosphor-led-manager-config-native = "talos-led-manager-config-native"
```

## meta-sample-bsp/conf/layer.conf
```bitbake
# We have a conf and classes directory, add to BBPATH
BBPATH .= ":${LAYERDIR}"

# We have a recipes-* directories, add to BBFILES
BBFILES += "${LAYERDIR}/recipes-*/*/*.bb \
        ${LAYERDIR}/recipes-*/*/*.bbappend"

BBFILE_COLLECTIONS += "qemuphosphor"
BBFILE_PATTERN_qemuphosphor = "^${LAYERDIR}/"
LAYERVERSION_qemuphosphor = "1"
```

## meta-sample-bsp/conf/machine/qemuphosphor.conf
```bitbake
#@TYPE: Machine
#@NAME: qemuphosphor
#@DESCRIPTION: Machine configuration for qemuphosphor systems

require conf/machine/include/qemu.inc
require conf/machine/include/tune-arm926ejs.inc
require conf/machine/include/qemuphosphor.inc

KERNEL_IMAGETYPE = "zImage"
SERIAL_CONSOLE = "115200 ttyAMA0"

MACHINE_FEATURES += "\
        obmc-phosphor-fan-mgmt \
        obmc-phosphor-chassis-mgmt \
        obmc-phosphor-sensor-mgmt \
        obmc-phosphor-flash-mgmt \
        "

VIRTUAL-RUNTIME_obmc-phosphor-fan-ctl = " \
       obmc-phosphor-qemu \
       "
VIRTUAL-RUNTIME_obmc-phosphor-sensor-ctl = " \
       obmc-phosphor-qemu \
       "
VIRTUAL-RUNTIME_obmc-phosphor-chassis-ctl = " \
       obmc-phosphor-qemu \
       "
VIRTUAL-RUNTIME_obmc-phosphor-flash-ctl = " \
       obmc-phosphor-qemu \
       "
```

## meta-security/conf/distro/include/maintainers.inc
```bitbake
# meta-security Maintainers File
#
# This file contains a list of recipe maintainers.
#
# Please submit any patches against recipes in meta to the 
# Yocto mail list (yocto@yoctoproject.org)
#
# If you have problems with or questions about a particular recipe, feel
# free to contact the maintainer directly (cc:ing the appropriate mailing list
# puts it in the archive and helps other people who might have the same
# questions in the future), but please try to do the following first:
#
#  - look in the Yocto Project Bugzilla
#    (http://bugzilla.yoctoproject.org/) to see if a problem has
#    already been reported
#
# The format is as a bitbake variable override for each recipe
#
#	RECIPE_MAINTAINER:pn-<recipe name> = "Full Name <address@domain>"
#
# Please keep this list in alphabetical order.
RECIPE_MAINTAINER:pn-aircrack-ng = "Armin Kuster <akuster808@gmail.com>"
RECIPE_MAINTAINER:pn-apparmor = "Armin Kuster <akuster808@gmail.com>"
RECIPE_MAINTAINER:pn-bastille = "Armin Kuster <akuster808@gmail.com>"
RECIPE_MAINTAINER:pn-buck-security = "Armin Kuster <akuster808@gmail.com>"
RECIPE_MAINTAINER:pn-ccs-tools = "Armin Kuster <akuster808@gmail.com>"
RECIPE_MAINTAINER:pn-checksec = "Armin Kuster <akuster808@gmail.com>"
RECIPE_MAINTAINER:pn-checksecurity = "Armin Kuster <akuster808@gmail.com>"
RECIPE_MAINTAINER:pn-clamav = "Armin Kuster <akuster808@gmail.com>"
RECIPE_MAINTAINER:pn-ding-libs = "Armin Kuster <akuster808@gmail.com>"
RECIPE_MAINTAINER:pn-ecryptfs-utils = "Armin Kuster <akuster808@gmail.com>"
RECIPE_MAINTAINER:pn-fscryptctl = "Armin Kuster <akuster808@gmail.com>"
RECIPE_MAINTAINER:pn-google-authenticator-libpam = "Armin Kuster <akuster808@gmail.com>"
RECIPE_MAINTAINER:pn-hash-perl = "Armin Kuster <akuster808@gmail.com>"
RECIPE_MAINTAINER:pn-isic = "Armin Kuster <akuster808@gmail.com>"
RECIPE_MAINTAINER:pn-keyutils = "Armin Kuster <akuster808@gmail.com>"
RECIPE_MAINTAINER:pn-libaes-siv = "Armin Kuster <akuster808@gmail.com>"
RECIPE_MAINTAINER:pn-libgssglue = "Armin Kuster <akuster808@gmail.com>"
RECIPE_MAINTAINER:pn-libhtp = "Armin Kuster <akuster808@gmail.com>"
RECIPE_MAINTAINER:pn-libmhash = "Armin Kuster <akuster808@gmail.com>"
RECIPE_MAINTAINER:pn-libmspack = "Armin Kuster <akuster808@gmail.com>"
RECIPE_MAINTAINER:pn-lib-perl = "Armin Kuster <akuster808@gmail.com>"
RECIPE_MAINTAINER:pn-libseccomp = "Armin Kuster <akuster808@gmail.com>"
RECIPE_MAINTAINER:pn-libwhisker2-perl = "Armin Kuster <akuster808@gmail.com>"
RECIPE_MAINTAINER:pn-ncrack = "Armin Kuster <akuster808@gmail.com>"
RECIPE_MAINTAINER:pn-nikto = "Armin Kuster <akuster808@gmail.com>"
RECIPE_MAINTAINER:pn-paxctl = "Armin Kuster <akuster808@gmail.com>"
RECIPE_MAINTAINER:pn-python3-fail2ban = "Armin Kuster <akuster808@gmail.com>"
RECIPE_MAINTAINER:pn-python3-scapy = "Armin Kuster <akuster808@gmail.com>"
RECIPE_MAINTAINER:pn-python-fail2ban = "Armin Kuster <akuster808@gmail.com>"
RECIPE_MAINTAINER:pn-python-scapy = "Armin Kuster <akuster808@gmail.com>"
RECIPE_MAINTAINER:pn-redhat-security = "Armin Kuster <akuster808@gmail.com>"
RECIPE_MAINTAINER:pn-samhain = "Armin Kuster <akuster808@gmail.com>"
RECIPE_MAINTAINER:pn-smack = "Armin Kuster <akuster808@gmail.com>"
RECIPE_MAINTAINER:pn-sssd = "Armin Kuster <akuster808@gmail.com>"
RECIPE_MAINTAINER:pn-suricata = "Armin Kuster <akuster808@gmail.com>"
RECIPE_MAINTAINER:pn-tripwire = "Armin Kuster <akuster808@gmail.com>"
```

## meta-security/conf/layer.conf
```bitbake
# We have a conf and classes directory, add to BBPATH
BBPATH .= ":${LAYERDIR}"

# We have recipes-* directories, add to BBFILES
BBFILES += "${LAYERDIR}/recipes-*/*/*.bb \
	${LAYERDIR}/recipes-*/*/*.bbappend"

BBFILE_COLLECTIONS += "security"
BBFILE_PATTERN_security = "^${LAYERDIR}/"
BBFILE_PRIORITY_security = "8"

LAYERSERIES_COMPAT_security = "styhead walnascar"

LAYERDEPENDS_security = "core openembedded-layer"

BBFILES_DYNAMIC += " \
  perl-layer:${LAYERDIR}/dynamic-layers/meta-perl/recipes-*/*/*.bb \
  perl-layer:${LAYERDIR}/dynamic-layers/meta-perl/recipes-*/*/*.bbappend \
  meta-python:${LAYERDIR}/dynamic-layers/meta-python/recipes-*/*/*.bb \
  meta-python:${LAYERDIR}/dynamic-layers/meta-python/recipes-*/*/*.bbappend \
  networking-layer:${LAYERDIR}/dynamic-layers/networking-layer/recipes-*/*/*.bb \
  networking-layer:${LAYERDIR}/dynamic-layers/networking-layer/recipes-*/*/*.bbappend \
"

# Sanity check for meta-security layer.
# Setting SKIP_META_SECURITY_SANITY_CHECK to "1" would skip the bbappend files check.
INHERIT += "sanity-meta-security"

addpylib ${LAYERDIR}/lib oeqa

WARN_QA:append:security = " patch-status missing-metadata"
```

## meta-security/meta-hardening/conf/distro/harden.conf
```bitbake
DISTRO = "harden"
DISTRO_NAME = "Simple Security hardening example"
DISTRO_VERSION = "1.0"

DISTRO_FEATURES = " acl xattr pci ext2 pam ipv4 ipv6 ipsec largefile usbhost"

VIRTUAL-RUNTIME_base-utils-syslog ?= "rsyslog"
IMAGE_ROOTFS_EXTRA_SPACE = "524288"
EXTRA_IMAGE_FEATURES:remove = "allow-empty-password empty-root-password allow-root-login"

DISABLE_ROOT ?= "True"
```

## meta-security/meta-hardening/conf/layer.conf
```bitbake
# We have a conf and classes directory, add to BBPATH
BBPATH .= ":${LAYERDIR}"

# We have a recipes directory, add to BBFILES
BBFILES += "${LAYERDIR}/recipes*/*/*.bb ${LAYERDIR}/recipes*/*/*.bbappend"

BBFILE_COLLECTIONS += "harden-layer"
BBFILE_PATTERN_harden-layer = "^${LAYERDIR}/"
BBFILE_PRIORITY_harden-layer = "6"

LAYERSERIES_COMPAT_harden-layer = "styhead"

LAYERDEPENDS_harden-layer = "core openembedded-layer"

WARN_QA:append:harden-layer = " patch-status missing-metadata"
```

## meta-security/meta-integrity/conf/layer.conf
```bitbake
# We have a conf and classes directory, add to BBPATH
BBPATH =. "${LAYERDIR}:"

# We have a packages directory, add to BBFILES
BBFILES += "${LAYERDIR}/recipes-*/*/*.bb \
            ${LAYERDIR}/recipes-*/*/*.bbappend"

BBFILE_COLLECTIONS += "integrity"
BBFILE_PATTERN_integrity := "^${LAYERDIR}/"
BBFILE_PRIORITY_integrity = "6"

# Set a variable to get to the top of the metadata location. Needed
# for finding scripts (when following the README.md instructions) and
# default debug keys (in ima-evm-rootfs.bbclass).
INTEGRITY_BASE := '${LAYERDIR}'

# We must not export this path to all shell scripts (as in "export
# INTEGRITY_BASE"), because that causes problems with sstate (becames
# dependent on location of the layer). Exporting it to just the
# interactive shell is enough.
OE_TERMINAL_EXPORTS += "INTEGRITY_BASE"

LAYERSERIES_COMPAT_integrity = "styhead walnascar"
# ima-evm-utils depends on keyutils from meta-oe
LAYERDEPENDS_integrity = "core openembedded-layer"

BBLAYERS_LAYERINDEX_NAME_integrity = "meta-integrity"

# Sanity check for meta-integrity layer.
# Setting SKIP_META_INTEGRITY_SANITY_CHECK to "1" would skip the bbappend files check.
INHERIT += "sanity-meta-integrity"

BBFILES_DYNAMIC += " \
networking-layer:${LAYERDIR}/dynamic-layers/meta-networking/recipes-*/*/*.bbappend \
"

addpylib ${LAYERDIR}/lib oeqa

WARN_QA:append:integrity = " patch-status missing-metadata"
```

## meta-security/meta-parsec/conf/layer.conf
```bitbake
# We have a conf and classes directory, add to BBPATH
BBPATH .= ":${LAYERDIR}"

# We have a recipes directory, add to BBFILES
BBFILES += "${LAYERDIR}/recipes*/*/*.bb ${LAYERDIR}/recipes*/*/*.bbappend"

BBFILE_COLLECTIONS += "parsec-layer"
BBFILE_PATTERN_parsec-layer = "^${LAYERDIR}/"
BBFILE_PRIORITY_parsec-layer = "5"

LAYERSERIES_COMPAT_parsec-layer = "walnascar styhead nanbield scarthgap"

LAYERDEPENDS_parsec-layer = "core clang-layer"
BBLAYERS_LAYERINDEX_NAME_parsec-layer = "meta-parsec"

addpylib ${LAYERDIR}/lib oeqa

WARN_QA:append:parsec-layer = " patch-status missing-metadata"
```

## meta-security/meta-security-compliance/conf/layer.conf
```bitbake
# We have a conf and classes directory, add to BBPATH
BBPATH .= ":${LAYERDIR}"

# We have a recipes directory, add to BBFILES
BBFILES += "${LAYERDIR}/recipes*/*/*.bb ${LAYERDIR}/recipes*/*/*.bbappend"

BBFILE_COLLECTIONS += "scanners-layer"
BBFILE_PATTERN_scanners-layer = "^${LAYERDIR}/"
BBFILE_PRIORITY_scanners-layer = "10"

LAYERSERIES_COMPAT_scanners-layer = "gatesgarth"

LAYERDEPENDS_scanners-layer = "core openembedded-layer meta-python"

BBLAYERS_LAYERINDEX_NAME_scanners-layer = "meta-security-compliance"
```

## meta-security/meta-security-isafw/conf/layer.conf
```bitbake
# We have a conf and classes directory, add to BBPATH
BBPATH .= ":${LAYERDIR}"

# We have recipes-* directories, add to BBFILES
BBFILES += "${LAYERDIR}/recipes-*/*/*.bb ${LAYERDIR}/recipes-*/*/*.bbappend"

BBFILE_COLLECTIONS += "security-isafw"
BBFILE_PATTERN_security-isafw = "^${LAYERDIR}/"
BBFILE_PRIORITY_security-isafw = "6"

# This should only be incremented on significant changes that will
# cause compatibility issues with other layers
LAYERVERSION_security-isafw = "1"

LAYERDEPENDS_security-isafw = "core"

LAYERSERIES_COMPAT_security-isafw = "dunfell"
```

## meta-security/meta-tpm/conf/distro/include/maintainers-meta-tpm.inc
```bitbake
# meta-tpm Maintainers File
#
# This file contains a list of recipe maintainers.
#
# Please submit any patches against recipes in meta to the 
# Yocto mail list (yocto@yoctoproject.org)
#
# If you have problems with or questions about a particular recipe, feel
# free to contact the maintainer directly (cc:ing the appropriate mailing list
# puts it in the archive and helps other people who might have the same
# questions in the future), but please try to do the following first:
#
#  - look in the Yocto Project Bugzilla
#    (http://bugzilla.yoctoproject.org/) to see if a problem has
#    already been reported
#
# The format is as a bitbake variable override for each recipe
#
#	RECIPE_MAINTAINER:pn-<recipe name> = "Full Name <address@domain>"
#
# Please keep this list in alphabetical order.
RECIPE_MAINTAINER:pn-aircrack-ng = "Armin Kuster <akuster808@gmail.com>"
RECIPE_MAINTAINER:pn-pcr-extend = "Armin Kuster <akuster808@gmail.com>"
RECIPE_MAINTAINER:pn-tpm-quote-tools = "Armin Kuster <akuster808@gmail.com>"
RECIPE_MAINTAINER:pn-libtpms = "Armin Kuster <akuster808@gmail.com>"
RECIPE_MAINTAINER:pn-trousers = "Armin Kuster <akuster808@gmail.com>"
RECIPE_MAINTAINER:pn-swtpm = "Armin Kuster <akuster808@gmail.com>"
RECIPE_MAINTAINER:pn-openssl-tpm-engine = "Armin Kuster <akuster808@gmail.com>"
RECIPE_MAINTAINER:pn-tpm-tools = "Armin Kuster <akuster808@gmail.com>"
RECIPE_MAINTAINER:pn-tpm2-abrmd = "Armin Kuster <akuster808@gmail.com>"
RECIPE_MAINTAINER:pn-tpm2-totp = "Armin Kuster <akuster808@gmail.com>"
RECIPE_MAINTAINER:pn-tpm2-tcti-uefi = "Armin Kuster <akuster808@gmail.com>"
RECIPE_MAINTAINER:pn-tpm2-tss-engine = "Armin Kuster <akuster808@gmail.com>"
RECIPE_MAINTAINER:pn-tpm2-pkcs11 = "Armin Kuster <akuster808@gmail.com>"
RECIPE_MAINTAINER:pn-tpm2-tss = "Armin Kuster <akuster808@gmail.com>"
RECIPE_MAINTAINER:pn-tpm2-tools = "Armin Kuster <akuster808@gmail.com>"
RECIPE_MAINTAINER:pn-ibmswtpm2 = "Armin Kuster <akuster808@gmail.com>"
```

## meta-security/meta-tpm/conf/distro/include/maintainers.inc
```bitbake
# meta-tpm Maintainers File
#
# This file contains a list of recipe maintainers.
#
# Please submit any patches against recipes in meta to the 
# Yocto mail list (yocto@yoctoproject.org)
#
# If you have problems with or questions about a particular recipe, feel
# free to contact the maintainer directly (cc:ing the appropriate mailing list
# puts it in the archive and helps other people who might have the same
# questions in the future), but please try to do the following first:
#
#  - look in the Yocto Project Bugzilla
#    (http://bugzilla.yoctoproject.org/) to see if a problem has
#    already been reported
#
# The format is as a bitbake variable override for each recipe
#
#	RECIPE_MAINTAINER_pn-<recipe name> = "Full Name <address@domain>"
#
# Please keep this list in alphabetical order.
RECIPE_MAINTAINER_pn-aircrack-ng = "Armin Kuster <akuster808@gmail.com>"
RECIPE_MAINTAINER_pn-pcr-extend = "Armin Kuster <akuster808@gmail.com>"
RECIPE_MAINTAINER_pn-tpm-quote-tools = "Armin Kuster <akuster808@gmail.com>"
RECIPE_MAINTAINER_pn-libtpm = "Armin Kuster <akuster808@gmail.com>"
RECIPE_MAINTAINER_pn-trousers = "Armin Kuster <akuster808@gmail.com>"
RECIPE_MAINTAINER_pn-swtpm = "Armin Kuster <akuster808@gmail.com>"
RECIPE_MAINTAINER_pn-openssl-tpm-engine = "Armin Kuster <akuster808@gmail.com>"
RECIPE_MAINTAINER_pn-tpm-tools = "Armin Kuster <akuster808@gmail.com>"
RECIPE_MAINTAINER_pn-tpm2-abrmd = "Armin Kuster <akuster808@gmail.com>"
RECIPE_MAINTAINER_pn-tpm2-totp = "Armin Kuster <akuster808@gmail.com>"
RECIPE_MAINTAINER_pn-tpm2-tcti-uefi = "Armin Kuster <akuster808@gmail.com>"
RECIPE_MAINTAINER_pn-tpm2-tss-engine = "Armin Kuster <akuster808@gmail.com>"
RECIPE_MAINTAINER_pn-tpm2-pkcs11 = "Armin Kuster <akuster808@gmail.com>"
RECIPE_MAINTAINER_pn-tpm2-tss = "Armin Kuster <akuster808@gmail.com>"
RECIPE_MAINTAINER_pn-tpm2-tools = "Armin Kuster <akuster808@gmail.com>"
RECIPE_MAINTAINER_pn-ibmswtpm2 = "Armin Kuster <akuster808@gmail.com>"
```
