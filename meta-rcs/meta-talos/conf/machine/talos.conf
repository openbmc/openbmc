## meta-security/meta-tpm/conf/layer.conf
```bitbake
# We have a conf and classes directory, add to BBPATH
BBPATH .= ":${LAYERDIR}"

# We have a recipes directory, add to BBFILES
BBFILES += "${LAYERDIR}/recipes*/*/*.bb ${LAYERDIR}/recipes*/*/*.bbappend"

BBFILE_COLLECTIONS += "tpm-layer"
BBFILE_PATTERN_tpm-layer = "^${LAYERDIR}/"
BBFILE_PRIORITY_tpm-layer = "6"

LAYERSERIES_COMPAT_tpm-layer = "styhead walnascar"

LAYERDEPENDS_tpm-layer = " \
    core \
    openembedded-layer \
    meta-python \
"
BBLAYERS_LAYERINDEX_NAME_tpm-layer = "meta-tpm"

# Sanity check for meta-integrity layer.
# Setting SKIP_META_TPM_SANITY_CHECK to "1" would skip the bbappend files check.
INHERIT += "sanity-meta-tpm"

BBFILES_DYNAMIC += " \
networking-layer:${LAYERDIR}/dynamic-layers/meta-networking/recipes-*/*/*.bbappend \
"

addpylib ${LAYERDIR}/lib oeqa

WARN_QA:append:tmp-layer = " patch-status missing-metadata"
```

## meta-supermicro/conf/layer.conf
```bitbake
# We have a conf and classes directory, add to BBPATH
BBPATH .= ":${LAYERDIR}"

# We have recipes-* directories, add to BBFILES
BBFILES += "${LAYERDIR}/meta-common/recipes-*/*/*.bb \
            ${LAYERDIR}/meta-common/recipes-*/*/*.bbappend"

BBFILE_COLLECTIONS += "supermicro"
BBFILE_PATTERN_supermicro = "^${LAYERDIR}/"
LAYERVERSION_supermicro = "1"
LAYERSERIES_COMPAT_supermicro = "scarthgap styhead"
LAYERDEPENDS_supermicro = "phosphor-layer"
```

## meta-supermicro/conf/machine/include/supermicro.inc
```bitbake
MACHINE_FEATURES += "\
        obmc-bmc-state-mgmt \
        obmc-chassis-state-mgmt \
        obmc-host-state-mgmt \
        obmc-host-ipmi \
        obmc-phosphor-chassis-mgmt \
        obmc-phosphor-fan-mgmt \
        obmc-phosphor-flash-mgmt \
        "

VIRTUAL-RUNTIME_skeleton_workbook = "${MACHINE}-config"

PREFERRED_PROVIDER_virtual/obmc-chassis-mgmt = "packagegroup-supermicro-apps"
PREFERRED_PROVIDER_virtual/obmc-fan-mgmt = "packagegroup-supermicro-apps"
PREFERRED_PROVIDER_virtual/obmc-flash-mgmt = "packagegroup-supermicro-apps"
PREFERRED_PROVIDER_virtual/obmc-system-mgmt = "packagegroup-supermicro-apps"
PREFERRED_PROVIDER_virtual/obmc-inventory-data ?= "${VIRTUAL-RUNTIME_skeleton_workbook}"
PREFERRED_PROVIDER_virtual/obmc-host-ipmi-hw ?= "phosphor-ipmi-kcs"

OVERRIDES .= ":supermicro"
```

## meta-supermicro/meta-x11spi/conf/bblayers.conf.sample
```bitbake
# LAYER_CONF_VERSION is increased each time build/conf/bblayers.conf
# changes incompatibly
LCONF_VERSION = "8"

BBPATH = "${TOPDIR}"
BBFILES ?= ""

BBLAYERS ?= " \
  ##OEROOT##/meta \
  ##OEROOT##/meta-poky \
  ##OEROOT##/meta-openembedded/meta-oe \
  ##OEROOT##/meta-openembedded/meta-networking \
  ##OEROOT##/meta-openembedded/meta-perl \
  ##OEROOT##/meta-openembedded/meta-python \
  ##OEROOT##/meta-openembedded/meta-webserver \
  ##OEROOT##/meta-phosphor \
  ##OEROOT##/meta-aspeed \
  ##OEROOT##/meta-supermicro \
  ##OEROOT##/meta-supermicro/meta-x11spi \
"
```

## meta-supermicro/meta-x11spi/conf/layer.conf
```bitbake
# We have a conf and classes directory, add to BBPATH
BBPATH .= ":${LAYERDIR}"

# We have recipes-* directories, add to BBFILES
BBFILES += "${LAYERDIR}/recipes-*/*/*.bb \
            ${LAYERDIR}/recipes-*/*/*.bbappend"

BBFILE_COLLECTIONS += "x11spi"
BBFILE_PATTERN_x11spi = ""

BBFILE_PRIORITY_x11spi = "5"
LAYERSERIES_COMPAT_x11spi = "scarthgap styhead"
```

## meta-supermicro/meta-x11spi/conf/machine/x11spi.conf
```bitbake
KMACHINE = "aspeed"
KERNEL_DEVICETREE = "aspeed/aspeed-bmc-supermicro-x11spi.dtb"

require conf/machine/include/ast2500.inc
require conf/machine/include/obmc-bsp-common.inc
require conf/machine/include/supermicro.inc

PREFERRED_PROVIDER_virtual/bootloader = "u-boot-aspeed"
PREFERRED_PROVIDER_u-boot = "u-boot-aspeed"
PREFERRED_PROVIDER_u-boot-fw-utils = "u-boot-fw-utils-aspeed"
UBOOT_MACHINE = "ast_g5_phy_config"

FLASH_SIZE = "32768"

VIRTUAL-RUNTIME_skeleton_workbook = "${MACHINE}-config"
```

## meta-tyan/conf/layer.conf
```bitbake
# We have a conf and classes directory, add to BBPATH
BBPATH .= ":${LAYERDIR}"

# We have recipes-* directories, add to BBFILES
BBFILES += "${LAYERDIR}/meta-common/recipes-*/*/*.bb \
            ${LAYERDIR}/meta-common/recipes-*/*/*.bbappend"

BBFILE_COLLECTIONS += "tyan-layer"
BBFILE_PATTERN_tyan-layer = "^${LAYERDIR}/"
LAYERSERIES_COMPAT_tyan-layer = "scarthgap styhead"
```

## meta-tyan/meta-s7106/conf/layer.conf
```bitbake
# We have a conf and classes directory, add to BBPATH
BBPATH .= ":${LAYERDIR}"

# We have recipes-* directories, add to BBFILES
BBFILES += "${LAYERDIR}/recipes-*/*/*.bb \
            ${LAYERDIR}/recipes-*/*/*.bbappend"

BBFILE_COLLECTIONS += "s7106-layer"
BBFILE_PATTERN_s7106-layer = "^${LAYERDIR}/"
BBFILE_PRIORITY_s7106-layer = "5"
LAYERSERIES_COMPAT_s7106-layer = "scarthgap styhead"
```

## meta-tyan/meta-s7106/conf/machine/s7106.conf
```bitbake
KMACHINE = "aspeed"
KERNEL_DEVICETREE = "${KMACHINE}-bmc-tyan-${MACHINE}.dtb"

PREFERRED_PROVIDER_virtual/bootloader = "u-boot-aspeed"
PREFERRED_PROVIDER_u-boot = "u-boot-aspeed"
PREFERRED_PROVIDER_u-boot-fw-utils = "u-boot-fw-utils-aspeed"
UBOOT_MACHINE = "ast_g5_phy_config"

require conf/machine/include/ast2500.inc
require conf/machine/include/obmc-bsp-common.inc
require conf/machine/include/tyan.inc

FLASH_SIZE = "32768"

# We don't have configuration for these components yet, so remove them.
PREFERRED_PROVIDER_virtual/obmc-fan-mgmt = "tyan-dummy"
IMAGE_FEATURES:remove = "obmc-fan-control"
IMAGE_FEATURES:remove = "obmc-fan-mgmt"
IMAGE_FEATURES:remove = "obmc-flash-mgmt"
```

## meta-tyan/meta-s8036/conf/layer.conf
```bitbake
# We have a conf and classes directory, add to BBPATH
BBPATH .= ":${LAYERDIR}"

# We have recipes-* directories, add to BBFILES
BBFILES += "${LAYERDIR}/recipes-*/*/*.bb \
            ${LAYERDIR}/recipes-*/*/*.bbappend"

BBFILE_COLLECTIONS += "s8036-layer"
BBFILE_PATTERN_s8036-layer = "^${LAYERDIR}/"
BBFILE_PRIORITY_s8036-layer = "5"
LAYERSERIES_COMPAT_s8036-layer = "scarthgap styhead"
```

## meta-ufispace/conf/layer.conf
```bitbake
# We have a conf and classes directory, add to BBPATH
BBPATH .= ":${LAYERDIR}"

# We have recipes-* directories, add to BBFILES
BBFILES += "${LAYERDIR}/meta-common/recipes-*/*/*.bb \
            ${LAYERDIR}/meta-common/recipes-*/*/*.bbappend"

BBFILE_COLLECTIONS += "ufispace-layer"
BBFILE_PATTERN_ufispace-layer := "^${LAYERDIR}/"
LAYERSERIES_COMPAT_ufispace-layer = "scarthgap styhead"
```

## meta-ufispace/conf/machine/include/ufispace.inc
```bitbake
MACHINE_FEATURES += "\
    obmc-bmc-state-mgmt \
    obmc-host-state-mgmt \
    obmc-chassis-state-mgmt \
    obmc-host-ipmi \
    obmc-phosphor-chassis-mgmt \
    obmc-phosphor-fan-mgmt \
    obmc-phosphor-flash-mgmt \
    "

PREFERRED_PROVIDER_virtual/obmc-chassis-mgmt = "packagegroup-ufispace-apps"
PREFERRED_PROVIDER_virtual/obmc-fan-mgmt = "packagegroup-ufispace-apps"
PREFERRED_PROVIDER_virtual/obmc-flash-mgmt = "packagegroup-ufispace-apps"
PREFERRED_PROVIDER_virtual/obmc-system-mgmt = "packagegroup-ufispace-apps"
PREFERRED_PROVIDER_virtual/obmc-host-ipmi-hw = "phosphor-ipmi-kcs"

OVERRIDES .= ":ufispace"

IMAGE_FEATURES:remove = "obmc-ikvm"
```
