## yocto-poky/meta/conf/machine/include/tune-power5.inc
```bitbake
DEFAULTTUNE ?= "ppc64p5"

require conf/machine/include/powerpc/arch-powerpc64.inc

TUNEVALID[power5] = "Enable IBM Power5 specific processor optimizations"
TUNE_CCARGS .= "${@bb.utils.contains('TUNE_FEATURES', 'power5', ' -mcpu=power5', '', d)}"

AVAILTUNES += "ppcp5 ppc64p5"
TUNE_FEATURES_tune-ppcp5 = "m32 fpu-hard power5 altivec"
BASE_LIB_tune-ppcp5 = "lib"
TUNE_PKGARCH_tune-ppcp5 = "ppcp5"
PACKAGE_EXTRA_ARCHS_tune-ppcp5 = "${PACKAGE_EXTRA_ARCHS_tune-powerpc} ppcp5"

TUNE_FEATURES_tune-ppc64p5 = "m64 fpu-hard power5 altivec"
BASE_LIB_tune-ppc64p5 = "lib64"
TUNE_PKGARCH_tune-ppc64p5 = "ppc64p5"
PACKAGE_EXTRA_ARCHS_tune-ppc64p5 = "${PACKAGE_EXTRA_ARCHS_tune-powerpc64} ppc64p5"

# glibc configure options to get power5 specific library
GLIBC_EXTRA_OECONF_powerpc64 += "${@bb.utils.contains('TUNE_FEATURES', 'power5', '--with-cpu=power5', '', d)}"
GLIBC_EXTRA_OECONF_powerpc += "${@bb.utils.contains('TUNE_FEATURES', 'power5', '--with-cpu=power5', '', d)}"
```

## yocto-poky/meta/conf/machine/include/tune-ppce300c2.inc
```bitbake
DEFAULTTUNE ?= "ppce300c2"

require conf/machine/include/powerpc/arch-powerpc.inc

TUNEVALID[ppce300c2] = "Enable ppce300c2 specific processor optimizations"
TUNE_CCARGS .= "${@bb.utils.contains("TUNE_FEATURES", "ppce300c2", " -mcpu=e300c2", "", d)}"

AVAILTUNES += "ppce300c2"
TUNE_FEATURES_tune-ppce300c2 = "m32 fpu-soft ppce300c2"
TUNE_PKGARCH_tune-ppce300c2 = "ppce300c2"
PACKAGE_EXTRA_ARCHS_tune-ppce300c2 = "${PACKAGE_EXTRA_ARCHS_tune-powerpc-nf} ppce300c2"
```

## yocto-poky/meta/conf/machine/include/tune-ppce300c3.inc
```bitbake
DEFAULTTUNE ?= "ppce300c3"

require conf/machine/include/powerpc/arch-powerpc.inc

AVAILTUNES += "ppce300c3 ppce300c3-nf"

# hard-float
TUNEVALID[ppce300c3] = "Enable ppce300c3 specific processor optimizations"
TUNE_FEATURES_tune-ppce300c3 = "${TUNE_FEATURES_tune-powerpc} ppce300c3"
TUNE_PKGARCH_tune-ppce300c3 = "ppce300c3"
PACKAGE_EXTRA_ARCHS_tune-ppce300c3 = "${PACKAGE_EXTRA_ARCHS_tune-powerpc} ppce300c3"
TUNE_CCARGS .= "${@bb.utils.contains("TUNE_FEATURES", "ppce300c3", " -mcpu=e300c3", "", d)}"

# glibc config options to make use of e300c3 (603e) specific sqrt/sqrtf routines
GLIBC_EXTRA_OECONF += "${@bb.utils.contains("TUNE_FEATURES", "ppce300c3", "--with-cpu=e300c3", "", d)}"

# soft-float
TUNEVALID[ppce300c3-nf] = "Enable ppce300c3 specific processor optimizations (no fpu)"
TUNE_FEATURES_tune-ppce300c3-nf = "${TUNE_FEATURES_tune-powerpc-nf} ppce300c3-nf"
TUNE_PKGARCH_tune-ppce300c3-nf = "ppce300c3-nf"
PACKAGE_EXTRA_ARCHS_tune-ppce300c3-nf = "${PACKAGE_EXTRA_ARCHS_tune-powerpc-nf} ppce300c3-nf"
TUNE_CCARGS .= "${@bb.utils.contains("TUNE_FEATURES", "ppce300c3-nf", " -mcpu=e300c3", "", d)}"
```

## yocto-poky/meta/conf/machine/include/tune-ppce500.inc
```bitbake
DEFAULTTUNE ?= "ppce500"

require conf/machine/include/powerpc/arch-powerpc.inc

TUNEVALID[ppce500] = "Enable ppce500 specific processor optimizations"
TUNE_CCARGS .= "${@bb.utils.contains("TUNE_FEATURES", "ppce500", " -mcpu=8540", "", d)}"

TUNEVALID[spe] = "Enable SPE ABI extensions"
TUNE_CCARGS .= "${@bb.utils.contains("TUNE_FEATURES", [ "ppce500", "spe" ], " -mabi=spe -mspe -mfloat-gprs=single", "", d)}"
TARGET_FPU .= "${@bb.utils.contains("TUNE_FEATURES", [ "ppce500" , "spe" ], "ppc-efs", "", d)}"

# spe is defined potentially in two places, so we want to be sure it will
# only write spe once to the ABIEXTENSIONS field.
SPEABIEXTENSION = "${@bb.utils.contains("TUNE_FEATURES", "spe", "spe", "", d)}"
ABIEXTENSION .= "${SPEABIEXTENSION}"

AVAILTUNES += "ppce500"
TUNE_FEATURES_tune-ppce500 = "m32 spe ppce500"
TUNE_PKGARCH_tune-ppce500 = "ppce500"
PACKAGE_EXTRA_ARCHS_tune-ppce500 = "ppce500"
```

## yocto-poky/scripts/lib/bsp/substrate/target/arch/i386/conf/machine/machine.conf
```bitbake
# yocto-bsp-filename {{=machine}}.conf
#@TYPE: Machine
#@NAME: {{=machine}}

#@DESCRIPTION: Machine configuration for {{=machine}} systems

{{ if kernel_choice == "custom": preferred_kernel = "linux-yocto-custom" }}
{{ if kernel_choice == "linux-yocto-dev": preferred_kernel = "linux-yocto-dev" }}
{{ if kernel_choice == "custom" or kernel_choice == "linux-yocto-dev" : }}
PREFERRED_PROVIDER_virtual/kernel ?= "{{=preferred_kernel}}"

{{ if kernel_choice != "custom" and kernel_choice != "linux-yocto-dev": preferred_kernel = kernel_choice.split('_')[0] }}
{{ if kernel_choice != "custom" and kernel_choice != "linux-yocto-dev": preferred_kernel_version = kernel_choice.split('_')[1] }}
{{ if kernel_choice != "custom" and kernel_choice != "linux-yocto-dev": }}
PREFERRED_PROVIDER_virtual/kernel ?= "{{=preferred_kernel}}"
PREFERRED_VERSION_{{=preferred_kernel}} ?= "{{=preferred_kernel_version}}%"

{{ input type:"choicelist" name:"tunefile" prio:"40" msg:"Which machine tuning would you like to use?" default:"tune_core2" }}
{{ input type:"choice" val:"tune_i586" msg:"i586 tuning optimizations" }}
{{ input type:"choice" val:"tune_atom" msg:"Atom tuning optimizations" }}
{{ input type:"choice" val:"tune_core2" msg:"Core2 tuning optimizations" }}
{{ if tunefile == "tune_i586": }}
require conf/machine/include/tune-i586.inc
{{ if tunefile == "tune_atom": }}
require conf/machine/include/tune-atom.inc
{{ if tunefile == "tune_core2": }}
DEFAULTTUNE="core2-32"
require conf/machine/include/tune-core2.inc

require conf/machine/include/x86-base.inc

MACHINE_FEATURES += "wifi efi pcbios"

{{ input type:"boolean" name:"xserver" prio:"50" msg:"Do you need support for X? (y/n)" default:"y" }}

{{ if xserver == "y" and (kernel_choice == "linux-yocto_4.4" or kernel_choice == "linux-yocto_4.1"): }}
{{ input type:"choicelist" name:"xserver_choice" prio:"50" msg:"Please select an xserver for this machine:" default:"xserver_vesa" }}
{{ input type:"choice" val:"xserver_vesa" msg:"VESA xserver support" }}
{{ input type:"choice" val:"xserver_i915" msg:"i915 xserver support" }}
{{ input type:"choice" val:"xserver_i965" msg:"i965 xserver support" }}
{{ input type:"choice" val:"xserver_fbdev" msg:"fbdev xserver support" }}
{{ input type:"choice" val:"xserver_modesetting" msg:"modesetting xserver support" }}

{{ if xserver == "y" and kernel_choice == "custom": }}
{{ input type:"choicelist" name:"xserver_choice" prio:"50" msg:"Please select an xserver for this machine:" default:"xserver_vesa" }}
{{ input type:"choice" val:"xserver_vesa" msg:"VESA xserver support" }}
{{ input type:"choice" val:"xserver_i915" msg:"i915 xserver support" }}
{{ input type:"choice" val:"xserver_i965" msg:"i965 xserver support" }}
{{ input type:"choice" val:"xserver_fbdev" msg:"fbdev xserver support" }}
{{ input type:"choice" val:"xserver_modesetting" msg:"modesetting xserver support" }}

{{ if xserver == "y" and kernel_choice != "linux-yocto_4.4" and kernel_choice != "linux-yocto_4.1" and kernel_choice != "custom": xserver_choice = "xserver_i915" }}

{{ if xserver == "y": }}
XSERVER ?= "${XSERVER_X86_BASE} \
           ${XSERVER_X86_EXT} \
{{ if xserver == "y" and xserver_choice == "xserver_vesa": }}
           ${XSERVER_X86_VESA} \
{{ if xserver == "y" and xserver_choice == "xserver_i915": }}
           ${XSERVER_X86_I915} \
{{ if xserver == "y" and xserver_choice == "xserver_i965": }}
           ${XSERVER_X86_I965} \
{{ if xserver == "y" and xserver_choice == "xserver_fbdev": }}
           ${XSERVER_X86_FBDEV} \
{{ if xserver == "y" and xserver_choice == "xserver_modesetting": }}
           ${XSERVER_X86_MODESETTING} \
{{ if xserver == "y": }}
           "

MACHINE_EXTRA_RRECOMMENDS += "linux-firmware v86d eee-acpi-scripts"

EXTRA_OECONF_append_pn-matchbox-panel-2 = " --with-battery=acpi"

GLIBC_ADDONS = "nptl"

{{ if xserver == "y" and xserver_choice == "xserver_vesa": }}
APPEND += "video=vesafb vga=0x318"
```

## yocto-poky/scripts/lib/bsp/substrate/target/arch/mips/conf/machine/machine.conf
```bitbake
# yocto-bsp-filename {{=machine}}.conf
#@TYPE: Machine
#@NAME: {{=machine}}

#@DESCRIPTION: Machine configuration for {{=machine}} systems

require conf/machine/include/tune-mips32.inc

MACHINE_FEATURES = "screen keyboard pci usbhost ext2 ext3 serial"

KERNEL_IMAGETYPE = "vmlinux"
KERNEL_ALT_IMAGETYPE = "vmlinux.bin"
KERNEL_IMAGE_STRIP_EXTRA_SECTIONS  = ".comment"

{{ if kernel_choice == "custom": preferred_kernel = "linux-yocto-custom" }}
{{ if kernel_choice == "linux-yocto-dev": preferred_kernel = "linux-yocto-dev" }}
{{ if kernel_choice == "custom" or kernel_choice == "linux-yocto-dev" : }}
PREFERRED_PROVIDER_virtual/kernel ?= "{{=preferred_kernel}}"

{{ if kernel_choice != "custom" and kernel_choice != "linux-yocto-dev": preferred_kernel = kernel_choice.split('_')[0] }}
{{ if kernel_choice != "custom" and kernel_choice != "linux-yocto-dev": preferred_kernel_version = kernel_choice.split('_')[1] }}
{{ if kernel_choice != "custom" and kernel_choice != "linux-yocto-dev": }}
PREFERRED_PROVIDER_virtual/kernel ?= "{{=preferred_kernel}}"
PREFERRED_VERSION_{{=preferred_kernel}} ?= "{{=preferred_kernel_version}}%"

{{ input type:"boolean" name:"xserver" prio:"50" msg:"Do you need support for X? (y/n)" default:"y" }}
{{ if xserver == "y": }}
PREFERRED_PROVIDER_virtual/xserver ?= "xserver-xorg"
XSERVER ?= "xserver-xorg \
            xf86-input-evdev \
            xf86-video-fbdev"

SERIAL_CONSOLE = "115200 ttyS0"
USE_VT ?= "0"

MACHINE_EXTRA_RRECOMMENDS = " kernel-modules"

IMAGE_FSTYPES ?= "jffs2 tar.bz2"
JFFS2_ERASEBLOCK = "0x10000"
```

## yocto-poky/scripts/lib/bsp/substrate/target/arch/powerpc/conf/machine/machine.conf
```bitbake
# yocto-bsp-filename {{=machine}}.conf
#@TYPE: Machine
#@NAME: {{=machine}}

#@DESCRIPTION: Machine configuration for {{=machine}} systems

TARGET_FPU = ""

{{ input type:"choicelist" name:"tunefile" prio:"40" msg:"Which machine tuning would you like to use?" default:"tune_ppce300c3" }}
{{ input type:"choice" val:"tune_ppc476" msg:"ppc476 tuning optimizations" }}
{{ input type:"choice" val:"tune_ppc603e" msg:"ppc603e tuning optimizations" }}
{{ input type:"choice" val:"tune_ppc7400" msg:"ppc7400 tuning optimizations" }}
{{ input type:"choice" val:"tune_ppce300c2" msg:"ppce300c2 tuning optimizations" }}
{{ input type:"choice" val:"tune_ppce300c3" msg:"ppce300c3 tuning optimizations" }}
{{ input type:"choice" val:"tune_ppce500" msg:"ppce500 tuning optimizations" }}
{{ input type:"choice" val:"tune_ppce500mc" msg:"ppce500mc tuning optimizations" }}
{{ input type:"choice" val:"tune_ppce500v2" msg:"ppce500v2 tuning optimizations" }}
{{ input type:"choice" val:"tune_ppce5500" msg:"ppce5500 tuning optimizations" }}
{{ input type:"choice" val:"tune_ppce6500" msg:"ppce6500 tuning optimizations" }}
{{ input type:"choice" val:"tune_power5" msg:"power5 tuning optimizations" }}
{{ input type:"choice" val:"tune_power6" msg:"power6 tuning optimizations" }}
{{ input type:"choice" val:"tune_power7" msg:"power7 tuning optimizations" }}
{{ if tunefile == "tune_ppc476": }}
include conf/machine/include/tune-ppc476.inc
{{ if tunefile == "tune_ppc603e": }}
include conf/machine/include/tune-ppc603e.inc
{{ if tunefile == "tune_ppc7400": }}
include conf/machine/include/tune-ppc7400.inc
{{ if tunefile == "tune_ppce300c2": }}
include conf/machine/include/tune-ppce300c2.inc
{{ if tunefile == "tune_ppce300c3": }}
include conf/machine/include/tune-ppce300c3.inc
{{ if tunefile == "tune_ppce500": }}
include conf/machine/include/tune-ppce500.inc
{{ if tunefile == "tune_ppce500mc": }}
include conf/machine/include/tune-ppce500mc.inc
{{ if tunefile == "tune_ppce500v2": }}
include conf/machine/include/tune-ppce500v2.inc
{{ if tunefile == "tune_ppce5500": }}
include conf/machine/include/tune-ppce5500.inc
{{ if tunefile == "tune_ppce6500": }}
include conf/machine/include/tune-ppce6500.inc
{{ if tunefile == "tune_power5": }}
include conf/machine/include/tune-power5.inc
{{ if tunefile == "tune_power6": }}
include conf/machine/include/tune-power6.inc
{{ if tunefile == "tune_power7": }}
include conf/machine/include/tune-power7.inc

KERNEL_IMAGETYPE = "uImage"

EXTRA_IMAGEDEPENDS += "u-boot"
UBOOT_MACHINE_{{=machine}} = "MPC8315ERDB_config"

SERIAL_CONSOLE = "115200 ttyS0"

MACHINE_FEATURES = "keyboard pci ext2 ext3 serial"

{{ if kernel_choice == "custom": preferred_kernel = "linux-yocto-custom" }}
{{ if kernel_choice == "linux-yocto-dev": preferred_kernel = "linux-yocto-dev" }}
{{ if kernel_choice == "custom" or kernel_choice == "linux-yocto-dev" : }}
PREFERRED_PROVIDER_virtual/kernel ?= "{{=preferred_kernel}}"

{{ if kernel_choice != "custom" and kernel_choice != "linux-yocto-dev": preferred_kernel = kernel_choice.split('_')[0] }}
{{ if kernel_choice != "custom" and kernel_choice != "linux-yocto-dev": preferred_kernel_version = kernel_choice.split('_')[1] }}
{{ if kernel_choice != "custom" and kernel_choice != "linux-yocto-dev": }}
PREFERRED_PROVIDER_virtual/kernel ?= "{{=preferred_kernel}}"
PREFERRED_VERSION_{{=preferred_kernel}} ?= "{{=preferred_kernel_version}}%"

{{ input type:"boolean" name:"xserver" prio:"50" msg:"Do you need support for X? (y/n)" default:"y" }}
{{ if xserver == "y": }}
PREFERRED_PROVIDER_virtual/xserver ?= "xserver-xorg"
XSERVER ?= "xserver-xorg \
           xf86-input-evdev \
           xf86-video-fbdev"

PREFERRED_VERSION_u-boot ?= "v2016.01%"
{{ input type:"edit" name:"uboot_entrypoint" prio:"40" msg:"Please specify a value for UBOOT_ENTRYPOINT:" default:"0x00000000" }}
UBOOT_ENTRYPOINT = "{{=uboot_entrypoint}}"

{{ input type:"edit" name:"kernel_devicetree" prio:"40" msg:"Please specify a [arch/powerpc/boot/dts/xxx] value for KERNEL_DEVICETREE:" default:"mpc8315erdb.dts" }}
KERNEL_DEVICETREE = "${S}/arch/powerpc/boot/dts/{{=kernel_devicetree}}"

MACHINE_EXTRA_RRECOMMENDS = " kernel-modules"

IMAGE_FSTYPES ?= "jffs2 tar.bz2"
JFFS2_ERASEBLOCK = "0x4000"
```

## yocto-poky/scripts/lib/wic/canned-wks/directdisk-bootloader-config.wks
```
# short-description: Create a 'pcbios' direct disk image with custom bootloader config
# long-description: Creates a partitioned legacy BIOS disk image that the user
# can directly dd to boot media. The bootloader configuration source is a user file.

include common.wks.inc

bootloader --configfile="directdisk-bootloader-config.cfg"
```
