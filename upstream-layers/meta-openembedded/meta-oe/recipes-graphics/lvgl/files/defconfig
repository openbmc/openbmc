## upstream-layers/meta-openembedded/meta-oe/recipes-graphics/lvgl/files/defconfig
```kconfig
CONFIG_LV_COLOR_DEPTH_32=y
# CONFIG_LV_BUILD_EXAMPLES is not set
# CONFIG_LV_BUILD_DEMOS is not set
```

## upstream-layers/meta-openembedded/meta-oe/recipes-graphics/lvgl/lvgl-demo-fb/defconfig
```kconfig
CONFIG_LV_COLOR_DEPTH_32=y
CONFIG_LV_MEM_SIZE_KILOBYTES=256
CONFIG_LV_USE_LOG=y
CONFIG_LV_LOG_PRINTF=y
CONFIG_LV_USE_FONT_COMPRESSED=y
CONFIG_LV_USE_DEMO_WIDGETS=y
```

## upstream-layers/meta-openembedded/meta-perl/conf/layer.conf
```bitbake
# We have a conf and classes directory, add to BBPATH
BBPATH .= ":${LAYERDIR}"

# We have recipes-* directories, add to BBFILES
BBFILES += "${LAYERDIR}/recipes-*/*/*.bb \
	${LAYERDIR}/recipes-*/*/*.bbappend"

BBFILE_COLLECTIONS += "perl-layer"
BBFILE_PATTERN_perl-layer := "^${LAYERDIR}/"
BBFILE_PRIORITY_perl-layer = "5"

# This should only be incremented on significant changes that will
# cause compatibility issues with other layers
LAYERVERSION_perl-layer = "1"

LAYERDEPENDS_perl-layer = "core openembedded-layer"

LAYERSERIES_COMPAT_perl-layer = "walnascar whinlatter"

# List of known non-reproducible package of the meta-perl layer
# Please keep this list sorted
OEQA_REPRODUCIBLE_EXCLUDED_PACKAGES += " \
    libencode-perl-src \
    libhtml-tree-perl \
    libhtml-tree-perl-doc \
    libmodule-build-tiny-perl \
    po4a \
    po4a-doc \
"
```

## upstream-layers/meta-openembedded/meta-python/conf/layer.conf
```bitbake
# We might have a conf and classes directory, append to BBPATH
BBPATH .= ":${LAYERDIR}"

# We have recipes directories, add to BBFILES
BBFILES += "${LAYERDIR}/recipes*/*/*.bb ${LAYERDIR}/recipes*/*/*.bbappend"

BBFILE_COLLECTIONS += "meta-python"
BBFILE_PATTERN_meta-python := "^${LAYERDIR}/"
BBFILE_PRIORITY_meta-python = "5"

# This should only be incremented on significant changes that will
# cause compatibility issues with other layers
LAYERVERSION_meta-python = "1"

LAYERDEPENDS_meta-python = "core (>= 12) openembedded-layer"

LAYERSERIES_COMPAT_meta-python = "walnascar whinlatter"

LICENSE_PATH += "${LAYERDIR}/licenses"

# List of known non-reproducible package of the meta-python layer
# Please keep this list sorted
OEQA_REPRODUCIBLE_EXCLUDED_PACKAGES += " \
    python3-evdev \
    python3-evdev-dbg \
    python3-evdev-src \
    python3-frozenlist \
    python3-frozenlist-dbg \
    python3-kivy-src \
    python3-lief \
    python3-mlcommons-loadgen \
    python3-mlcommons-loadgen-dbg \
    python3-mlcommons-loadgen-src \
    python3-pandas \
    python3-pandas-dbg \
    python3-pandas-src \
    python3-propcache \
    python3-propcache-dbg \
    python3-pybind11-json-dev \
    python3-pycocotools-src \
    python3-pydantic-core \
    python3-pynacl \
    python3-pynacl-dbg \
    python3-pynacl-src \
    python3-pyproj \
    python3-pyproj-dbg \
    python3-pyproj-src \
    python3-pyzmq \
    python3-yarl \
    python3-yarl-dbg \
"
```

## upstream-layers/meta-openembedded/meta-xfce/conf/layer.conf
```bitbake
# We have a conf and classes directory, append to BBPATH
BBPATH .= ":${LAYERDIR}"

# We have a recipes directory, add to BBFILES
BBFILES += "${LAYERDIR}/recipes-*/*/*.bb ${LAYERDIR}/recipes-*/*/*.bbappend"

BBFILE_COLLECTIONS += "xfce-layer"
BBFILE_PATTERN_xfce-layer := "^${LAYERDIR}/"
BBFILE_PRIORITY_xfce-layer = "5"

# This should only be incremented on significant changes that will
# cause compatibility issues with other layers
LAYERVERSION_xfce-layer = "1"

LAYERDEPENDS_xfce-layer = "core"
LAYERDEPENDS_xfce-layer += "openembedded-layer"
LAYERDEPENDS_xfce-layer += "gnome-layer"
LAYERDEPENDS_xfce-layer += "multimedia-layer"
LAYERDEPENDS_xfce-layer += "meta-python"
LAYERDEPENDS_xfce-layer += "networking-layer"

LAYERSERIES_COMPAT_xfce-layer = "walnascar whinlatter"

SIGGEN_EXCLUDE_SAFE_RECIPE_DEPS += "\
  openzone->gdk-pixbuf \
  openzone->gtk+3 \
  rodent-icon-theme->gdk-pixbuf \
  rodent-icon-theme->gtk+3 \
"

# List of known non-reproducible package of the meta-xfce layer
# Please keep this list sorted
OEQA_REPRODUCIBLE_EXCLUDED_PACKAGES += " \
    catfish \
    libsamba-util0 \
    samba-dbg \
"
```

## upstream-layers/meta-raspberrypi/conf/machine/include/rpi-default-settings.inc
```bitbake
# RaspberryPi BSP default settings

IMAGE_CLASSES += "sdcard_image-rpi"

# RPI kernel has errors of its own which should be filtered
# therefore use parselogs_rpi test instead of parselogs from oe-core
#
DEFAULT_TEST_SUITES:append:rpi = " parselogs_rpi"
DEFAULT_TEST_SUITES:remove:rpi = " parselogs"
```

## upstream-layers/meta-raspberrypi/conf/machine/include/rpi-default-versions.inc
```bitbake
# RaspberryPi BSP default versions

PREFERRED_VERSION_linux-raspberrypi ??= "6.18.%"
PREFERRED_VERSION_linux-raspberrypi:raspberrypi-armv7 ??= "6.12.%"
PREFERRED_VERSION_linux-raspberrypi-v7 ??= "6.12.%"
```

## upstream-layers/meta-raspberrypi/conf/machine/raspberrypi-cm5-io-board.conf
```bitbake
#@TYPE: Machine
#@NAME: Raspberry Pi Compute Module 5 IO Board (64-bit)
#@DESCRIPTION: Machine configuration for the Raspberry Pi Compute Module 5 IO Board in 64 bits mode

MACHINEOVERRIDES =. "raspberrypi5:"

include conf/machine/raspberrypi5.conf
```

## upstream-layers/meta-raspberrypi/conf/machine/raspberrypi.conf
```bitbake
#@TYPE: Machine
#@NAME: RaspberryPi Development Board
#@DESCRIPTION: Machine configuration for the RaspberryPi http://www.raspberrypi.org/ Board

DEFAULTTUNE ?= "arm1176jzfshf"

require conf/machine/include/tune-arm1176jzf-s.inc
include conf/machine/include/rpi-base.inc

SDIMG_KERNELIMAGE  ?= "kernel.img"
UBOOT_MACHINE = "rpi_config"
SERIAL_CONSOLES ?= "115200;ttyAMA0"

ARMSTUB ?= "armstub.bin"

#
# Below are variables ONLY needed for running with Yocto/OE's runqemu script
#
IMAGE_CLASSES += "qemuboot"

QB_SYSTEM_NAME = "qemu-system-arm"
QB_MACHINE = "-machine raspi1ap"
QB_MEM = "-m 512"
QB_DTB = "bcm2708-rpi-b-plus.dtb"
QB_NETWORK_DEVICE = "-device usb-net,netdev=net0,mac=@MAC@"
QB_KERNEL_ROOT = "/dev/sda"
# The dwc_otg.fiq_fsm_enable setting is necessary to get USB devices (both disk and net) working.  Without this, boot hangs
# The initcall_blacklist=bcm2835_pm_driver_init is needed to workaround boot issues.  Seems like the PM HW emulation isn't present
QB_KERNEL_CMDLINE_APPEND = "rootwait initcall_blacklist=bcm2835_pm_driver_init earlycon=pl011,0x20201000 dwc_otg.fiq_fsm_enable=0"
QB_RNG = ""
QB_ROOTFS_OPT = "-drive id=disk0,file=@ROOTFS@,if=none,format=raw -device usb-storage,drive=disk0"
QB_DEFAULT_FSTYPE = "ext3"
```

## upstream-layers/meta-raspberrypi/conf/machine/raspberrypi0-2w.conf
```bitbake
#@TYPE: Machine
#@NAME: RaspberryPi0 2 Wifi Development Board
#@DESCRIPTION: Machine configuration for the RaspberryPi0 2 Wifi in 32 bits mode

MACHINEOVERRIDES =. "raspberrypi3:"

include conf/machine/raspberrypi3.conf

MACHINE_EXTRA_RRECOMMENDS += "\
    linux-firmware-rpidistro-bcm43436 \
    linux-firmware-rpidistro-bcm43436s \
    bluez-firmware-rpidistro-bcm43430b0-hcd \
"
```

## upstream-layers/meta-raspberrypi/conf/machine/raspberrypi2-64.conf
```bitbake
#@TYPE: Machine
#@NAME: RaspberryPi 2 V1.2 Development Board
#@DESCRIPTION: Machine configuration for the RaspberryPi 2 in 64 bits mode

MACHINEOVERRIDES =. "raspberrypi3-64:"

DEFAULTTUNE ?= "cortexa53-nocrypto"
require conf/machine/include/arm/armv8a/tune-cortexa53.inc
include conf/machine/include/rpi-base.inc

RPI_KERNEL_DEVICETREE = " \
    broadcom/bcm2710-rpi-2-b.dtb \
    broadcom/bcm2710-rpi-3-b.dtb \
    broadcom/bcm2710-rpi-3-b-plus.dtb \
    broadcom/bcm2837-rpi-3-b.dtb \
    broadcom/bcm2710-rpi-cm3.dtb \
    "

SDIMG_KERNELIMAGE ?= "kernel8.img"
# When u-boot is enabled we need to use the "Image" format and the "booti"
# command to load the kernel
KERNEL_IMAGETYPE_UBOOT ?= "Image"
# "zImage" not supported on arm64 and ".gz" images not supported by bootloader yet
KERNEL_IMAGETYPE_DIRECT ?= "Image"
KERNEL_BOOTCMD ?= "booti"
UBOOT_MACHINE = "rpi_arm64_config"
SERIAL_CONSOLES ?= "115200;ttyAMA0"

VC4DTBO ?= "vc4-fkms-v3d"
ARMSTUB ?= "armstub8.bin"
```

## upstream-layers/meta-raspberrypi/conf/machine/raspberrypi2.conf
```bitbake
#@TYPE: Machine
#@NAME: RaspberryPi 2 Development Board
#@DESCRIPTION: Machine configuration for the RaspberryPi 2

DEFAULTTUNE ?= "cortexa7thf-neon-vfpv4"

require conf/machine/include/arm/armv7a/tune-cortexa7.inc
include conf/machine/include/rpi-base.inc

SDIMG_KERNELIMAGE ?= "kernel7.img"
SERIAL_CONSOLES ?= "115200;ttyAMA0"
UBOOT_MACHINE = "rpi_2_config"

ARMSTUB ?= "armstub7.bin"

#
# Below are variables ONLY needed for running with Yocto/OE's runqemu script
#
IMAGE_CLASSES += "qemuboot"

QB_SYSTEM_NAME = "qemu-system-arm"
QB_MACHINE = "-machine raspi2b"
QB_MEM = "-m 1024"
QB_DTB = "bcm2709-rpi-2-b.dtb"
QB_NETWORK_DEVICE = "-device usb-net,netdev=net0,mac=@MAC@"
QB_KERNEL_ROOT = "/dev/sda"
# The dwc_otg.fiq_fsm_enable setting is necessary to get USB devices (both disk and net) working.  Without this, boot hangs
QB_KERNEL_CMDLINE_APPEND = "rootwait earlycon=pl011,0x3f201000 dwc_otg.fiq_fsm_enable=0"
QB_RNG = ""
QB_ROOTFS_OPT = "-drive id=disk0,file=@ROOTFS@,if=none,format=raw -device usb-storage,drive=disk0"
QB_DEFAULT_FSTYPE = "ext3"
```

## upstream-layers/meta-raspberrypi/conf/machine/raspberrypi4.conf
```bitbake
#@TYPE: Machine
#@NAME: RaspberryPi 4 Development Board (32bit)
#@DESCRIPTION: Machine configuration for the RaspberryPi 4 in 32 bit mode

DEFAULTTUNE ?= "cortexa7thf-neon-vfpv4"
require conf/machine/include/arm/armv7a/tune-cortexa7.inc
include conf/machine/include/rpi-base.inc

# 6.18 has removed 32bit config for rpi4 and expects it
# to always use 64bit kernel even if rootfs is needed to be
# 32bit. So we need multiconfig builds, and technically, 32bit
# option for rpi4 should be gone
PREFERRED_VERSION_linux-raspberrypi ?= "6.12.%"

MACHINE_FEATURES += "pci"
MACHINE_EXTRA_RRECOMMENDS += "\
    linux-firmware-rpidistro-bcm43455 \
    bluez-firmware-rpidistro-bcm4345c0-hcd \
    linux-firmware-rpidistro-bcm43456 \
    bluez-firmware-rpidistro-bcm4345c5-hcd \
"

# 'l' stands for LPAE
SDIMG_KERNELIMAGE ?= "kernel7l.img"
UBOOT_MACHINE = "rpi_4_32b_config"
SERIAL_CONSOLES ?= "115200;ttyS0"

VC4DTBO ?= "vc4-kms-v3d"
ARMSTUB ?= "armstub7.bin"
```

## upstream-layers/meta-security/conf/distro/include/maintainers-meta-security.inc
```bitbake
# meta-security Maintainers File
#
# This file contains a list of recipe maintainers.
#
# Please submit any patches against recipes in meta to the 
# Yocto mail list (yocto@yoctoproject.org)
#
# If you have problems with or questions about a particular recipe, feel
# free to contact the maintainer directly (cc:ing the appropriate mailing list
# puts it in the archive and helps other people who might have the same
# questions in the future), but please try to do the following first:
#
#  - look in the Yocto Project Bugzilla
#    (http://bugzilla.yoctoproject.org/) to see if a problem has
#    already been reported
#
# The format is as a bitbake variable override for each recipe
#
#	RECIPE_MAINTAINER:pn-<recipe name> = "Full Name <address@domain>"
#
# Please keep this list in alphabetical order.
RECIPE_MAINTAINER:pn-aircrack-ng = "Scott Murray <scott.murray@konsulko.com>"
RECIPE_MAINTAINER:pn-apparmor = "Scott Murray <scott.murray@konsulko.com>"
RECIPE_MAINTAINER:pn-bastille = "Scott Murray <scott.murray@konsulko.com>"
RECIPE_MAINTAINER:pn-buck-security = "Scott Murray <scott.murray@konsulko.com>"
RECIPE_MAINTAINER:pn-ccs-tools = "Scott Murray <scott.murray@konsulko.com>"
RECIPE_MAINTAINER:pn-checksec = "Scott Murray <scott.murray@konsulko.com>"
RECIPE_MAINTAINER:pn-checksecurity = "Scott Murray <scott.murray@konsulko.com>"
RECIPE_MAINTAINER:pn-clamav = "Scott Murray <scott.murray@konsulko.com>"
RECIPE_MAINTAINER:pn-ding-libs = "Scott Murray <scott.murray@konsulko.com>"
RECIPE_MAINTAINER:pn-ecryptfs-utils = "Scott Murray <scott.murray@konsulko.com>"
RECIPE_MAINTAINER:pn-fscryptctl = "Scott Murray <scott.murray@konsulko.com>"
RECIPE_MAINTAINER:pn-google-authenticator-libpam = "Scott Murray <scott.murray@konsulko.com>"
RECIPE_MAINTAINER:pn-hash-perl = "Scott Murray <scott.murray@konsulko.com>"
RECIPE_MAINTAINER:pn-isic = "Scott Murray <scott.murray@konsulko.com>"
RECIPE_MAINTAINER:pn-keyutils = "Scott Murray <scott.murray@konsulko.com>"
RECIPE_MAINTAINER:pn-libaes-siv = "Scott Murray <scott.murray@konsulko.com>"
RECIPE_MAINTAINER:pn-libgssglue = "Scott Murray <scott.murray@konsulko.com>"
RECIPE_MAINTAINER:pn-libhtp = "Scott Murray <scott.murray@konsulko.com>"
RECIPE_MAINTAINER:pn-libmhash = "Scott Murray <scott.murray@konsulko.com>"
RECIPE_MAINTAINER:pn-libmspack = "Scott Murray <scott.murray@konsulko.com>"
RECIPE_MAINTAINER:pn-lib-perl = "Scott Murray <scott.murray@konsulko.com>"
RECIPE_MAINTAINER:pn-libseccomp = "Scott Murray <scott.murray@konsulko.com>"
RECIPE_MAINTAINER:pn-libwhisker2-perl = "Scott Murray <scott.murray@konsulko.com>"
RECIPE_MAINTAINER:pn-ncrack = "Scott Murray <scott.murray@konsulko.com>"
RECIPE_MAINTAINER:pn-nikto = "Scott Murray <scott.murray@konsulko.com>"
RECIPE_MAINTAINER:pn-paxctl = "Scott Murray <scott.murray@konsulko.com>"
RECIPE_MAINTAINER:pn-python3-fail2ban = "Scott Murray <scott.murray@konsulko.com>"
RECIPE_MAINTAINER:pn-python3-scapy = "Scott Murray <scott.murray@konsulko.com>"
RECIPE_MAINTAINER:pn-python-fail2ban = "Scott Murray <scott.murray@konsulko.com>"
RECIPE_MAINTAINER:pn-python-scapy = "Scott Murray <scott.murray@konsulko.com>"
RECIPE_MAINTAINER:pn-redhat-security = "Scott Murray <scott.murray@konsulko.com>"
RECIPE_MAINTAINER:pn-samhain = "Scott Murray <scott.murray@konsulko.com>"
RECIPE_MAINTAINER:pn-smack = "Scott Murray <scott.murray@konsulko.com>"
RECIPE_MAINTAINER:pn-sssd = "Scott Murray <scott.murray@konsulko.com>"
RECIPE_MAINTAINER:pn-suricata = "Scott Murray <scott.murray@konsulko.com>"
RECIPE_MAINTAINER:pn-tripwire = "Scott Murray <scott.murray@konsulko.com>"
```

## upstream-layers/meta-security/meta-tpm/conf/distro/include/maintainers-meta-tpm.inc
```bitbake
# meta-tpm Maintainers File
#
# This file contains a list of recipe maintainers.
#
# Please submit any patches against recipes in meta to the 
# Yocto mail list (yocto@yoctoproject.org)
#
# If you have problems with or questions about a particular recipe, feel
# free to contact the maintainer directly (cc:ing the appropriate mailing list
# puts it in the archive and helps other people who might have the same
# questions in the future), but please try to do the following first:
#
#  - look in the Yocto Project Bugzilla
#    (http://bugzilla.yoctoproject.org/) to see if a problem has
#    already been reported
#
# The format is as a bitbake variable override for each recipe
#
#	RECIPE_MAINTAINER:pn-<recipe name> = "Full Name <address@domain>"
#
# Please keep this list in alphabetical order.
RECIPE_MAINTAINER:pn-aircrack-ng = "Scott Murray <scott.murray@konsulko.com>"
RECIPE_MAINTAINER:pn-pcr-extend = "Scott Murray <scott.murray@konsulko.com>"
RECIPE_MAINTAINER:pn-tpm-quote-tools = "Scott Murray <scott.murray@konsulko.com>"
RECIPE_MAINTAINER:pn-libtpms = "Scott Murray <scott.murray@konsulko.com>"
RECIPE_MAINTAINER:pn-trousers = "Scott Murray <scott.murray@konsulko.com>"
RECIPE_MAINTAINER:pn-swtpm = "Scott Murray <scott.murray@konsulko.com>"
RECIPE_MAINTAINER:pn-openssl-tpm-engine = "Scott Murray <scott.murray@konsulko.com>"
RECIPE_MAINTAINER:pn-tpm-tools = "Scott Murray <scott.murray@konsulko.com>"
RECIPE_MAINTAINER:pn-tpm2-abrmd = "Scott Murray <scott.murray@konsulko.com>"
RECIPE_MAINTAINER:pn-tpm2-totp = "Scott Murray <scott.murray@konsulko.com>"
RECIPE_MAINTAINER:pn-tpm2-tcti-uefi = "Scott Murray <scott.murray@konsulko.com>"
RECIPE_MAINTAINER:pn-tpm2-tss-engine = "Scott Murray <scott.murray@konsulko.com>"
RECIPE_MAINTAINER:pn-tpm2-pkcs11 = "Scott Murray <scott.murray@konsulko.com>"
RECIPE_MAINTAINER:pn-tpm2-tss = "Scott Murray <scott.murray@konsulko.com>"
RECIPE_MAINTAINER:pn-tpm2-tools = "Scott Murray <scott.murray@konsulko.com>"
RECIPE_MAINTAINER:pn-ibmswtpm2 = "Scott Murray <scott.murray@konsulko.com>"
```
