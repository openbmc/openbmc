## upstream-layers/openembedded-core/meta-selftest/files/wic/test_empty_plugin.wks
```
# short-description: image for checking empty partition creation

part / --source rootfs --fstype=ext4 --align 1024 --use-uuid
part empty --source empty --ondisk sda --size 1024 --align 1024
```

## upstream-layers/openembedded-core/meta-selftest/wic/test_gpt_partition_name.wks
```
# short-description: image to test part-name in GPT partitions

part --fstype=ext4 --part-name boot-A --label boot --size 1M --align 1024
part / --source rootfs --fstype=ext4 --part-name root-A --align 1024
part --fstype=ext4 --label ext-space --size 1M --align 1024

bootloader --ptable gpt
```

## upstream-layers/openembedded-core/meta-selftest/wic/wictestdisk.wks
```
# short-description: image for use in machine agnostic wic test cases

# /boot is intentionally an empty partition
part /boot --ondisk sda --label boot --active --align 1024 --size 16
part / --source rootfs --ondisk sda --fstype=ext4 --label platform --align 1024 --use-uuid

# bootloader is intentionally left out
```

## upstream-layers/openembedded-core/meta/conf/distro/defaultsetup.conf
```bitbake
include conf/distro/include/default-providers.inc
include conf/distro/include/default-distrovars.inc
include_all conf/distro/include/maintainers.inc
include conf/distro/include/time64.inc
require conf/distro/include/tcmode-${TCMODE}.inc
require conf/distro/include/tclibc-${TCLIBC}.inc

require conf/distro/include/no-static-libs.inc
require conf/distro/include/security_flags.inc
require conf/distro/include/yocto-space-optimize.inc

require conf/distro/include/uninative-flags.inc
require conf/distro/include/yocto-uninative.inc

USER_CLASSES ?= ""
PACKAGE_CLASSES ?= "package_ipk"
INHERIT_DISTRO ?= "debian devshell sstate license remove-libtool create-spdx buildstats uninative"
INHERIT += "${PACKAGE_CLASSES} ${USER_CLASSES} ${INHERIT_DISTRO}"

INIT_MANAGER ??= "systemd"
require conf/distro/include/init-manager-${INIT_MANAGER}.inc
```

## upstream-layers/openembedded-core/meta/conf/distro/include/init-manager-mdev-busybox.inc
```bitbake
# enable mdev/busybox for init
VIRTUAL-RUNTIME_dev_manager ??= "busybox-mdev"
VIRTUAL-RUNTIME_init_manager ??= "busybox"
VIRTUAL-RUNTIME_initscripts ??= "initscripts"
VIRTUAL-RUNTIME_login_manager ??= "busybox"
```

## upstream-layers/openembedded-core/meta/conf/distro/include/init-manager-none.inc
```bitbake
VIRTUAL-RUNTIME_init_manager ??= "sysvinit"
VIRTUAL-RUNTIME_initscripts ??= "initscripts"
VIRTUAL-RUNTIME_login_manager ??= "busybox"
VIRTUAL-RUNTIME_dev_manager ??= "udev"
```

## upstream-layers/openembedded-core/meta/conf/distro/include/init-manager-systemd.inc
```bitbake
# Use systemd for system initialization
DISTRO_FEATURES:append = " systemd usrmerge"
VIRTUAL-RUNTIME_init_manager ??= "systemd"
VIRTUAL-RUNTIME_initscripts ??= ""
VIRTUAL-RUNTIME_login_manager ??= "shadow-base"
VIRTUAL-RUNTIME_dev_manager ??= "systemd"
# systemd hardcodes /root in its source codes, other values are not offically supported
ROOT_HOME ?= "/root"
```

## upstream-layers/openembedded-core/meta/conf/distro/include/init-manager-sysvinit.inc
```bitbake
# Use sysvinit for system initialization
DISTRO_FEATURES:append = " sysvinit"
VIRTUAL-RUNTIME_init_manager ??= "sysvinit"
VIRTUAL-RUNTIME_initscripts ??= "initscripts"
VIRTUAL-RUNTIME_login_manager ??= "busybox"
VIRTUAL-RUNTIME_dev_manager ??= "udev"
```

## upstream-layers/openembedded-core/meta/conf/distro/include/ptest-packagelists.inc
```bitbake
#
# Lists of the ptests in OE-Core, sorted into two sets by the time they take
#
# ptests which take less than ~30s each
#
PTESTS_FAST = "\
    acl \
    apr-util \
    attr \
    babeltrace2 \
    bc \
    bluez5 \
    busybox \
    cpio \
    diffstat \
    diffutils \
    ethtool \
    expat \
    expect \
    findutils \
    flex \
    fmt \
    gawk \
    gdbm \
    gdk-pixbuf \
    glib-networking \
    gzip \
    icu \
    json-c \
    json-glib \
    libarchive \
    libassuan \
    libcheck \
    libconfig \
    libconvert-asn1-perl \
    libexif \
    libgpg-error\
    libksba \
    libmd \
    libnl \
    libpcre \
    libpcre2 \
    librsvg \
    libsolv \
    libssh2 \
    libtest-fatal-perl \
    libtest-needs-perl \
    libtest-warnings-perl \
    libtimedate-perl \
    libtry-tiny-perl \
    libusb1 \
    libxml-namespacesupport-perl \
    libxml-parser-perl \
    libxml-perl \
    libxml-sax-base-perl \
    libxml-sax-perl \
    libxml-simple-perl \
    libxml2 \
    libxmlb \
    libyaml \
    logrotate \
    lua \
    lzo \
    m4 \
    nettle \
    opkg \
    popt \
    procps \
    python3-atomicwrites \
    python3-attrs \
    python3-bcrypt \
    python3-calver \
    python3-hypothesis \
    python3-idna \
    python3-jinja2 \
    python3-jsonpointer \
    python3-libarchive-c \
    python3-license-expression \
    python3-mako \
    python3-markupsafe \
    python3-more-itertools \
    python3-packaging \
    python3-pluggy \
    python3-pefile \
    python3-pyasn1 \
    python3-pytz \
    python3-pyyaml \
    python3-rpds-py \
    python3-trove-classifiers \
    python3-vcs-versioning \
    python3-uritools \
    python3-wcwidth \
    python3-webcolors \
    python3-wheel \
    qemu \
    quilt \
    rpm-sequoia \
    sed \
    slang \
    utfcpp \
    wayland \
    xz \
    zlib \
"
PTESTS_FAST:remove:mips64 = "qemu"
PTESTS_PROBLEMS:append:mips64 = " qemu"
PTESTS_FAST:remove:riscv32 = "qemu"
PTESTS_PROBLEMS:append:riscv32 = " qemu"
PTESTS_FAST:remove:libc-musl = "procps"

PTESTS_SLOW = "\
    apr \
    bzip2 \
    coreutils \
    curl \
    dbus \
    dosfstools \
    dpkg \
    e2fsprogs \
    elfutils \
    gettext \
    glib-2.0 \
    gnutls \
    go \
    gstreamer1.0 \
    less \
    libevent \
    libgcrypt \
    libmodule-build-perl \
    libpng \
    ${@bb.utils.contains('DISTRO_FEATURES', 'seccomp', 'libseccomp', '',d)} \
    lttng-tools \
    lz4 \
    openssh \
    openssl \
    parted \
    perl \
    python3 \
    python3-cffi \
    python3-click \
    python3-cryptography \
    python3-numpy \
    python3-xmltodict \
    strace \
    tar \
    tcl \
    tcl8 \
    util-linux \
"

# python3 ptests hang on qemuriscv64
PTESTS_SLOW:remove:riscv64 = "python3"
PTESTS_PROBLEMS:append:riscv64 = " python3"
PTESTS_SLOW:remove:riscv32 = "lttng-tools strace "
PTESTS_PROBLEMS:append:riscv32 = " lttng-tools strace"
PTESTS_SLOW:append:libc-musl = " libc-test"

# These tests don't yet pass for riscv64
PTESTS_SLOW:remove:riscv64 = "tcl tcl8 python3-cffi strace lttng-tools python3-numpy perl"
PTESTS_PROBLEMS:append:riscv64 = " tcl tcl8 python3-cffi strace lttng-tools python3-numpy perl"

# These tests don't yet pass for musl qemuarm64
PTESTS_SLOW:remove:libc-musl:qemuarm64 = "strace perl gnutls glib-2.0"
PTESTS_FAST:remove:libc-musl:qemuarm64 = "libarchive"
PTESTS_PROBLEMS:append:libc-musl:qemuarm64 = " strace perl gnutls glib-2.0 libarchive"
# These tests don't yet pass for musl qemux86-64
PTESTS_SLOW:remove:libc-musl:qemux86-64 = "perl gnutls"
PTESTS_FAST:remove:libc-musl:qemux86-64 = "libarchive"
PTESTS_PROBLEMS:append:libc-musl:qemux86-64 = " perl gnutls libarchive"

#    ruby \ # Timeout
#    rt-tests \ # Needs to be checked whether it runs at all
#    bash \ # Test outcomes are non-deterministic by design
#    ifupdown \ # Tested separately in lib/oeqa/selftest/cases/imagefeatures.py
#    libinput \ # Tests need an unloaded system to be reliable
#    libpam \ # Needs pam DISTRO_FEATURE
#    mdadm \ # tests are flaky in AB.
#    numactl \ # qemu not (yet) configured for numa; all tests are skipped

PTESTS_PROBLEMS = "\
    ruby \
    rt-tests \
    bash \
    ifupdown \
    libinput \
    libpam \
    mdadm \
    numactl \
    python3-license-expression \
"
```
