## upstream-layers/openembedded-core/meta/conf/machine/include/riscv/arch-riscv.inc
```bitbake
# RISCV Architecture definition

# Based on the RISC-V Instruction Set Manual Volume I: Unprivileged ISA from May 2025
# As well as the RISC-V options for using GCC (as of June 2025)

# Note: the following should be implemented in the order that GCC expects
# -march= values to be defined in.

# Base ISA
# All supported march strings must start with rv32 or rv64
TUNEVALID[rv] = "RISC-V"
TUNE_RISCV_ARCH = "${@bb.utils.contains("TUNE_FEATURES", "rv", "riscv", "", d)}"
TUNE_RISCV_MARCH = "${@bb.utils.contains("TUNE_FEATURES", "rv", "rv", "", d)}"
TUNE_RISCV_ABI = ""

# There are two primary ABIs, ilp32 and lp64
# There are variants of both, that appears to be based on extensions above
# For example:
#   rv32i uses ilp32, rv32e uses ilp32e, rv32f uses ilp32f
#   rv64i uses lp64, rv64if uses lp64f, rv64id uses lp64d
TUNEVALID[32] = "ISA XLEN - 32-bit"
TUNECONFLICTS[32] = "64"
TUNE_RISCV_ARCH .= "${@bb.utils.contains("TUNE_FEATURES", "32", "32", "", d)}"
TUNE_RISCV_MARCH .= "${@bb.utils.contains("TUNE_FEATURES", "32", "32", "", d)}"
TUNE_RISCV_ABI .= "${@bb.utils.contains("TUNE_FEATURES", "32", "ilp32", "", d)}"

TUNEVALID[64] = "ISA XLEN - 64-bit"
TUNECONFLICTS[64] = "32"
TUNE_RISCV_MARCH .= "${@bb.utils.contains("TUNE_FEATURES", "64", "64", "", d)}"
TUNE_RISCV_ARCH .= "${@bb.utils.contains("TUNE_FEATURES", "64", "64", "", d)}"
TUNE_RISCV_ABI .= "${@bb.utils.contains("TUNE_FEATURES", "64", "lp64", "", d)}"

# The package arch starts with the canonical arch, but adds some extensions to make
# package compatibility clear
TUNE_RISCV_PKGARCH = "${TUNE_RISCV_ARCH}"

# i, e, or g are defined by gcc, but 'g' refers to 'i' + extensions 'MAFD Zicsr Zifencei'
# So 'g' will not be defined here as it is an abbreviation of the expanded version
TUNEVALID[e] = "Reduced register base integer extension"
TUNECONFLICTS[e] = "i"
TUNE_RISCV_MARCH .= "${@bb.utils.contains("TUNE_FEATURES", "e", "e", "", d)}"
TUNE_RISCV_ABI .= "${@bb.utils.contains("TUNE_FEATURES", "e", "e", "", d)}"
TUNE_RISCV_PKGARCH .= "${@bb.utils.contains("TUNE_FEATURES", "e", "e", "", d)}"

TUNEVALID[i] = "Base integer extension"
TUNECONFLICTS[i] = "e"
TUNE_RISCV_MARCH .= "${@bb.utils.contains("TUNE_FEATURES", "i", "i", "", d)}"
TUNE_RISCV_PKGARCH .= "${@bb.utils.contains("TUNE_FEATURES", "i", "i", "", d)}"

# Extensions
TUNEVALID[m] = "Integer multiplication and division extension"
TUNE_RISCV_MARCH .= "${@bb.utils.contains("TUNE_FEATURES", "m", "m", "", d)}"
TUNE_RISCV_PKGARCH .= "${@bb.utils.contains("TUNE_FEATURES", "m", "m", "", d)}"

TUNEVALID[a] = "Atomic extension"
TUNE_RISCV_MARCH .= "${@bb.utils.contains("TUNE_FEATURES", "a", "a", "", d)}"
TUNE_RISCV_PKGARCH .= "${@bb.utils.contains("TUNE_FEATURES", "a", "a", "", d)}"

TUNEVALID[f] = "Single-precision floating-point extension"
TUNE_RISCV_MARCH .= "${@bb.utils.contains_any("TUNE_FEATURES", "f d", "f", "", d)}"
TUNE_RISCV_PKGARCH .= "${@bb.utils.contains_any("TUNE_FEATURES", "f d", "f", "", d)}"

TUNEVALID[d] = "Double-precision floating-point extension"
TUNE_RISCV_MARCH .= "${@bb.utils.contains("TUNE_FEATURES", "d", "d", "", d)}"
TUNE_RISCV_PKGARCH .= "${@bb.utils.contains("TUNE_FEATURES", "d", "d", "", d)}"

# Only f OR d, but just one
TUNE_RISCV_ABI .= "${@bb.utils.contains("TUNE_FEATURES", "d", "d", bb.utils.contains("TUNE_FEATURES", "f", "f", "", d), d)}"

TUNEVALID[c] = "Compressed extension"
TUNE_RISCV_MARCH .= "${@bb.utils.contains("TUNE_FEATURES", "c", "c", "", d)}"
TUNE_RISCV_PKGARCH .= "${@bb.utils.contains("TUNE_FEATURES", "c", "c", "", d)}"

TUNEVALID[b] = "Bit Manipulation extension"
# Handled below via zba, zbb, zbs
# This matches current Linux kernel behavior
#TUNE_RISCV_MARCH .= "${@bb.utils.contains("TUNE_FEATURES", "b", "b", "", d)}"
#TUNE_RISCV_PKGARCH .= "${@bb.utils.contains("TUNE_FEATURES", "b", "b", "", d)}"

TUNEVALID[v] = "Vector operations extension"
TUNE_RISCV_MARCH .= "${@bb.utils.contains("TUNE_FEATURES", "v", "v", "", d)}"
TUNE_RISCV_PKGARCH .= "${@bb.utils.contains("TUNE_FEATURES", "v", "v", "", d)}"

# Now the special Z extensions
TUNEVALID[zicbom] = "Cache-block management extension"
TUNE_RISCV_MARCH .= "${@bb.utils.contains_any("TUNE_FEATURES", "zicbom", "_zicbom", "", d)}"
TUNE_RISCV_PKGARCH .= "${@bb.utils.contains_any("TUNE_FEATURES", "zicbom", "_zicbom", "", d)}"

TUNEVALID[zicsr] = "Control and status register access extension"
TUNE_RISCV_MARCH .= "${@bb.utils.contains_any("TUNE_FEATURES", "zicsr f d", "_zicsr", "", d)}"
# If zicsr (or zifencei) is in the path, OpenSBI fails to use the extensions, do to (Makefile):
#   # Check whether the assembler and the compiler support the Zicsr and Zifencei extensions
#   CC_SUPPORT_ZICSR_ZIFENCEI := $(shell $(CC) $(CLANG_TARGET) $(RELAX_FLAG) -nostdlib -march=rv$(OPENSBI_CC_XLEN)imafd_zicsr_zifencei -x c /dev/null -o /dev/null 2>&1 | grep -e "zicsr" -e "zifencei" > /dev/null && echo n || echo y)
# this will match on the path containing zicsr or zifencei when an error is reported, which
# will always happens in this check.
#
# Yocto Project Bugzilla 15897
#
#TUNE_RISCV_PKGARCH .= "${@bb.utils.contains_any("TUNE_FEATURES", "zicsr f d", "_zicsr", "", d)}"

TUNEVALID[zifencei] = "Instruction-fetch fence extension"
TUNE_RISCV_MARCH .= "${@bb.utils.contains("TUNE_FEATURES", "zifencei", "_zifencei", "", d)}"
# See above Bug 15897
#TUNE_RISCV_PKGARCH .= "${@bb.utils.contains("TUNE_FEATURES", "zifencei", "_zifencei", "", d)}"

TUNEVALID[zba] = "Address bit manipulation extension"
TUNE_RISCV_MARCH .= "${@bb.utils.contains_any("TUNE_FEATURES", "b zba", "_zba", "", d)}"
TUNE_RISCV_PKGARCH .= "${@bb.utils.contains_any("TUNE_FEATURES", "b zba", "_zba", "", d)}"

TUNEVALID[zbb] = "Basic bit manipulation extension"
TUNE_RISCV_MARCH .= "${@bb.utils.contains_any("TUNE_FEATURES", "b zbb", "_zbb", "", d)}"
TUNE_RISCV_PKGARCH .= "${@bb.utils.contains_any("TUNE_FEATURES", "b zbb", "_zbb", "", d)}"

TUNEVALID[zbc] = "Carry-less multiplication extension"
TUNE_RISCV_MARCH .= "${@bb.utils.contains_any("TUNE_FEATURES", "zbc", "_zbc", "", d)}"
TUNE_RISCV_PKGARCH .= "${@bb.utils.contains_any("TUNE_FEATURES", "zbc", "_zbc", "", d)}"

TUNEVALID[zbs] = "Single-bit manipulation extension"
TUNE_RISCV_MARCH .= "${@bb.utils.contains_any("TUNE_FEATURES", "b zbs", "_zbs", "", d)}"
TUNE_RISCV_PKGARCH .= "${@bb.utils.contains_any("TUNE_FEATURES", "b zbs", "_zbs", "", d)}"

# Construct TUNE_CCARGS
# This should result in a CCARG similar to:
#   -march=rv32imac -mabi=ilp32
TUNE_CCARGS = "${@ '-march=${TUNE_RISCV_MARCH} -mabi=${TUNE_RISCV_ABI}' if not d.getVar('TUNE_CCARGS:tune-${DEFAULTTUNE}') else 'TUNE_CCARGS:tune-${DEFAULTTUNE}'}"

# Construct TUNE_ARCH
# This should result in an arch string similar to:
#   riscv32
TUNE_ARCH = "${TUNE_RISCV_ARCH}"

# Construct TUNE_PKGARCH
# This should result in a package are like:
#    riscv32imac
TUNE_PKGARCH = "${TUNE_RISCV_PKGARCH}"

# Misc settings
# Fix: ld: unrecognized option '--hash-style=sysv'
LINKER_HASH_STYLE:libc-newlib = ""
LINKER_HASH_STYLE:libc-picolibc = ""
# Fix: ld: unrecognized option '--hash-style=gnu'
LINKER_HASH_STYLE:libc-baremetal = ""
```

## upstream-layers/openembedded-core/meta/conf/machine/include/riscv/tune-riscv.inc
```bitbake
require conf/machine/include/riscv/arch-riscv.inc

DEFAULTTUNE ?= "riscv64"

AVAILTUNES += "riscv64 riscv32 riscv64nc riscv64nf riscv32nf"

# Default
TUNE_FEATURES:tune-riscv64 := "${@oe.tune.riscv_isa_to_tune("rv64gc")}"
PACKAGE_EXTRA_ARCHS:tune-riscv64 = "${TUNE_RISCV_PKGARCH}"

TUNE_FEATURES:tune-riscv32 := "${@oe.tune.riscv_isa_to_tune("rv32gc")}"
PACKAGE_EXTRA_ARCHS:tune-riscv32 = "${TUNE_RISCV_PKGARCH}"

# No float
TUNE_FEATURES:tune-riscv64nf := "${@oe.tune.riscv_isa_to_tune("rv64imac_zicsr_zifencei")}"
PACKAGE_EXTRA_ARCHS:tune-riscv64nf = "${TUNE_RISCV_PKGARCH}"

TUNE_FEATURES:tune-riscv32nf := "${@oe.tune.riscv_isa_to_tune("rv32imac_zicsr_zifencei")}"
PACKAGE_EXTRA_ARCHS:tune-riscv32nf = "${TUNE_RISCV_PKGARCH}"

# no compressed
TUNE_FEATURES:tune-riscv64nc := "${@oe.tune.riscv_isa_to_tune("rv64imafd_zicsr_zifencei")}"
PACKAGE_EXTRA_ARCHS:tune-riscv64nc = "${TUNE_RISCV_PKGARCH}"
```

## upstream-layers/openembedded-core/meta/conf/machine/include/soc-family.inc
```bitbake
# Add SOC_FAMILY to machine overrides so we get access to e.g. 'omap3' and 'ti335x'
SOC_FAMILY ??= ""
MACHINEOVERRIDES =. "${@['', '${SOC_FAMILY}:']['${SOC_FAMILY}' != '']}"
```

## upstream-layers/openembedded-core/meta/conf/machine/include/x86/tune-atom.inc
```bitbake
# Atom tunings are the same as core2 for now...
require conf/machine/include/x86/tune-core2.inc
```

## upstream-layers/openembedded-core/meta/conf/machine/include/x86/tune-i686.inc
```bitbake
#
# The i686 CPU family was introduced with the Intel Pentium Pro in 1995.
# It has as required feature flags: fpu tsc cx8 cmov.
#
# It is the minimum CPU required by the Debian i386 port.
# https://lists.debian.org/debian-devel-announce/2016/05/msg00001.html
#
#

DEFAULTTUNE ?= "i686"

# Set x86 target arch to i686, so that glibc enables SSE optimised memcpy, etc.
X86ARCH32 ?= "i686"

# Include the previous tune to pull in PACKAGE_EXTRA_ARCHS
require conf/machine/include/x86/tune-i586.inc

# Extra tune features
TUNEVALID[i686] = "Enable i686 specific processor optimizations"
TUNE_CCARGS .= "${@bb.utils.contains('TUNE_FEATURES', 'i686', ' -march=i686', '', d)}"

# Extra tune selections
AVAILTUNES += "i686"
TUNE_FEATURES:tune-i686 = "${TUNE_FEATURES:tune-x86} i686"
BASE_LIB:tune-i686 = "lib"
TUNE_PKGARCH:tune-i686 = "i686"
PACKAGE_EXTRA_ARCHS:tune-i686 = "${PACKAGE_EXTRA_ARCHS:tune-i586} i686"
```

## upstream-layers/openembedded-core/meta/conf/machine/include/x86/tune-x86-64-v3.inc
```bitbake
# Settings for the GCC(1) cpu-type "x86-64-v3":
#
#     CPUs with AVX, AVX2, BMI1, BMI2, F16C, FMA, LZCNT, MOVBE, XSAVE.
#     (but not AVX512).
#     See https://www.phoronix.com/news/GCC-11-x86-64-Feature-Levels for details.
#
# This tune is recommended for Intel Haswell/AMD Excavator CPUs (and later).
#
DEFAULTTUNE ?= "x86-64-v3"

# Include the previous tune to pull in PACKAGE_EXTRA_ARCHS
require conf/machine/include/x86/tune-corei7.inc

# Extra tune features
TUNEVALID[x86-64-v3] = "Enable x86-64-v3 specific processor optimizations"
TUNE_CCARGS .= "${@bb.utils.contains('TUNE_FEATURES', 'x86-64-v3', ' -march=x86-64-v3', '', d)}"

# Extra tune selections
AVAILTUNES += "x86-64-v3"
TUNE_FEATURES:tune-x86-64-v3 = "${TUNE_FEATURES:tune-x86-64} x86-64-v3"
BASE_LIB:tune-x86-64-v3 = "lib64"
TUNE_PKGARCH:tune-x86-64-v3 = "x86-64-v3"
PACKAGE_EXTRA_ARCHS:tune-x86-64-v3 = "${PACKAGE_EXTRA_ARCHS:tune-corei7-64} x86-64-v3"
QEMU_EXTRAOPTIONS:tune-x86-64-v3 = " -cpu Skylake-Client,check=false"

AVAILTUNES += "x86-64-v3-x32"
TUNE_FEATURES:tune-x86-64-v3-x32 = "${TUNE_FEATURES:tune-x86-64-x32} x86-64-v3"
BASE_LIB:tune-x86-64-v3-x32 = "libx32"
TUNE_PKGARCH:tune-x86-64-v3-x32 = "x86-64-v3-x32"
PACKAGE_EXTRA_ARCHS:tune-x86-64-v3-x32 = "${PACKAGE_EXTRA_ARCHS:tune-corei7-64-x32} x86-64-v3-x32"
QEMU_EXTRAOPTIONS:tune-x86-64-v3-x32 = " -cpu Skylake-Client,check=false"
```

## upstream-layers/openembedded-core/meta/conf/machine/include/x86/x86-base.inc
```bitbake
#
# Base machine settings for X86 architecture BSPs
#

#
# common settings for X86 machines
#
MACHINE_FEATURES += "screen keyboard pci usbhost ext2 ext3 x86 \
                     acpi serial usbgadget alsa"

IMAGE_FSTYPES ?= "wic"

KERNEL_IMAGETYPE ?= "bzImage"

SERIAL_CONSOLES ?= "115200;ttyS0"

#
# kernel-related variables
#
PREFERRED_PROVIDER_virtual/kernel ??= "linux-yocto"

#
# XSERVER subcomponents, used to build the XSERVER variable
#
XSERVER_X86_BASE = "xserver-xorg \
           "

XSERVER_X86_EXT = " \
           ${@bb.utils.contains('DISTRO_FEATURES', 'opengl', 'xserver-xorg-extension-glx', '', d)} \
           xserver-xorg-module-libint10 \
           "

XSERVER_X86_I915 = "xf86-video-intel \
           ${@bb.utils.contains('DISTRO_FEATURES', 'opengl', 'mesa-driver-i915', '', d)} \
           "

XSERVER_X86_I965 = "xf86-video-intel \
           ${@bb.utils.contains('DISTRO_FEATURES', 'opengl', 'mesa-driver-crocus', '', d)} \
           "

XSERVER_X86_VESA = "xf86-video-vesa"

XSERVER_X86_FBDEV = "xf86-video-fbdev"

XSERVER_X86_MODESETTING = "xf86-video-modesetting"
```

## upstream-layers/openembedded-core/meta/conf/machine/qemuarmv5.conf
```bitbake
#@TYPE: Machine
#@NAME: QEMU ARM9 machine
#@DESCRIPTION: Machine configuration for running an ARMv5 system on QEMU

require conf/machine/include/qemu.inc
require conf/machine/include/arm/armv5/tune-arm926ejs.inc

KERNEL_IMAGETYPE = "zImage"

SERIAL_CONSOLES ?= "115200;ttyAMA0 115200;ttyAMA1"

# For runqemu
QB_SYSTEM_NAME = "qemu-system-arm"
QB_MACHINE = "-machine versatilepb"
QB_GRAPHICS = "-device virtio-gpu-pci"
QB_OPT_APPEND = "-device qemu-xhci -device usb-tablet -device usb-kbd"
QB_DTB ?= "zImage-versatile-pb.dtb"

KMACHINE:qemuarmv5 = "arm-versatile-926ejs"
```

## upstream-layers/openembedded-core/meta/conf/machine/qemumips.conf
```bitbake
#@TYPE: Machine
#@NAME: QEMU MIPS32 machine
#@DESCRIPTION: Machine configuration for running a MIPS system on QEMU

require conf/machine/include/qemu.inc
require conf/machine/include/mips/tune-mips32r2.inc
require conf/machine/include/mips/qemuboot-mips.inc

KERNEL_IMAGETYPE = "vmlinux"
KERNEL_ALT_IMAGETYPE = "vmlinux.bin"

UBOOT_MACHINE ?= "malta_defconfig"

SERIAL_CONSOLES ?= "115200;ttyS0 115200;ttyS1"

QB_SYSTEM_NAME = "qemu-system-mips"

QB_CPU = "-cpu 34Kf"
```

## upstream-layers/openembedded-core/meta/conf/machine/qemuppc.conf
```bitbake
#@TYPE: Machine
#@NAME: QEMU PPC machine
#@DESCRIPTION: Machine configuration for running a PPC system on QEMU

require conf/machine/include/qemu.inc
require conf/machine/include/powerpc/tune-ppc7400.inc

TARGET_CC_KERNEL_ARCH = "-mno-spe"

KERNEL_IMAGETYPE = "vmlinux"

SERIAL_CONSOLES ?= "115200;ttyS0 115200;ttyS1"

# For runqemu
QB_SYSTEM_NAME = "qemu-system-ppc"
QB_MACHINE = "-machine mac99"
QB_CPU = "-cpu G4"
QB_KERNEL_CMDLINE_APPEND = "console=tty console=ttyS0"
QB_OPT_APPEND = "-usb -device usb-tablet"
QB_TAP_OPT = "-netdev tap,id=net0,ifname=@TAP@,script=no,downscript=no"
```

## upstream-layers/openembedded-core/meta/files/wic/qemuriscv.wks
```
# short-description: Create qcow2 image for RISC-V QEMU machines

part / --source rootfs --fstype=ext4 --label root --align 4096 --size 5G
```
