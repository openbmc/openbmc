## upstream-layers/openembedded-core/meta/conf/machine/include/loongarch/arch-loongarch.inc
```bitbake
# LoongArch Architecture definition

DEFAULTTUNE ?= "loongarch64"

TUNE_ARCH = "${TUNE_ARCH:tune-${DEFAULTTUNE}}"
TUNE_PKGARCH = "${TUNE_PKGARCH:tune-${DEFAULTTUNE}}"
TUNE_CCARGS:append = "${@bb.utils.contains('TUNE_FEATURES', 'loongarch64', ' -march=loongarch64 -mabi=lp64d', ' ', d)}"
```

## upstream-layers/openembedded-core/meta/conf/machine/include/loongarch/qemuloongarch.inc
```bitbake
PREFERRED_PROVIDER_virtual/bootloader ?= "u-boot"

require conf/machine/include/qemu.inc
require conf/machine/include/loongarch/tune-loongarch.inc

MACHINE_FEATURES = "screen keyboard ext2 ext3 serial"

KERNEL_IMAGETYPE = "vmlinuz"
KERNEL_IMAGETYPES += "vmlinuz"
KEEPUIMAGE = "no"

SERIAL_CONSOLES ?= "115200;ttyS0 115200;hvc0"

IMAGE_FSTYPES += "ext4 wic.qcow2"

WKS_FILE ?= "qemuloongarch.wks"

MACHINE_EXTRA_RRECOMMENDS += " kernel-modules"

#EXTRA_IMAGEDEPENDS += "opensbi"

UBOOT_ENTRYPOINT_loongarch32 = "0x80400000"
UBOOT_ENTRYPOINT_loongarch64 = "0x80200000"

# qemuboot options
QB_KERNEL_CMDLINE_APPEND = "earlycon=sbi"
QB_MACHINE = "-machine virt"
QB_DEFAULT_BIOS = "fw_jump.elf"
QB_TAP_OPT = "-netdev tap,id=net0,ifname=@TAP@,script=no,downscript=no"
QB_NETWORK_DEVICE = "-device virtio-net-device,netdev=net0,mac=@MAC@"
QB_ROOTFS_OPT = "-drive id=disk0,file=@ROOTFS@,if=none,format=raw -device virtio-blk-device,drive=disk0"
QB_SERIAL_OPT = "-device virtio-serial-pci -chardev null,id=virtcon -device virtconsole,chardev=virtcon"
QB_TCPSERIAL_OPT = " -device virtio-serial-pci -chardev socket,id=virtcon,port=@PORT@,host=127.0.0.1,nodelay=on -device virtconsole,chardev=virtcon"
# Add the 'virtio-rng-pci' device otherwise the guest may run out of entropy
QB_OPT_APPEND = " -object rng-random,filename=/dev/urandom,id=rng0 -device virtio-rng-device,rng=rng0"
```

## upstream-layers/openembedded-core/meta/conf/machine/include/loongarch/tune-loongarch.inc
```bitbake
require conf/machine/include/loongarch/arch-loongarch.inc

TUNEVALID[loongarch64] = "Enable 64-bit LoongArch optimizations"

TUNEVALID[littleendian] = "Little endian mode"

AVAILTUNES += "loongarch64"

# Default
TUNE_FEATURES:tune-loongarch64 = "loongarch64"
TUNE_ARCH:tune-loongarch64 = "loongarch64"
TUNE_PKGARCH:tune-loongarch64 = "loongarch64"
PACKAGE_EXTRA_ARCHS:tune-loongarch64 = "loongarch64"
```

## upstream-layers/openembedded-core/meta/conf/machine/include/microblaze/tune-microblaze.inc
```bitbake
DEFAULTTUNE ?= "microblaze"

require conf/machine/include/microblaze/arch-microblaze.inc

AVAILTUNES += "microblaze"
TUNE_FEATURES:tune-microblaze = "microblaze"
PACKAGE_EXTRA_ARCHS:tune-microblaze = "${TUNE_PKGARCH}"
```

## upstream-layers/openembedded-core/meta/conf/machine/include/mips/feature-mips-mips16e.inc
```bitbake
TUNEVALID[mips16e] = "Build target packages with MIPS16e ASE instructions"
MIPS_MIPS16E_OPT = "${@['mno-mips16', 'mips16'][d.getVar('MIPS_INSTRUCTION_SET') == 'mips16e']}"
TUNE_CCARGS .= "${@bb.utils.contains('TUNE_FEATURES', 'mips16e', ' -${MIPS_MIPS16E_OPT}', '', d)}"

MIPSPKGSFX_MIPS16E .= "${@bb.utils.contains('TUNE_FEATURES', 'mips16e', '-m16', '', d) if d.getVar('MIPS_MIPS16E_OPT') == 'mips16' else ''}"

# Whether to compile with code to allow interworking between the two
# instruction sets. This allows mips16e code to be executed on a primarily
# mips32/64 system and vice versa. It is strongly recommended that DISTROs not
# turn this off - the actual cost is very small.
TUNEVALID[no-interlink-compressed] = "Disable mixing of standard and MIPS16e code"
MIPS16_TUNE_CCARGS .= "${@bb.utils.contains('TUNE_FEATURES', 'no-interlink-compressed', ' -mno-interlink-compressed', ' -minterlink-compressed', d)}"
TUNE_CCARGS .= "${@bb.utils.contains('TUNE_FEATURES', 'mips16e', ' ${MIPS16_TUNE_CCARGS}', '', d)}"
MACHINEOVERRIDES =. "${@bb.utils.contains('TUNE_FEATURES', 'mips16e', 'mips16e:', '', d)}"

# show status (if compiling in MIPS16e mode)
BUILDCFG_VARS += "${@['', 'MIPS_INSTRUCTION_SET'][d.getVar('MIPS_INSTRUCTION_SET') == 'mips16e']}"
```

## upstream-layers/openembedded-core/meta/conf/machine/include/mips/tune-mips64r6.inc
```bitbake
DEFAULTTUNE ?= "mipsisa64r6el"

require conf/machine/include/mips/arch-mips.inc

TUNEVALID[mipsisa64r6] = "Enable mipsisa64r6 specific processor optimizations"
TUNE_CCARGS .= "${@bb.utils.contains('TUNE_FEATURES', 'mipsisa64r6', ' -march=mips64r6', '', d)}"

# Base Tunes
AVAILTUNES += "mipsisa64r6 mipsisa64r6el"

TUNE_FEATURES:tune-mipsisa64r6 = "bigendian fpu-hard n64 mipsisa64r6 r6"
MIPSPKGSFX_VARIANT:tune-mipsisa64r6 = "${TUNE_ARCH}"
BASE_LIB:tune-mipsisa64r6 = "lib64"
PACKAGE_EXTRA_ARCHS:tune-mipsisa64r6 = "mipsisa64r6"

TUNE_FEATURES:tune-mipsisa64r6el = "fpu-hard r6 n64 mipsisa64r6"
MIPSPKGSFX_VARIANT:tune-mipsisa64r6el = "${TUNE_ARCH}"
BASE_LIB:tune-mipsisa64r6el = "lib64"
PACKAGE_EXTRA_ARCHS:tune-mipsisa64r6el = "mipsisa64r6el"

# Soft Float
AVAILTUNES += "mipsisa64r6-nf mipsisa64r6el-nf"

TUNE_FEATURES:tune-mipsisa64r6-nf = "bigendian r6 n64 mipsisa64r6"
MIPSPKGSFX_VARIANT:tune-mipsisa64r6-nf = "${TUNE_ARCH}"
BASE_LIB:tune-mipsisa64r6-nf = "lib64"
PACKAGE_EXTRA_ARCHS:tune-mipsisa64r6-nf = "mipsisa64r6-nf"

TUNE_FEATURES:tune-mipsisa64r6el-nf = "r6 n64 mipsisa64r6"
MIPSPKGSFX_VARIANT:tune-mipsisa64r6el-nf = "${TUNE_ARCH}"
BASE_LIB:tune-mipsisa64r6el-nf = "lib64"
PACKAGE_EXTRA_ARCHS:tune-mipsisa64r6el-nf = "mipsisa64r6el-nf"

# MIPS 64r6 n32
AVAILTUNES += "mipsisa64r6-n32 mipsisa64r6el-n32"

TUNE_FEATURES:tune-mipsisa64r6-n32 = "bigendian fpu-hard r6 n32 mipsisa64r6"
BASE_LIB:tune-mipsisa64r6-n32 = "lib32"
MIPSPKGSFX_VARIANT:tune-mipsisa64r6-n32 = "${TUNE_ARCH}"
PACKAGE_EXTRA_ARCHS:tune-mipsisa64r6-n32 = "mipsisa64r6-n32"

TUNE_FEATURES:tune-mipsisa64r6el-n32 = "fpu-hard r6 n32 mipsisa64r6"
BASE_LIB:tune-mipsisa64r6el-n32 = "lib32"
MIPSPKGSFX_VARIANT:tune-mipsisa64r6el-n32 = "${TUNE_ARCH}"
PACKAGE_EXTRA_ARCHS:tune-mipsisa64r6el-n32 = "mipsisa64r6el-n32"

# MIPS 64r6 n32 and Soft Float
AVAILTUNES += "mipsisa64r6-nf-n32 mipsisa64r6el-nf-n32"

TUNE_FEATURES:tune-mipsisa64r6-nf-n32 = "bigendian r6 n32 mipsisa64r6"
BASE_LIB:tune-mipsisa64r6-nf-n32 = "lib32"
MIPSPKGSFX_VARIANT:tune-mipsisa64r6-nf-n32 = "${TUNE_ARCH}"
PACKAGE_EXTRA_ARCHS:tune-mipsisa64r6-nf-n32 = "mipsisa64r6-nf-n32"

TUNE_FEATURES:tune-mipsisa64r6el-nf-n32 = "r6 n32 mipsisa64r6"
BASE_LIB:tune-mipsisa64r6el-nf-n32 = "lib32"
MIPSPKGSFX_VARIANT:tune-mipsisa64r6el-nf-n32 = "${TUNE_ARCH}"
PACKAGE_EXTRA_ARCHS:tune-mipsisa64r6el-nf-n32 = "mipsisa64r6el-nf-n32"
```

## upstream-layers/openembedded-core/meta/conf/machine/include/powerpc/tune-power8.inc
```bitbake
DEFAULTTUNE ?= "ppc64p8le"

require conf/machine/include/powerpc/arch-powerpc64.inc

TUNEVALID[power8] = "Enable IBM Power8 specific processor optimizations"
TUNE_CCARGS .= "${@bb.utils.contains('TUNE_FEATURES', 'power8', ' -mcpu=power8', '', d)}"

AVAILTUNES += "ppcp8 ppc64p8 ppcp8le ppc64p8le"

TUNE_FEATURES:tune-ppcp8 = "m32 fpu-hard power8 altivec bigendian"
BASE_LIB:tune-ppcp8 = "lib"
TUNE_PKGARCH:tune-ppcp8 = "ppcp8"
PACKAGE_EXTRA_ARCHS:tune-ppcp8 = "${PACKAGE_EXTRA_ARCHS:tune-powerpc} ppcp8"

TUNE_FEATURES:tune-ppc64p8 = "m64 fpu-hard power8 altivec bigendian"
BASE_LIB:tune-ppc64p8 = "lib64"
TUNE_PKGARCH:tune-ppc64p8 = "ppc64p8"
PACKAGE_EXTRA_ARCHS:tune-ppc64p8 = "${PACKAGE_EXTRA_ARCHS:tune-powerpc64} ppc64p8"

TUNE_FEATURES:tune-ppcp8le = "m32 fpu-hard power8 altivec"
BASE_LIB:tune-ppcp8le = "lib"
TUNE_PKGARCH:tune-ppcp8le = "ppcp8le"
PACKAGE_EXTRA_ARCHS:tune-ppcp8le = "${PACKAGE_EXTRA_ARCHS:tune-powerpcle} ppcp8le"

TUNE_FEATURES:tune-ppc64p8le = "m64 fpu-hard power8 altivec"
BASE_LIB:tune-ppc64p8le = "lib64"
TUNE_PKGARCH:tune-ppc64p8le = "ppc64p8le"
PACKAGE_EXTRA_ARCHS:tune-ppc64p8le = "${PACKAGE_EXTRA_ARCHS:tune-powerpc64le} ppc64p8le"

# glibc configure options to get power8 specific library
GLIBC_EXTRA_OECONF += "${@bb.utils.contains('TUNE_FEATURES', 'power8', '--with-cpu=power8', '', d)}"
```

## upstream-layers/openembedded-core/meta/conf/machine/include/powerpc/tune-ppc603e.inc
```bitbake
DEFAULTTUNE ?= "ppc603e"

require conf/machine/include/powerpc/arch-powerpc.inc

TUNEVALID[ppc603e] = "Enable ppc603e specific processor optimizations"
TUNE_CCARGS .= "${@bb.utils.contains('TUNE_FEATURES', 'ppc603e', ' -mcpu=603e', '', d)}"

AVAILTUNES += "ppc603e"
TUNE_FEATURES:tune-ppc603e = "m32 fpu-hard ppc603e bigendian"
TUNE_PKGARCH:tune-ppc603e = "ppc603e"
PACKAGE_EXTRA_ARCHS:tune-ppc603e = "${PACKAGE_EXTRA_ARCHS:tune-powerpc} ppc603e"
```

## upstream-layers/openembedded-core/meta/conf/machine/include/powerpc/tune-ppc7400.inc
```bitbake
DEFAULTTUNE ?= "ppc7400"

require conf/machine/include/powerpc/arch-powerpc.inc

TUNEVALID[ppc7400] = "Enable ppc7400 specific processor optimizations"
TUNE_CCARGS .= "${@bb.utils.contains('TUNE_FEATURES', 'ppc7400', ' -mcpu=7400 -mno-spe', '', d)}"

AVAILTUNES += "ppc7400"
TUNE_FEATURES:tune-ppc7400 = "m32 fpu-hard ppc7400 altivec bigendian"
TUNE_PKGARCH:tune-ppc7400 = "ppc7400"
PACKAGE_EXTRA_ARCHS:tune-ppc7400 = "${PACKAGE_EXTRA_ARCHS:tune-powerpc} ppc7400"
QEMU_EXTRAOPTIONS:tune-ppc7400 = " -cpu 7400"
```

## upstream-layers/openembedded-core/meta/conf/machine/include/powerpc/tune-ppce500v2.inc
```bitbake
DEFAULTTUNE ?= "ppce500v2"

require conf/machine/include/powerpc/arch-powerpc.inc

TUNEVALID[ppce500v2] = "Enable ppce500v2 specific processor optimizations"
TUNE_CCARGS .= "${@bb.utils.contains('TUNE_FEATURES', 'ppce500v2', ' -mcpu=8548', '', d)}"

TUNEVALID[spe] = "Enable SPE ABI extensions"
TUNE_CCARGS .= "${@bb.utils.contains('TUNE_FEATURES', [ 'ppce500v2', 'spe' ], ' -mabi=spe -mspe -mfloat-gprs=double', '', d)}"
TARGET_FPU .= "${@bb.utils.contains('TUNE_FEATURES', [ 'ppce500v2' , 'spe' ], 'ppc-efd', '', d)}"

# spe is defined potentially in two places, so we want to be sure it will
# only write spe once to the ABIEXTENSIONS field.
SPEABIEXTENSION = "${@bb.utils.filter('TUNE_FEATURES', 'spe', d)}"
ABIEXTENSION .= "${SPEABIEXTENSION}"

AVAILTUNES += "ppce500v2"
TUNE_FEATURES:tune-ppce500v2 = "m32 ppce500v2 bigendian"
TUNE_PKGARCH:tune-ppce500v2 = "ppce500v2"
PACKAGE_EXTRA_ARCHS:tune-ppce500v2 = "ppce500v2"
QEMU_EXTRAOPTIONS:tune-ppce500v2 = " -cpu e500v2"
```

## upstream-layers/openembedded-core/meta/conf/machine/include/powerpc/tune-ppce5500.inc
```bitbake
DEFAULTTUNE ?= "ppce5500"

require conf/machine/include/powerpc/arch-powerpc64.inc

TUNEVALID[e5500] = "Enable Freescale e5500 specific processor optimizations"
TUNE_CCARGS .= "${@bb.utils.contains('TUNE_FEATURES', 'e5500', ' -mcpu=e5500', '', d)}"

AVAILTUNES += "ppce5500 ppc64e5500"
TUNE_FEATURES:tune-ppce5500 = "m32 fpu-hard e5500 bigendian"
BASE_LIB:tune-ppce5500 = "lib"
TUNE_PKGARCH:tune-ppce5500 = "ppce5500"
PACKAGE_EXTRA_ARCHS:tune-ppce5500 = "${PACKAGE_EXTRA_ARCHS:tune-powerpc} ppce5500"
QEMU_EXTRAOPTIONS:tune-ppce5500 = " -cpu e500mc"

TUNE_FEATURES:tune-ppc64e5500 = "m64 fpu-hard e5500 bigendian"
BASE_LIB:tune-ppc64e5500 = "lib64"
TUNE_PKGARCH:tune-ppc64e5500 = "ppc64e5500"
PACKAGE_EXTRA_ARCHS:tune-ppc64e5500 = "${PACKAGE_EXTRA_ARCHS:tune-powerpc64} ppc64e5500"
QEMU_EXTRAOPTIONS:tune-ppc64e5500 = " -cpu e500mc"

# QEMU usermode fails with invalid instruction error (YOCTO: #10304)
MACHINE_FEATURES_BACKFILL_CONSIDERED:append = "${@bb.utils.contains('TUNE_FEATURES', 'e5500', ' qemu-usermode', '', d)}"
```

## upstream-layers/openembedded-core/meta/conf/machine/include/powerpc/tune-ppce6500.inc
```bitbake
DEFAULTTUNE ?= "ppce6500"

require conf/machine/include/powerpc/arch-powerpc64.inc

TUNEVALID[e6500] = "Enable Freescale e6500 specific processor optimizations"
TUNE_CCARGS .= "${@bb.utils.contains('TUNE_FEATURES', 'e6500', ' -mcpu=e6500', '', d)}"

AVAILTUNES += "ppce6500 ppc64e6500"
TUNE_FEATURES:tune-ppce6500 = "m32 fpu-hard e6500 altivec bigendian"
BASE_LIB:tune-ppce6500 = "lib"
TUNE_PKGARCH:tune-ppce6500 = "ppce6500"
PACKAGE_EXTRA_ARCHS:tune-ppce6500 = "${PACKAGE_EXTRA_ARCHS:tune-powerpc} ppce6500"
QEMU_EXTRAOPTIONS:tune-ppce6500 = " -cpu e500mc"

TUNE_FEATURES:tune-ppc64e6500 = "m64 fpu-hard e6500 altivec bigendian"
BASE_LIB:tune-ppc64e6500 = "lib64"
TUNE_PKGARCH:tune-ppc64e6500 = "ppc64e6500"
PACKAGE_EXTRA_ARCHS:tune-ppc64e6500 = "${PACKAGE_EXTRA_ARCHS:tune-powerpc64} ppc64e6500"
QEMU_EXTRAOPTIONS:tune-ppc64e6500 = " -cpu e500mc"

# QEMU usermode fails with invalid instruction error (YOCTO: #10304)
MACHINE_FEATURES_BACKFILL_CONSIDERED:append = "${@bb.utils.contains('TUNE_FEATURES', 'e6500', ' qemu-usermode', '', d)}"
```

## upstream-layers/openembedded-core/meta/conf/machine/include/qemu.inc
```bitbake
XSERVER ?= "xserver-xorg \
            ${@bb.utils.contains('DISTRO_FEATURES', 'opengl', 'mesa-driver-swrast xserver-xorg-extension-glx', '', d)} \
            xf86-video-fbdev \
            xf86-video-modesetting \
            "

MACHINE_FEATURES = "alsa bluetooth usbgadget screen vfat"

MACHINEOVERRIDES =. "qemuall:"

IMAGE_FSTYPES += "tar.bz2 ext4"

# Don't include kernels in standard images
RDEPENDS:${KERNEL_PACKAGE_NAME}-base = ""

# Use a common kernel recipe for all QEMU machines
PREFERRED_PROVIDER_virtual/kernel ??= "linux-yocto"

# Provide the nfs server kernel module for all qemu images
KERNEL_FEATURES:append:pn-linux-yocto = " features/nfsd/nfsd-enable.scc"
KERNEL_FEATURES:append:pn-linux-yocto-rt = " features/nfsd/nfsd-enable.scc"

IMAGE_CLASSES += "qemuboot"

# Use gnu tar so we can handle sparse files in testimage debug archives
MACHINE_ESSENTIAL_EXTRA_RDEPENDS += "tar"
```
