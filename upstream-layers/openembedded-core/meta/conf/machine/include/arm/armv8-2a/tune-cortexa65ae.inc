## upstream-layers/openembedded-core/meta/conf/machine/include/arm/armv8-2a/tune-cortexa65ae.inc
```bitbake
#
# Tune Settings for Cortex-A65AE
#
DEFAULTTUNE                                        ?= "cortexa65ae"

TUNEVALID[cortexa65ae] = "Enable Cortex-A65AE specific processor optimizations"
TUNE_CCARGS .= "${@bb.utils.contains('TUNE_FEATURES', 'cortexa65ae', ' -mcpu=cortex-a65ae', '', d)}"

require conf/machine/include/arm/arch-armv8-2a.inc

# Little Endian base configs
AVAILTUNES                                         += "cortexa65ae"
ARMPKGARCH:tune-cortexa65ae                         = "cortexa65ae"
# We do not want -march since -mcpu is added above to cover for it
TUNE_FEATURES:tune-cortexa65ae                      = "aarch64 crypto cortexa65ae"
PACKAGE_EXTRA_ARCHS:tune-cortexa65ae                = "${PACKAGE_EXTRA_ARCHS:tune-armv8-2a-crypto} cortexa65ae"
BASE_LIB:tune-cortexa65ae                           = "lib64"
```

## upstream-layers/openembedded-core/meta/conf/machine/include/arm/armv8-2a/tune-cortexa77.inc
```bitbake
#
# Tune Settings for Cortex-A77
#
DEFAULTTUNE                                        ?= "cortexa77"

TUNEVALID[cortexa77] = "Enable Cortex-A77 specific processor optimizations"
TUNE_CCARGS .= "${@bb.utils.contains('TUNE_FEATURES', 'cortexa77', ' -mcpu=cortex-a77', '', d)}"

require conf/machine/include/arm/arch-armv8-2a.inc

# Little Endian base configs
AVAILTUNES                                         += "cortexa77"
ARMPKGARCH:tune-cortexa77                           = "cortexa77"
# We do not want -march since -mcpu is added above to cover for it
TUNE_FEATURES:tune-cortexa77                        = "aarch64 crypto cortexa77"
PACKAGE_EXTRA_ARCHS:tune-cortexa77                  = "${PACKAGE_EXTRA_ARCHS:tune-armv8-2a-crypto} cortexa77"
BASE_LIB:tune-cortexa77                             = "lib64"
```

## upstream-layers/openembedded-core/meta/conf/machine/include/arm/armv8-2a/tune-cortexa78.inc
```bitbake
#
# Tune Settings for Cortex-A78
#
DEFAULTTUNE                                        ?= "cortexa78"

TUNEVALID[cortexa78] = "Enable Cortex-A78 specific processor optimizations"
TUNE_CCARGS .= "${@bb.utils.contains('TUNE_FEATURES', 'cortexa78', ' -mcpu=cortex-a78', '', d)}"

require conf/machine/include/arm/arch-armv8-2a.inc

# Little Endian base configs
AVAILTUNES                                         += "cortexa78"
ARMPKGARCH:tune-cortexa78                           = "cortexa78"
# We do not want -march since -mcpu is added above to cover for it
TUNE_FEATURES:tune-cortexa78                        = "aarch64 crypto cortexa78"
PACKAGE_EXTRA_ARCHS:tune-cortexa78                  = "${PACKAGE_EXTRA_ARCHS:tune-armv8-2a-crypto} cortexa78"
BASE_LIB:tune-cortexa78                             = "lib64"
```

## upstream-layers/openembedded-core/meta/conf/machine/include/arm/armv8-2a/tune-cortexa78c.inc
```bitbake
#
# Tune Settings for cortex-a78c
#
DEFAULTTUNE ?= "cortexa78c"

TUNEVALID[cortexa78c] = "Enable cortex-a78c specific processor optimizations"
TUNE_CCARGS .= "${@bb.utils.contains('TUNE_FEATURES', 'cortexa78c', ' -mcpu=cortex-a78c', '', d)}"

require conf/machine/include/arm/arch-armv8-2a.inc

AVAILTUNES                                          += "cortexa78c"
ARMPKGARCH:tune-cortexa78c                           = "cortexa78c"
TUNE_FEATURES:tune-cortexa78c                        = "aarch64 crypto cortexa78c"
PACKAGE_EXTRA_ARCHS:tune-cortexa78c                  = "${PACKAGE_EXTRA_ARCHS:tune-armv8-2a-crypto} cortexa78c"
BASE_LIB:tune-cortexa78c                             = "lib64"
```

## upstream-layers/openembedded-core/meta/conf/machine/include/arm/armv8-2a/tune-cortexx1c.inc
```bitbake
#
# Tune Settings for cortex-x1c
#
DEFAULTTUNE ?= "cortexx1c"

TUNEVALID[cortexx1c] = "Enable cortex-x1c specific processor optimizations"
TUNE_CCARGS .= "${@bb.utils.contains('TUNE_FEATURES', 'cortexx1c', ' -mcpu=cortex-x1c', '', d)}"

require conf/machine/include/arm/arch-armv8-2a.inc

AVAILTUNES                                         += "cortexx1c"
ARMPKGARCH:tune-cortexx1c                           = "cortexx1c"
TUNE_FEATURES:tune-cortexx1c                        = "aarch64 crypto cortexx1c"
PACKAGE_EXTRA_ARCHS:tune-cortexx1c                  = "${PACKAGE_EXTRA_ARCHS:tune-armv8-2a-crypto} cortexx1c"
BASE_LIB:tune-cortexx1c                             = "lib64"
```

## upstream-layers/openembedded-core/meta/conf/machine/include/arm/armv8-2a/tune-octeontx2.inc
```bitbake
DEFAULTTUNE ?= "octeontx2"

TUNEVALID[octeontx2] = "Enable Marvell octeontx2 specific processor optimizations"
CPU_TUNE_OCTEONTX2 ?= "-mcpu=octeontx2"
CPU_TUNE_OCTEONTX2:toolchain-clang = "-march=armv8.2-a"
TUNE_CCARGS .= "${@bb.utils.contains('TUNE_FEATURES', 'octeontx2', ' ${CPU_TUNE_OCTEONTX2}', '', d)}"

require conf/machine/include/arm/arch-armv8-2a.inc

# Little Endian base configs
AVAILTUNES += "octeontx2"
ARMPKGARCH:tune-octeontx2             = "octeontx2"
# We do not want -march since -mcpu is added above to cover for it
TUNE_FEATURES:tune-octeontx2          = "aarch64 crypto octeontx2"
PACKAGE_EXTRA_ARCHS:tune-octeontx2    = "${PACKAGE_EXTRA_ARCHS:tune-armv8-2a-crypto} octeontx2"
BASE_LIB:tune-octeontx2               = "lib64"
```

## upstream-layers/openembedded-core/meta/conf/machine/include/arm/armv8-4a/tune-neoverse512tvb.inc
```bitbake
#
# Tune Settings for neoverse-512tvb
#
DEFAULTTUNE ?= "neoverse512tvb"

TUNEVALID[neoverse512tvb] = "Enable neoverse-512tvb specific processor optimizations"
TUNE_CCARGS .= "${@bb.utils.contains('TUNE_FEATURES', 'neoverse512tvb', ' -mcpu=neoverse-512tvb', '', d)}"

require conf/machine/include/arm/arch-armv8-4a.inc

AVAILTUNES                                              += "neoverse512tvb"
ARMPKGARCH:tune-neoverse512tvb                           = "neoverse512tvb"
TUNE_FEATURES:tune-neoverse512tvb                        = "aarch64 crypto neoverse512tvb"
PACKAGE_EXTRA_ARCHS:tune-neoverse512tvb                  = "${PACKAGE_EXTRA_ARCHS:tune-armv8-4a-crypto} neoverse512tvb"
BASE_LIB:tune-neoverse512tvb                             = "lib64"
```

## upstream-layers/openembedded-core/meta/conf/machine/include/arm/armv8-4a/tune-neoversev1.inc
```bitbake
#
# Tune Settings for neoverse-v1
#
DEFAULTTUNE ?= "neoversev1"

TUNEVALID[neoversev1] = "Enable neoverse-v1 specific processor optimizations"
TUNE_CCARGS .= "${@bb.utils.contains('TUNE_FEATURES', 'neoversev1', ' -mcpu=neoverse-v1', '', d)}"

require conf/machine/include/arm/arch-armv8-4a.inc

AVAILTUNES                                          += "neoversev1"
ARMPKGARCH:tune-neoversev1                           = "neoversev1"
TUNE_FEATURES:tune-neoversev1                        = "aarch64 crypto neoversev1"
PACKAGE_EXTRA_ARCHS:tune-neoversev1                  = "${PACKAGE_EXTRA_ARCHS:tune-armv8-4a-crypto} neoversev1"
BASE_LIB:tune-neoversev1                             = "lib64"
```

## upstream-layers/openembedded-core/meta/conf/machine/include/arm/armv8-m/tune-cortexm23.inc
```bitbake
#
# Tune Settings for Cortex-M23
#
DEFAULTTUNE ?= "cortexm23"

TUNEVALID[cortexm23] = "Enable Cortex-M23 specific processor optimizations"
TUNE_CCARGS .= "${@bb.utils.contains('TUNE_FEATURES', 'cortexm23', ' -mcpu=cortex-m23', '', d)}"

require conf/machine/include/arm/arch-armv8m-base.inc

AVAILTUNES                          += "cortexm23"
ARMPKGARCH:tune-cortexm23            = "cortexm23"
# We do not want -march since -mcpu is added above to cover for it
TUNE_FEATURES:tune-cortexm23         = "cortexm23"
PACKAGE_EXTRA_ARCHS:tune-cortexm23   = "${PACKAGE_EXTRA_ARCHS:tune-armv8m-base} cortexm23"
```

## upstream-layers/openembedded-core/meta/conf/machine/include/arm/armv8-m/tune-cortexm33.inc
```bitbake
#
# Tune Settings for Cortex-M33
#
DEFAULTTUNE ?= "cortexm33"

TUNEVALID[cortexm33] = "Enable Cortex-M33 specific processor optimizations"
TUNE_CCARGS .= "${@bb.utils.contains('TUNE_FEATURES', 'cortexm33', ' -mcpu=cortex-m33', '', d)}"

require conf/machine/include/arm/arch-armv8m-main.inc

# GCC thnks that DSP and VFP are required, but Arm docs say it is
# optional.  So forcing below so that compiling works, but this should
# be fixed in GCC
AVAILTUNES                          += "cortexm33"
ARMPKGARCH:tune-cortexm33            = "cortexm33"
# We do not want -march since -mcpu is added above to cover for it
TUNE_FEATURES:tune-cortexm33         = "vfpv5spd16 dsp cortexm33"
PACKAGE_EXTRA_ARCHS:tune-cortexm33   = "${PACKAGE_EXTRA_ARCHS:tune-armv8m-maine-vfpv5spd16} cortexm33e-fpv5-spd16"
```

## upstream-layers/openembedded-core/meta/conf/machine/include/arm/armv8a/tune-cortexa32.inc
```bitbake
DEFAULTTUNE ?= "cortexa32"

TUNEVALID[cortexa32] = "Enable Cortex-A32 specific processor optimizations"
TUNE_CCARGS .= "${@bb.utils.contains('TUNE_FEATURES', 'cortexa32', ' -mcpu=cortex-a32', '', d)}"

require conf/machine/include/arm/arch-armv8a.inc

# On AArch32 the ARMv8 crypto extensions (AES/SHA) live in the FPU, not just
# -march. OE-Core's 'crypto' feature only adds '+crypto' to -march, leaving the
# FPU at plain 'neon', so GCC refuses to inline the AES intrinsics used by e.g.
# mbedtls' aesce.c ("target specific option mismatch"). Select the crypto FPU by
# making it the last word of TUNE_CCARGS_MFPU - the same idiom OE-Core uses for
# the vfpv4+neon -> neon-vfpv4 combination in feature-arm-neon.inc.
TUNE_CCARGS_MFPU .= "${@bb.utils.contains('TUNE_FEATURES', [ 'crypto', 'neon' ], ' crypto-neon-fp-armv8', '', d)}"

# Little Endian base configs
AVAILTUNES += "cortexa32 cortexa32-crypto"
ARMPKGARCH:tune-cortexa32             = "cortexa32"
ARMPKGARCH:tune-cortexa32-crypto      = "cortexa32"
# We do not want -march since -mcpu is added above to cover for it
TUNE_FEATURES:tune-cortexa32          = "arm armv8a cortexa32 crc callconvention-hard neon thumb"
TUNE_FEATURES:tune-cortexa32-crypto   = "${TUNE_FEATURES:tune-cortexa32} crypto"
PACKAGE_EXTRA_ARCHS:tune-cortexa32             = "${PACKAGE_EXTRA_ARCHS:tune-armv8a-crc} cortexa32 cortexa32t2hf-neon"
PACKAGE_EXTRA_ARCHS:tune-cortexa32-crypto      = "${PACKAGE_EXTRA_ARCHS:tune-armv8a-crc-crypto} cortexa32 cortexa32t2hf-neon cortexa32t2hf-crypto-neon-fp-armv8"
BASE_LIB:tune-cortexa32               = "lib"
BASE_LIB:tune-cortexa32-crypto        = "lib"
```

## upstream-layers/openembedded-core/meta/conf/machine/include/arm/armv8a/tune-cortexa34.inc
```bitbake
#
# Tune Settings for Cortex-A34
#
DEFAULTTUNE ?= "cortexa34"

TUNEVALID[cortexa34] = "Enable Cortex-A34 specific processor optimizations"
TUNE_CCARGS .= "${@bb.utils.contains('TUNE_FEATURES', 'cortexa34', ' -mcpu=cortex-a34', '', d)}"

require conf/machine/include/arm/arch-armv8a.inc

# Little Endian base configs
AVAILTUNES                                += "cortexa34 cortexa34-crypto"
ARMPKGARCH:tune-cortexa34                  = "cortexa34"
ARMPKGARCH:tune-cortexa34-crypto           = "cortexa34"
# We do not want -march since -mcpu is added above to cover for it
TUNE_FEATURES:tune-cortexa34               = "aarch64 crc cortexa34"
TUNE_FEATURES:tune-cortexa34-crypto        = "${TUNE_FEATURES:tune-cortexa34} crypto"
PACKAGE_EXTRA_ARCHS:tune-cortexa34         = "${PACKAGE_EXTRA_ARCHS:tune-armv8a-crc} cortexa34"
PACKAGE_EXTRA_ARCHS:tune-cortexa34-crypto  = "${PACKAGE_EXTRA_ARCHS:tune-armv8a-crc-crypto} cortexa34 cortexa34-crypto"
BASE_LIB:tune-cortexa34                    = "lib64"
BASE_LIB:tune-cortexa34-crypto             = "lib64"
```

## upstream-layers/openembedded-core/meta/conf/machine/include/arm/armv8a/tune-cortexa57-cortexa53.inc
```bitbake
DEFAULTTUNE ?= "cortexa57-cortexa53"

TUNEVALID[cortexa57-cortexa53] = "Enable big.LITTLE Cortex-A57.Cortex-A53 specific processor optimizations"

CPU_TUNE_ARG = "cortex-a57.cortex-a53"
# clang doesn't support big.LITTLE tunes, select the LITTLE tune
CPU_TUNE_ARG:toolchain-clang = "cortex-a53"
TUNE_CCARGS .= "${@bb.utils.contains("TUNE_FEATURES", "cortexa57-cortexa53", " -mcpu=${CPU_TUNE_ARG}", "", d)}"
MACHINEOVERRIDES =. "${@bb.utils.contains("TUNE_FEATURES", "cortexa57-cortexa53", "cortexa57-cortexa53:", "", d)}"

require conf/machine/include/arm/arch-armv8a.inc

# Little Endian base configs
AVAILTUNES += "cortexa57-cortexa53"
ARMPKGARCH:tune-cortexa57-cortexa53 = "cortexa57-cortexa53"
# We do not want -march since -mcpu is added above to cover for it
TUNE_FEATURES:tune-cortexa57-cortexa53 = "aarch64 crc cortexa57-cortexa53"
PACKAGE_EXTRA_ARCHS:tune-cortexa57-cortexa53 = "${PACKAGE_EXTRA_ARCHS:tune-armv8a-crc} cortexa57-cortexa53"
BASE_LIB:tune-cortexa57-cortexa53 = "lib64"
```

## upstream-layers/openembedded-core/meta/conf/machine/include/arm/armv8a/tune-cortexa72.inc
```bitbake
DEFAULTTUNE ?= "cortexa72"

TUNEVALID[cortexa72] = "Enable Cortex-A72 specific processor optimizations"
TUNE_CCARGS .= "${@bb.utils.contains('TUNE_FEATURES', 'cortexa72', ' -mcpu=cortex-a72', '', d)}"

require conf/machine/include/arm/arch-armv8a.inc

# Little Endian base configs
AVAILTUNES += "cortexa72 cortexa72-crypto"
ARMPKGARCH:tune-cortexa72             = "cortexa72"
ARMPKGARCH:tune-cortexa72-crypto      = "cortexa72"
# We do not want -march since -mcpu is added above to cover for it
TUNE_FEATURES:tune-cortexa72          = "aarch64 crc cortexa72"
TUNE_FEATURES:tune-cortexa72-crypto   = "${TUNE_FEATURES:tune-cortexa72} crypto"
PACKAGE_EXTRA_ARCHS:tune-cortexa72        = "${PACKAGE_EXTRA_ARCHS:tune-armv8a-crc} cortexa72"
PACKAGE_EXTRA_ARCHS:tune-cortexa72-crypto = "${PACKAGE_EXTRA_ARCHS:tune-armv8a-crc-crypto} cortexa72 cortexa72-crypto"
BASE_LIB:tune-cortexa72            = "lib64"
BASE_LIB:tune-cortexa72-crypto     = "lib64"
```

## upstream-layers/openembedded-core/meta/conf/machine/include/arm/armv8a/tune-cortexa73.inc
```bitbake
#
# Tune Settings for Cortex-A73
#
DEFAULTTUNE ?= "cortexa73"

TUNEVALID[cortexa73] = "Enable Cortex-A73 specific processor optimizations"
TUNE_CCARGS .= "${@bb.utils.contains('TUNE_FEATURES', 'cortexa73', ' -mcpu=cortex-a73', '', d)}"

require conf/machine/include/arm/arch-armv8a.inc

# Little Endian base configs
AVAILTUNES                                += "cortexa73 cortexa73-crypto"
ARMPKGARCH:tune-cortexa73                  = "cortexa73"
ARMPKGARCH:tune-cortexa73-crypto           = "cortexa73"
# We do not want -march since -mcpu is added above to cover for it
TUNE_FEATURES:tune-cortexa73               = "aarch64 crc cortexa73"
TUNE_FEATURES:tune-cortexa73-crypto        = "${TUNE_FEATURES:tune-cortexa73} crypto"
PACKAGE_EXTRA_ARCHS:tune-cortexa73         = "${PACKAGE_EXTRA_ARCHS:tune-armv8a-crc} cortexa73"
PACKAGE_EXTRA_ARCHS:tune-cortexa73-crypto  = "${PACKAGE_EXTRA_ARCHS:tune-armv8a-crc-crypto} cortexa73 cortexa73-crypto"
BASE_LIB:tune-cortexa73                    = "lib64"
BASE_LIB:tune-cortexa73-crypto             = "lib64"
```

## upstream-layers/openembedded-core/meta/conf/machine/include/arm/armv8a/tune-thunderx.inc
```bitbake
DEFAULTTUNE ?= "thunderx"
AVAILTUNES += "thunderx thunderx_be"

TUNEVALID[thunderx] = "Enable instructions for Cavium ThunderX"

TUNE_CCARGS .= "${@bb.utils.contains('TUNE_FEATURES', 'thunderx', ' -mcpu=thunderx', '',d)}"

require conf/machine/include/arm/arch-armv8a.inc

ARMPKGARCH:tune-thunderx ?= "thunderx"
ARMPKGARCH:tune-thunderx_be ?= "thunderx"

TUNE_FEATURES:tune-thunderx = "${TUNE_FEATURES:tune-aarch64} thunderx"
TUNE_FEATURES:tune-thunderx_be = "${TUNE_FEATURES:tune-thunderx} bigendian"
BASE_LIB:tune-thunderx = "lib64"
BASE_LIB:tune-thunderx_be = "lib64"

PACKAGE_EXTRA_ARCHS:tune-thunderx = "${PACKAGE_EXTRA_ARCHS:tune-armv8a-crc-crypto} thunderx"
PACKAGE_EXTRA_ARCHS:tune-thunderx_be = "aarch64_be thunderx_be"
```
