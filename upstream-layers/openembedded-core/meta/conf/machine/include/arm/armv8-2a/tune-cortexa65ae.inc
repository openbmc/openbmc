## upstream-layers/openembedded-core/meta/conf/machine/include/arm/armv8r/tune-cortexr82.inc
```bitbake
#
# Tune Settings for cortex-r82
#
DEFAULTTUNE ?= "cortexr82"

TUNEVALID[cortexr82] = "Enable cortex-r82 specific processor optimizations"
TUNE_CCARGS .= "${@bb.utils.contains('TUNE_FEATURES', 'cortexr82', ' -mcpu=cortex-r82', '', d)}"

require conf/machine/include/arm/arch-armv8r.inc

AVAILTUNES                                         += "cortexr82"
ARMPKGARCH:tune-cortexr82                           = "cortexr82"
TUNE_FEATURES:tune-cortexr82                        = "${TUNE_FEATURES:tune-armv8r-crc-simd} cortexr82"
PACKAGE_EXTRA_ARCHS:tune-cortexr82                  = "${PACKAGE_EXTRA_ARCHS:tune-armv8r-crc-simd} cortexr82"
BASE_LIB:tune-cortexr82                             = "lib64"
```

## upstream-layers/openembedded-core/meta/conf/machine/include/arm/armv9a/tune-cortexa710.inc
```bitbake
#
# Tune Settings for cortex-a710
#
DEFAULTTUNE ?= "cortexa710"

TUNEVALID[cortexa710] = "Enable cortex-a710 specific processor optimizations"
TUNE_CCARGS .= "${@bb.utils.contains('TUNE_FEATURES', 'cortexa710', ' -mcpu=cortex-a710', '', d)}"

require conf/machine/include/arm/arch-armv9a.inc

AVAILTUNES                                          += "cortexa710"
ARMPKGARCH:tune-cortexa710                           = "cortexa710"
TUNE_FEATURES:tune-cortexa710                        = "aarch64 crypto cortexa710"
PACKAGE_EXTRA_ARCHS:tune-cortexa710                  = "${PACKAGE_EXTRA_ARCHS:tune-armv9a-crypto} cortexa710"
BASE_LIB:tune-cortexa710                             = "lib64"
```

## upstream-layers/openembedded-core/meta/conf/machine/include/arm/armv9a/tune-cortexx2.inc
```bitbake
#
# Tune Settings for cortex-x2
#
DEFAULTTUNE ?= "cortexx2"

TUNEVALID[cortexx2] = "Enable cortex-x2 specific processor optimizations"
TUNE_CCARGS .= "${@bb.utils.contains('TUNE_FEATURES', 'cortexx2', ' -mcpu=cortex-x2', '', d)}"

require conf/machine/include/arm/arch-armv9a.inc

AVAILTUNES                                        += "cortexx2"
ARMPKGARCH:tune-cortexx2                           = "cortexx2"
TUNE_FEATURES:tune-cortexx2                        = "aarch64 crypto cortexx2"
PACKAGE_EXTRA_ARCHS:tune-cortexx2                  = "${PACKAGE_EXTRA_ARCHS:tune-armv9a-crypto} cortexx2"
BASE_LIB:tune-cortexx2                             = "lib64"
```

## upstream-layers/openembedded-core/meta/conf/machine/include/arm/armv9a/tune-neoversev2.inc
```bitbake
#
# Tune Settings for neoverse-v2
#
DEFAULTTUNE ?= "neoversev2"

TUNEVALID[neoversev2] = "Enable neoverse-v2 specific processor optimizations"
TUNE_CCARGS .= "${@bb.utils.contains('TUNE_FEATURES', 'neoversev2', ' -mcpu=neoverse-v2', '', d)}"

require conf/machine/include/arm/arch-armv9a.inc

AVAILTUNES                                          += "neoversev2"
ARMPKGARCH:tune-neoversev2                           = "neoversev2"
TUNE_FEATURES:tune-neoversev2                        = "aarch64 crypto neoversev2"
PACKAGE_EXTRA_ARCHS:tune-neoversev2                  = "${PACKAGE_EXTRA_ARCHS:tune-armv9a-crypto} neoversev2"
BASE_LIB:tune-neoversev2                             = "lib64"
```

## upstream-layers/openembedded-core/meta/conf/machine/include/arm/feature-arm-crc.inc
```bitbake
# Cyclic Redundancy Check (CRC) instructions for armv8-a and armv8-r

TUNEVALID[crc] = "Enable instructions for ARMv8 Cyclic Redundancy Check (CRC)"
TUNE_CCARGS_MARCH_OPTS .= "${@bb.utils.contains('TUNE_FEATURES', 'crc', '+crc', '', d)}"
```

## upstream-layers/openembedded-core/meta/conf/machine/include/arm/feature-arm-crypto.inc
```bitbake
# Cryptographic instructions for:
# armv8-a, armv8.1-a, armv8.3-a, armv8.4-a, armv8.5-a, armv8.6-a, and armv8-r

TUNEVALID[crypto] = "Enable cryptographic instructions for ARMv8"
TUNE_CCARGS_MARCH_OPTS .= "${@bb.utils.contains('TUNE_FEATURES', 'crypto', '+crypto', '', d)}"
```

## upstream-layers/openembedded-core/meta/conf/machine/include/arm/feature-arm-dsp.inc
```bitbake
ARMPKGSFX_DSP = "${@bb.utils.contains('TUNE_FEATURES', [ 'dsp' ], 'e', '', d)}"
TUNEVALID[dsp] = "ARM DSP functionality"
TUNE_CCARGS_MARCH_OPTS .= "${@bb.utils.contains('TUNE_FEATURES', [ 'dsp' ], '+dsp', '', d)}"
```

## upstream-layers/openembedded-core/meta/conf/machine/include/arm/feature-arm-simd.inc
```bitbake
# Advanced SIMD and floating-point instructions for armv7-a, armv7ve,
# armv8-a, armv8.1-a, armv8.3-a, armv8.4-a, armv8.5-a, armv8.6-a, and armv8-r

TUNEVALID[simd] = "Enable instructions for Advanced SIMD and floating-point units"
TUNE_CCARGS_MARCH_OPTS .= "${@bb.utils.contains('TUNE_FEATURES', 'simd', '+simd', '', d)}"
```

## upstream-layers/openembedded-core/meta/conf/machine/include/arm/feature-arm-sve.inc
```bitbake
# Scalable Vector Extension (SVE) for Armv8-A and R
# Enabled by default for Armv9

TUNEVALID[sve] = "Enable SVE instructions for ARMv8"
TUNE_CCARGS_MARCH_OPTS .= "${@bb.utils.contains('TUNE_FEATURES', 'sve', '+sve', '', d)}"

TUNEVALID[sve2] = "Enable SVE2 instructions for ARMv8"
TUNE_CCARGS_MARCH_OPTS .= "${@bb.utils.contains('TUNE_FEATURES', 'sve2', '+sve2', '', d)}"
```
