## upstream-layers/openembedded-core/meta/conf/machine/include/arm/arch-armv8-8a.inc
```bitbake
DEFAULTTUNE ?= "armv8-8a"

TUNEVALID[armv8-8a] = "Enable instructions for ARMv8.8-a"
TUNE_CCARGS_MARCH .= "${@bb.utils.contains('TUNE_FEATURES', 'armv8-8a', ' -march=armv8.8-a', '', d)}"
MACHINEOVERRIDES =. "${@bb.utils.contains('TUNE_FEATURES', 'armv8-8a', 'armv8-8a:', '', d)}"

require conf/machine/include/arm/arch-armv8a.inc

# Little Endian base configs
AVAILTUNES += "armv8-8a"
ARMPKGARCH:tune-armv8-8a                    ?= "armv8-8a"
TUNE_FEATURES:tune-armv8-8a                  = "aarch64 armv8-8a"
PACKAGE_EXTRA_ARCHS:tune-armv8-8a            = "${PACKAGE_EXTRA_ARCHS:tune-armv8a} armv8-8a"
BASE_LIB:tune-armv8-8a                       = "lib64"
```

## upstream-layers/openembedded-core/meta/conf/machine/include/arm/arch-armv8m-base.inc
```bitbake
#
# Defaults for ARMv8-m.base
#
DEFAULTTUNE ?= "armv8m-base"

TUNEVALID[armv8m-base] = "Enable instructions for ARMv8-m.base"
TUNE_CCARGS_MARCH .= "${@bb.utils.contains('TUNE_FEATURES', 'armv8m-base', ' -march=armv8-m.base', '', d)}"
MACHINEOVERRIDES =. "${@bb.utils.contains('TUNE_FEATURES', 'armv8m-base', 'armv8m-base:', '', d)}"

TUNECONFLICTS[armv8m-base] = "armv4 armv5 armv6 armv7a"

require conf/machine/include/arm/arch-armv7m.inc

AVAILTUNES                          += "armv8m-base"
ARMPKGARCH:tune-armv8m-base          = "armv8m-base"
TUNE_FEATURES:tune-armv8m-base       = "armv8m-base"
PACKAGE_EXTRA_ARCHS:tune-armv8m-base = "armv8m-base"
```

## upstream-layers/openembedded-core/meta/conf/machine/include/arm/arch-armv8m-main.inc
```bitbake
#
# Defaults for ARMv8-m.main
#
DEFAULTTUNE ?= "armv8m-main"

require conf/machine/include/arm/arch-armv8m-base.inc
require conf/machine/include/arm/feature-arm-dsp.inc
require conf/machine/include/arm/feature-arm-neon.inc

TUNEVALID[armv8m-main] = "Enable instructions for ARMv8-m.main"
TUNE_CCARGS_MARCH .= "${@bb.utils.contains('TUNE_FEATURES', 'armv8m-main', ' -march=armv8-m.main', '', d)}"
MACHINEOVERRIDES =. "${@bb.utils.contains('TUNE_FEATURES', 'armv8m-main', 'armv8m-main:', '', d)}"

TUNECONFLICTS[armv8m-main] = "armv4 armv5 armv6 armv7a"

AVAILTUNES                                      += "armv8m-main armv8m-maine armv8m-main-vfpv5spd16 armv8m-maine-vfpv5spd16"
ARMPKGARCH:tune-armv8m-main                      = "armv8m-main"
ARMPKGARCH:tune-armv8m-maine                     = "armv8m-main"
ARMPKGARCH:tune-armv8m-main-vfpv5spd16           = "armv8m-main"
ARMPKGARCH:tune-armv8m-maine-vfpv5spd16          = "armv8m-main"
TUNE_FEATURES:tune-armv8m-main                   = "armv8m-main"
TUNE_FEATURES:tune-armv8m-maine                  = "${TUNE_FEATURES:tune-armv8m-main} dsp"
TUNE_FEATURES:tune-armv8m-main-vfpv5spd16        = "${TUNE_FEATURES:tune-armv8m-main} vfpv5spd16"
TUNE_FEATURES:tune-armv8m-maine-vfpv5spd16       = "${TUNE_FEATURES:tune-armv8m-main-vfpv5spd16} dsp"
PACKAGE_EXTRA_ARCHS:tune-armv8m-main             = "armv8m-main"
PACKAGE_EXTRA_ARCHS:tune-armv8m-maine            = "${PACKAGE_EXTRA_ARCHS:tune-armv8m-main} armv8m-maine"
PACKAGE_EXTRA_ARCHS:tune-armv8m-main-vfpv5spd16  = "${PACKAGE_EXTRA_ARCHS:tune-armv8m-main} armv8m-main-fpv5-spd16"
PACKAGE_EXTRA_ARCHS:tune-armv8m-maine-vfpv5spd16 = "${PACKAGE_EXTRA_ARCHS:tune-armv8m-main} armv8m-maine-fpv5-spd16"
```

## upstream-layers/openembedded-core/meta/conf/machine/include/arm/armv4/tune-arm920t.inc
```bitbake
DEFAULTTUNE ?= "arm920t"

require conf/machine/include/arm/arch-armv4.inc

TUNEVALID[arm920t] = "Enable arm920t specific processor optimizations"
TUNE_CCARGS .= "${@bb.utils.contains('TUNE_FEATURES', 'arm920t', ' -mcpu=arm920t', '', d)}"
MACHINEOVERRIDES =. "${@bb.utils.contains('TUNE_FEATURES', 'arm920t', 'armv4:', '', d)}"

AVAILTUNES += "arm920t"
ARMPKGARCH:tune-arm920t = "arm920t"
# mcpu is used so don't use armv4t as we don't want march
TUNE_FEATURES:tune-arm920t = "arm thumb arm920t"
PACKAGE_EXTRA_ARCHS:tune-arm920t = "${PACKAGE_EXTRA_ARCHS:tune-armv4t} arm920t arm920tt"
```

## upstream-layers/openembedded-core/meta/conf/machine/include/arm/armv4/tune-arm9tdmi.inc
```bitbake
DEFAULTTUNE ?= "arm9tdmi"

require conf/machine/include/arm/arch-armv4.inc

TUNEVALID[arm9tdmi] = "Enable arm9tdmi specific processor optimizations"
TUNE_CCARGS .= "${@bb.utils.contains('TUNE_FEATURES', 'arm9tdmi', ' -mcpu=arm9tdmi', '', d)}"
MACHINEOVERRIDES =. "${@bb.utils.contains('TUNE_FEATURES', 'arm9tdmi', 'armv4:', '', d)}"

AVAILTUNES += "arm9tdmi"
ARMPKGARCH:tune-arm9tdmi = "arm9tdmi"
# mcpu is used so don't use armv4t as we don't want march
TUNE_FEATURES:tune-arm9tdmi = "arm thumb arm9tdmi"
PACKAGE_EXTRA_ARCHS:tune-arm9tdmi = "${PACKAGE_EXTRA_ARCHS:tune-armv4t} arm9tdmi arm9tdmit"
```

## upstream-layers/openembedded-core/meta/conf/machine/include/arm/armv6/tune-arm1136jf-s.inc
```bitbake
DEFAULTTUNE ?= "armv6hf"

require conf/machine/include/arm/arch-armv6.inc

TUNEVALID[arm1136jfs] = "Enable arm1136jfs specific processor optimizations"
TUNE_CCARGS .= "${@bb.utils.contains('TUNE_FEATURES', 'arm1136jfs', ' -mcpu=arm1136jf-s', '', d)}"
MACHINEOVERRIDES =. "${@bb.utils.contains('TUNE_FEATURES', 'arm1136jfs', 'armv6:', '', d)}"

AVAILTUNES += "arm1136jfs arm1136jfshf"
ARMPKGARCH:tune-arm1136jfs = "arm1136jfs"
ARMPKGARCH:tune-arm1136jfshf = "arm1136jfs"
# mcpu is used so don't use armv6 as we don't want march
TUNE_FEATURES:tune-arm1136jfs = "arm vfp arm1136jfs"
TUNE_FEATURES:tune-arm1136jfshf = "${TUNE_FEATURES:tune-arm1136jfs} callconvention-hard"
PACKAGE_EXTRA_ARCHS:tune-arm1136jfs = "${PACKAGE_EXTRA_ARCHS:tune-armv6} arm1136jfs-vfp"
PACKAGE_EXTRA_ARCHS:tune-arm1136jfshf = "${PACKAGE_EXTRA_ARCHS:tune-armv6hf} arm1136jfshf-vfp"
```

## upstream-layers/openembedded-core/meta/conf/machine/include/arm/armv6m/tune-cortexm0plus.inc
```bitbake
DEFAULTTUNE ?= "cortexm0-plus"
require conf/machine/include/arm/arch-armv6m.inc

TUNEVALID[cortexm0-plus] = "Enable Cortex-M0 Plus specific processor optimizations"
TUNE_CCARGS .= "${@bb.utils.contains('TUNE_FEATURES', 'cortexm0-plus', ' -mcpu=cortex-m0plus', '', d)}"
AVAILTUNES += "cortexm0-plus"

ARMPKGARCH:tune-cortexm0-plus = "cortexm0-plus"
TUNE_FEATURES:tune-cortexm0-plus = "${TUNE_FEATURES:tune-armv6m} cortexm0-plus"

PACKAGE_EXTRA_ARCHS:tune-cortexm0-plus = "${PACKAGE_EXTRA_ARCHS:tune-armv6m} cortexm0-plus"
```

## upstream-layers/openembedded-core/meta/conf/machine/include/arm/armv7a/tune-cortexa9.inc
```bitbake
DEFAULTTUNE ?= "cortexa9thf-neon"

require conf/machine/include/arm/arch-armv7a.inc

TUNEVALID[cortexa9] = "Enable Cortex-A9 specific processor optimizations"
TUNE_CCARGS .= "${@bb.utils.contains('TUNE_FEATURES', 'cortexa9', ' -mcpu=cortex-a9', '', d)}"
MACHINEOVERRIDES =. "${@bb.utils.contains('TUNE_FEATURES', 'cortexa9', 'armv7a:', '', d)}"

# Little Endian base configs
AVAILTUNES += "cortexa9 cortexa9t cortexa9-neon cortexa9t-neon"
ARMPKGARCH:tune-cortexa9             = "cortexa9"
ARMPKGARCH:tune-cortexa9t            = "cortexa9"
ARMPKGARCH:tune-cortexa9-neon        = "cortexa9"
ARMPKGARCH:tune-cortexa9t-neon       = "cortexa9"
# mcpu is used so don't use armv7a as we don't want march
TUNE_FEATURES:tune-cortexa9             = "arm vfp cortexa9"
TUNE_FEATURES:tune-cortexa9t            = "${TUNE_FEATURES:tune-cortexa9} thumb"
TUNE_FEATURES:tune-cortexa9-neon        = "${TUNE_FEATURES:tune-cortexa9} neon"
TUNE_FEATURES:tune-cortexa9t-neon       = "${TUNE_FEATURES:tune-cortexa9-neon} thumb"
PACKAGE_EXTRA_ARCHS:tune-cortexa9             = "${PACKAGE_EXTRA_ARCHS:tune-armv7a} cortexa9-vfp"
PACKAGE_EXTRA_ARCHS:tune-cortexa9t            = "${PACKAGE_EXTRA_ARCHS:tune-armv7at} cortexa9-vfp cortexa9t2-vfp"
PACKAGE_EXTRA_ARCHS:tune-cortexa9-neon        = "${PACKAGE_EXTRA_ARCHS:tune-armv7a-neon} cortexa9-vfp cortexa9-neon"
PACKAGE_EXTRA_ARCHS:tune-cortexa9t-neon       = "${PACKAGE_EXTRA_ARCHS:tune-armv7at-neon} cortexa9-vfp cortexa9-neon cortexa9t2-vfp cortexa9t2-neon"

# HF Tunes
AVAILTUNES += "cortexa9hf cortexa9thf cortexa9hf-neon cortexa9thf-neon"
ARMPKGARCH:tune-cortexa9hf             = "cortexa9"
ARMPKGARCH:tune-cortexa9thf            = "cortexa9"
ARMPKGARCH:tune-cortexa9hf-neon        = "cortexa9"
ARMPKGARCH:tune-cortexa9thf-neon       = "cortexa9"
# mcpu is used so don't use armv7a as we don't want march
TUNE_FEATURES:tune-cortexa9hf             = "${TUNE_FEATURES:tune-cortexa9} callconvention-hard"
TUNE_FEATURES:tune-cortexa9thf            = "${TUNE_FEATURES:tune-cortexa9t} callconvention-hard"
TUNE_FEATURES:tune-cortexa9hf-neon        = "${TUNE_FEATURES:tune-cortexa9-neon} callconvention-hard"
TUNE_FEATURES:tune-cortexa9thf-neon       = "${TUNE_FEATURES:tune-cortexa9t-neon} callconvention-hard"
PACKAGE_EXTRA_ARCHS:tune-cortexa9hf             = "${PACKAGE_EXTRA_ARCHS:tune-armv7ahf} cortexa9hf-vfp"
PACKAGE_EXTRA_ARCHS:tune-cortexa9thf            = "${PACKAGE_EXTRA_ARCHS:tune-armv7athf} cortexa9hf-vfp cortexa9t2hf-vfp"
PACKAGE_EXTRA_ARCHS:tune-cortexa9hf-neon        = "${PACKAGE_EXTRA_ARCHS:tune-armv7ahf-neon} cortexa9hf-vfp cortexa9hf-neon"
PACKAGE_EXTRA_ARCHS:tune-cortexa9thf-neon       = "${PACKAGE_EXTRA_ARCHS:tune-armv7athf-neon} cortexa9hf-vfp cortexa9hf-neon cortexa9t2hf-vfp cortexa9t2hf-neon"

# VFPv3 Tunes
AVAILTUNES += "cortexa9-vfpv3 cortexa9t-vfpv3 cortexa9hf-vfpv3 cortexa9thf-vfpv3"
ARMPKGARCH:tune-cortexa9-vfpv3          = "cortexa9"
ARMPKGARCH:tune-cortexa9t-vfpv3         = "cortexa9"
ARMPKGARCH:tune-cortexa9hf-vfpv3        = "cortexa9"
ARMPKGARCH:tune-cortexa9thf-vfpv3       = "cortexa9"
# mcpu is used so don't use armv7a as we don't want march
TUNE_FEATURES:tune-cortexa9-vfpv3           = "${TUNE_FEATURES:tune-cortexa9} vfpv3"
TUNE_FEATURES:tune-cortexa9t-vfpv3          = "${TUNE_FEATURES:tune-cortexa9t} vfpv3"
TUNE_FEATURES:tune-cortexa9hf-vfpv3         = "${TUNE_FEATURES:tune-cortexa9hf} vfpv3"
TUNE_FEATURES:tune-cortexa9thf-vfpv3        = "${TUNE_FEATURES:tune-cortexa9thf} vfpv3"
PACKAGE_EXTRA_ARCHS:tune-cortexa9-vfpv3           = "${PACKAGE_EXTRA_ARCHS:tune-armv7a-vfpv3} cortexa9-vfp cortexa9-vfpv3"
PACKAGE_EXTRA_ARCHS:tune-cortexa9t-vfpv3          = "${PACKAGE_EXTRA_ARCHS:tune-armv7at-vfpv3} cortexa9-vfp cortexa9-vfpv3 cortexa9t2-vfp cortexa9t2-vfpv3"
PACKAGE_EXTRA_ARCHS:tune-cortexa9hf-vfpv3         = "${PACKAGE_EXTRA_ARCHS:tune-armv7ahf-vfpv3} cortexa9hf-vfp cortexa9hf-vfpv3"
PACKAGE_EXTRA_ARCHS:tune-cortexa9thf-vfpv3        = "${PACKAGE_EXTRA_ARCHS:tune-armv7athf-vfpv3} cortexa9hf-vfp cortexa9hf-vfpv3 cortexa9t2hf-vfp cortexa9t2hf-vfpv3"
```

## upstream-layers/openembedded-core/meta/conf/machine/include/arm/armv7m/tune-cortexm4.inc
```bitbake
#
# Tune Settings for Cortex-M4
#
DEFAULTTUNE ?= "cortexm4"

TUNEVALID[cortexm4] = "Enable Cortex-M4 specific processor optimizations"
TUNE_CCARGS .= "${@bb.utils.contains('TUNE_FEATURES', 'cortexm4', ' -mcpu=cortex-m4', '', d)}"

require conf/machine/include/arm/arch-armv7em.inc

AVAILTUNES                            += "cortexm4"
ARMPKGARCH:tune-cortexm4               = "cortexm4"
TUNE_FEATURES:tune-cortexm4            = "${TUNE_FEATURES:tune-armv7em} cortexm4"
PACKAGE_EXTRA_ARCHS:tune-cortexm4      = "${PACKAGE_EXTRA_ARCHS:tune-armv7em} cortexm4"
```

## upstream-layers/openembedded-core/meta/conf/machine/include/arm/armv7m/tune-cortexm7.inc
```bitbake
#
# Tune Settings for Cortex-M7
#
DEFAULTTUNE ?= "cortexm7"

TUNEVALID[cortexm7] = "Enable Cortex-M7 specific processor optimizations"
TUNE_CCARGS .= "${@bb.utils.contains('TUNE_FEATURES', 'cortexm7', ' -mcpu=cortex-m7', '', d)}"

require conf/machine/include/arm/arch-armv7em.inc

AVAILTUNES                            += "cortexm7"
ARMPKGARCH:tune-cortexm7               = "cortexm7"
TUNE_FEATURES:tune-cortexm7            = "${TUNE_FEATURES:tune-armv7em} cortexm7"
PACKAGE_EXTRA_ARCHS:tune-cortexm7      = "${PACKAGE_EXTRA_ARCHS:tune-armv7em} cortexm7"
```

## upstream-layers/openembedded-core/meta/conf/machine/include/arm/armv7r/tune-cortexr4.inc
```bitbake
#
# Tune Settings for Cortex-R4
#
DEFAULTTUNE ?= "cortexr4"

TUNEVALID[cortexr4] = "Enable Cortex-R4 specific processor optimizations"
TUNE_CCARGS .= "${@bb.utils.contains('TUNE_FEATURES', 'cortexr4', ' -mcpu=cortex-r4', '', d)}"

require conf/machine/include/arm/arch-armv7r.inc

AVAILTUNES                            += "cortexr4"
ARMPKGARCH:tune-cortexr4               = "cortexr4"
TUNE_FEATURES:tune-cortexr4            = "${TUNE_FEATURES:tune-armv7r} cortexr4"
PACKAGE_EXTRA_ARCHS:tune-cortexr4      = "${PACKAGE_EXTRA_ARCHS:tune-armv7r} cortexr4"
```

## upstream-layers/openembedded-core/meta/conf/machine/include/arm/armv7r/tune-cortexr4f.inc
```bitbake
#
# Tune Settings for Cortex-R4F
#
DEFAULTTUNE ?= "cortexr4f"

TUNEVALID[cortexr4f] = "Enable Cortex-R4F specific processor optimizations"
TUNE_CCARGS .= "${@bb.utils.contains('TUNE_FEATURES', 'cortexr4f', ' -mcpu=cortex-r4f', '', d)}"

require conf/machine/include/arm/arch-armv7r.inc

AVAILTUNES                            += "cortexr4f"
ARMPKGARCH:tune-cortexr4f              = "cortexr4f"
TUNE_FEATURES:tune-cortexr4f           = "${TUNE_FEATURES:tune-armv7r-vfpv3d16} cortexr4f"
PACKAGE_EXTRA_ARCHS:tune-cortexr4f     = "${PACKAGE_EXTRA_ARCHS:tune-armv7r-vfpv3d16} cortexr4f-vfpv3d16"
```

## upstream-layers/openembedded-core/meta/conf/machine/include/arm/armv7r/tune-cortexr8.inc
```bitbake
#
# Tune Settings for Cortex-R8
#
DEFAULTTUNE ?= "cortexr8"

TUNEVALID[cortexr8] = "Enable Cortex-R8 specific processor optimizations"
TUNE_CCARGS .= "${@bb.utils.contains('TUNE_FEATURES', 'cortexr8', ' -mcpu=cortex-r8', '', d)}"

require conf/machine/include/arm/arch-armv7r.inc

AVAILTUNES                            += "cortexr8"
ARMPKGARCH:tune-cortexr8               = "cortexr8"
TUNE_FEATURES:tune-cortexr8            = "${TUNE_FEATURES:tune-armv7r-vfpv3d16} cortexr8 idiv"
PACKAGE_EXTRA_ARCHS:tune-cortexr8      = "${PACKAGE_EXTRA_ARCHS:tune-armv7r-vfpv3d16} cortexr8-vfpv3d16"
```

## upstream-layers/openembedded-core/meta/conf/machine/include/arm/armv8-1m/tune-cortexm55.inc
```bitbake
#
# Tune Settings for Cortex-M55
#
DEFAULTTUNE ?= "cortexm55"

TUNEVALID[cortexm55] = "Enable Cortex-M55 specific processor optimizations"
TUNE_CCARGS .= "${@bb.utils.contains('TUNE_FEATURES', 'cortexm55', ' -mcpu=cortex-m55', '', d)}"

require conf/machine/include/arm/arch-armv8-1m-main.inc

AVAILTUNES                            += "cortexm55"
ARMPKGARCH:tune-cortexm55              = "cortexm55"
# We do not want -march since -mcpu is added above to cover for it
TUNE_FEATURES:tune-cortexm55           = "cortexm55"
PACKAGE_EXTRA_ARCHS:tune-cortexm55     = "${PACKAGE_EXTRA_ARCHS:tune-armv8-1m-main} cortexm55"
```

## upstream-layers/openembedded-core/meta/conf/machine/include/arm/armv8-2a/tune-cortexa65.inc
```bitbake
#
# Tune Settings for Cortex-A65
#
DEFAULTTUNE ?= "cortexa65"

TUNEVALID[cortexa65] = "Enable Cortex-A65 specific processor optimizations"
TUNE_CCARGS .= "${@bb.utils.contains('TUNE_FEATURES', 'cortexa65', ' -mcpu=cortex-a65', '', d)}"

require conf/machine/include/arm/arch-armv8-2a.inc

# Little Endian base configs
AVAILTUNES                                         += "cortexa65"
ARMPKGARCH:tune-cortexa65                           = "cortexa65"
# We do not want -march since -mcpu is added above to cover for it
TUNE_FEATURES:tune-cortexa65                        = "aarch64 crypto cortexa65"
PACKAGE_EXTRA_ARCHS:tune-cortexa65                  = "${PACKAGE_EXTRA_ARCHS:tune-armv8-2a-crypto} cortexa65"
BASE_LIB:tune-cortexa65                             = "lib64"
```
