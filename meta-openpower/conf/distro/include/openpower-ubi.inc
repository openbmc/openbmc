## meta-openpower/conf/distro/include/openpower-ubi.inc
```bitbake
require conf/distro/include/openpower-virtual-pnor.inc

DISTRO_FEATURES += "openpower-ubi-fs"
DISTROOVERRIDES .= ":df-openpower-ubi-fs"
```

## meta-openpower/conf/distro/include/openpower-virtual-pnor.inc
```bitbake
DISTRO_FEATURES += "openpower-virtual-pnor"
DISTROOVERRIDES .= ":df-openpower-virtual-pnor"
```

## meta-openpower/conf/distro/openbmc-openpower.conf
```bitbake
require conf/distro/include/phosphor-base.inc
require conf/distro/include/openpower-distrovars.inc
require conf/distro/include/phosphor-isolation.inc
```

## meta-openpower/conf/layer.conf
```bitbake
# We have a conf and classes directory, add to BBPATH
BBPATH .= ":${LAYERDIR}"

# We have recipes-* directories, add to BBFILES
BBFILES += "${LAYERDIR}/recipes-*/*/*.bb \
            ${LAYERDIR}/recipes-*/*/*.bbappend"

BBFILE_COLLECTIONS += "openpower-layer"
BBFILE_PATTERN_openpower-layer := "^${LAYERDIR}/"
LAYERVERSION_openpower-layer = "1"
LAYERDEPENDS_openpower-layer = "core phosphor-layer aspeed-layer"
LAYERSERIES_COMPAT_openpower-layer = "scarthgap styhead"
```

## meta-openpower/conf/machine/include/ibm-power10-cpu.inc
```bitbake
MACHINEOVERRIDES =. "ibm-power10-cpu:"
require conf/machine/include/ibm-power-cpu.inc
```

## meta-openpower/conf/machine/include/ibm-power8-cpu.inc
```bitbake
MACHINEOVERRIDES =. "ibm-power8-cpu:"
require conf/machine/include/ibm-power-cpu.inc
```

## meta-openpower/conf/machine/include/openpower.inc
```bitbake
OBMC_MACHINE_FEATURES += "\
        obmc-phosphor-fan-mgmt \
        obmc-phosphor-chassis-mgmt \
        obmc-phosphor-flash-mgmt \
        obmc-host-ipmi \
        obmc-host-ctl \
        obmc-host-state-mgmt \
        obmc-chassis-state-mgmt \
        obmc-bmc-state-mgmt \
        "

# Add OpenPOWER OEM commands handler library
VIRTUAL-RUNTIME_phosphor-ipmi-providers_append_df-openpower = " \
    openpower-ipmi-oem \
"

PREFERRED_PROVIDER_virtual/obmc-host-ipmi-hw = "phosphor-ipmi-bt"
PREFERRED_PROVIDER_virtual/obmc-chassis-mgmt = "packagegroup-op-apps"
PREFERRED_PROVIDER_virtual/obmc-fan-mgmt = "packagegroup-op-apps"
PREFERRED_PROVIDER_virtual/obmc-flash-mgmt = "packagegroup-op-apps"
PREFERRED_PROVIDER_virtual/obmc-system-mgmt = "packagegroup-op-apps"
PREFERRED_PROVIDER_virtual/obmc-host-ctl ?= "obmc-op-control-host"
PREFERRED_PROVIDER_virtual/phosphor-ipmi-fru-hostfw-config ?= "hostboot-inventory-config-native"
PREFERRED_PROVIDER_virtual/openpower-fru-vpd-layout ?= "openpower-fru-vpd-layout-native"
PREFERRED_PROVIDER_virtual/openpower-fru-inventory ?= "openpower-fru-inventory-example-native"
PREFERRED_PROVIDER_virtual/openpower-fru-properties ?= "openpower-fru-properties-example-native"

# The openpower-occ-control application is data-driven and requires an input
# yaml of OCC instance numbers to sensor IDs.
# This virtual is a native recipe that provides that mapping by installing
# configuration files in the format and native sysroot location expected by
# the openpower-occ-control build process in the native sysroot.
PREFERRED_PROVIDER_virtual/openpower-occ-control-config-native ?= "openpower-occ-control-config-example-native"

#Default value for power supply output power efficiency.
POWER_SUPPLY_DERATING_FACTOR = "90"
```

## meta-openpower/conf/machine/include/p10.inc
```bitbake
include conf/machine/include/ibm-power10-cpu.inc
MACHINE_FEATURES += 'op-fsi'
PREFERRED_PROVIDER_virtual/obmc-host-ctl = "p9-host-start"
```

## meta-openpower/conf/machine/include/p9.inc
```bitbake
include conf/machine/include/ibm-power9-cpu.inc
OBMC_MACHINE_FEATURES += 'op-fsi p9-cfam-override'
PREFERRED_PROVIDER_virtual/obmc-host-ctl = "p9-host-start"
```

## meta-phosphor/conf/bblayers.conf.sample
```bitbake
# LAYER_CONF_VERSION is increased each time build/conf/bblayers.conf
# changes incompatibly
LCONF_VERSION = "8"

BBPATH = "${TOPDIR}"
BBFILES ?= ""

BBLAYERS ?= " \
  ##OEROOT##/meta \
  ##OEROOT##/meta-poky \
  ##OEROOT##/meta-openembedded/meta-oe \
  ##OEROOT##/meta-openembedded/meta-networking \
  ##OEROOT##/meta-openembedded/meta-python \
  ##OEROOT##/meta-phosphor \
  "
BBLAYERS_NON_REMOVABLE ?= " \
  ##OEROOT##/meta \
  ##OEROOT##/meta-poky \
  ##OEROOT##/meta-openembedded/meta-oe \
  ##OEROOT##/meta-openembedded/meta-networking \
  ##OEROOT##/meta-openembedded/meta-python \
  "
```

## meta-phosphor/conf/distro/include/google-authenticator-libpam.inc
```bitbake
DISTRO_FEATURES += "google-authenticator-libpam"
DISTROOVERRIDES .= ":df-google-authenticator-libpam"
```

## meta-phosphor/conf/distro/include/linux-audit.inc
```bitbake
# Core audit infrastructure for OpenBMC
# Enable for kernel audit and rules generation

DISTRO_FEATURES += "linux-audit"
DISTROOVERRIDES .= ":df-linux-audit"

# Install audit userspace utilities (auditd, ausearch, aureport, auditctl, etc.)
# Note: auditd is package being installed
#   - 'audit' = base libraries only
#   - 'auditd' = daemon and CLI tools (ausearch, aureport, auditctl, etc.)
IMAGE_INSTALL:append = " ${@bb.utils.contains('DISTRO_FEATURES', 'linux-audit', 'auditd', '', d)}"
```

## meta-phosphor/conf/distro/include/phosphor-aspeed-spi-master-mode.inc
```bitbake
DISTRO_FEATURES += "obmc-aspeed-spi-master"
DISTROOVERRIDES .= ":df-aspeed-spi-master"
```

## meta-phosphor/conf/distro/include/phosphor-aspeednic-use-mac2.inc
```bitbake
DISTRO_FEATURES += "obmc-aspeednic-use-mac2"
DISTROOVERRIDES .= ":df-aspeednic-use-mac2"
```

## meta-phosphor/conf/distro/include/phosphor-base.inc
```bitbake
require conf/distro/include/phosphor-defaults.inc

# Match the distro codename from upstream poky.
DISTRO_CODENAME ?= "scarthgap"

DISTROOVERRIDES .= ":openbmc-phosphor"

QEMU_TARGETS ?= "arm aarch64 i386 riscv32 riscv64 ppc64le x86_64"

PREMIRRORS ??= "\
bzr://.*/.*   http://downloads.yoctoproject.org/mirror/sources/ \n \
cvs://.*/.*   http://downloads.yoctoproject.org/mirror/sources/ \n \
git://.*/.*   http://downloads.yoctoproject.org/mirror/sources/ \n \
gitsm://.*/.* http://downloads.yoctoproject.org/mirror/sources/ \n \
hg://.*/.*    http://downloads.yoctoproject.org/mirror/sources/ \n \
osc://.*/.*   http://downloads.yoctoproject.org/mirror/sources/ \n \
p4://.*/.*    http://downloads.yoctoproject.org/mirror/sources/ \n \
svn://.*/.*   http://downloads.yoctoproject.org/mirror/sources/ \n"

MIRRORS =+ "\
ftp://.*/.*      http://downloads.yoctoproject.org/mirror/sources/ \n \
http://.*/.*     http://downloads.yoctoproject.org/mirror/sources/ \n \
https://.*/.*    http://downloads.yoctoproject.org/mirror/sources/ \n"

# The CONNECTIVITY_CHECK_URI's are used to test whether we can successfully
# fetch from the network (and warn you if not). To disable the test set
# the variable to be empty.
# Git example url: git://git.yoctoproject.org/yocto-firewall-test;protocol=https;rev=master
CONNECTIVITY_CHECK_URIS ?= "https://yoctoproject.org/connectivity.html"

SANITY_TESTED_DISTROS ?= " \
            poky-4.2 \n \
            poky-4.3 \n \
            ubuntu-18.04 \n \
            ubuntu-20.04 \n \
            ubuntu-22.04 \n \
            ubuntu-23.04 \n \
            fedora-38 \n \
            centosstream-8 \n \
            debian-11 \n \
            debian-12 \n \
            opensuseleap-15.4 \n \
            almalinux-8.8 \n \
            almalinux-9.2 \n \
            rocky-9 \n \
            "
#
# OELAYOUT_ABI allows us to notify users when the format of TMPDIR changes in
# an incompatible way. Such changes should usually be detailed in the commit
# that breaks the format and have been previously discussed on the mailing list
# with general agreement from the core team.
#
OELAYOUT_ABI = "15"

# QA check settings - a little stricter than the OE-Core defaults
WARN_TO_ERROR_QA = "already-stripped compile-host-path install-host-path \
                    installed-vs-shipped ldflags pn-overrides rpaths staticdev \
                    useless-rpaths"
WARN_QA:remove = "${WARN_TO_ERROR_QA}"
ERROR_QA:append = " ${WARN_TO_ERROR_QA}"

require conf/distro/include/no-static-libs.inc
require conf/distro/include/yocto-uninative.inc

DISTRO_NAME ?= "Phosphor OpenBMC (Phosphor OpenBMC Project Reference Distro)"
TARGET_VENDOR="-openbmc"


VIRTUAL-RUNTIME_keymaps = ""

# Phosphor OpenBMC uses systemd and udev
INIT_MANAGER = "systemd"
# systemd doesn't like us using /home/root instead of /root but we've been
# doing it a long time.  The `INIT_MANAGER = systemd` switches the default to
# /root, but we should switch it back (and maybe adjust in another commit).
ROOT_HOME = "/home/root"

# We generally want to persist /var/log, which is likely to be used for
# obmc-console and/or journald, unless PHOSPHOR_VOLATILE_VARLOG is set.
FILESYSTEM_PERMS_TABLES:remove = " \
        ${@bb.utils.contains("PHOSPHOR_VOLATILE_VARLOG", "1", "", "files/fs-perms-volatile-log.txt", d)} \
        "

DISTRO_FEATURES_BACKFILL_CONSIDERED = " \
        bluez5 \
        ldconfig \
        gobject-introspection-data \
        pulseaudio \
        "

DISTRO_FEATURES_OBMC = " \
        obmc-host-ctl \
        obmc-host-ipmi \
        obmc-phosphor-chassis-mgmt \
        obmc-phosphor-fan-mgmt \
        obmc-phosphor-flash-mgmt \
        obmc-phosphor-system-mgmt \
        "

DISTRO_FEATURES_DEFAULT = " \
        avahi \
        ipv4 \
        ipv6 \
        pam \
        security \
        slp \
        seccomp \
        "

DISTRO_FEATURES += " \
        ${DISTRO_FEATURES_DEFAULT} \
        ${DISTRO_FEATURES_OBMC} \
        "

DISTRO_EXTRA_RDEPENDS:remove:qemuarm = "packagegroup-core-device-devel"

include conf/distro/include/openbmc-phosphor/${MACHINE}.inc

IMAGE_CLASSES:append = " image_types_phosphor phosphor-rootfs-postcommands"
IMAGE_CLASSES:append:npcm7xx = " image_types_phosphor_nuvoton"
IMAGE_CLASSES:append:npcm8xx = " image_types_phosphor_nuvoton_npcm8xx"

IMAGE_INSTALL:append = " dbus-broker libnss-systemd"

# Skip the udev database by default.  It adds around 2MB
# compressed to the root filesystem, and probably doesn't
# make sense on a BMC anyway.
BAD_RECOMMENDATIONS += "udev-hwdb"
BAD_RECOMMENDATIONS += "shared-mime-info"
BAD_RECOMMENDATIONS += "systemd-mime"

# e2fsprogs isn't needed on a BMC without MMC, where it gets explicitly added
BAD_RECOMMENDATIONS += "e2fsprogs-e2fsck"

LAYER_CONF_VERSION ?= "8"

KERNEL_CLASSES:append = " obmc-phosphor-kernel-version"

# Some packages have directory trees of YAML files arranged based on
# canonical organization names.  'org/freedesktop' and 'xyz/openbmc_project'
# should be used everywhere in phosphor, but some layers may append this with
# their own organization(s).
OBMC_ORG_YAML_SUBDIRS += " org/freedesktop xyz/openbmc_project"

PREFERRED_VERSION_libgpiod = "1.6.5"

# Enable SBOM: https://docs.yoctoproject.org/next/dev-manual/sbom.html
INHERIT += "create-spdx"
```
