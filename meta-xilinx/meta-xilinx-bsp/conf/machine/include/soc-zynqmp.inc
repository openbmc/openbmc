## meta-xilinx/meta-xilinx-bsp/conf/machine/include/soc-zynqmp.inc
```bitbake
DEFAULTTUNE ?= "cortexa72-cortexa53"
SOC_FAMILY ?= "zynqmp"

# Available SOC_VARIANT's for zynqmp:
# "cg" - Zynq UltraScale+  CG Devices
# "eg" - Zynq UltraScale+  EG Devices
# "ev" - Zynq UltraScale+  EV Devices
# "dr" - Zynq UltraScale+  DR Devices

SOC_VARIANT ?= "eg"

MACHINEOVERRIDES_prepend_zynqmpeg = "mali400:"
MACHINEOVERRIDES_prepend_zynqmpev = "mali400:vcu:"

require soc-tune-include.inc
require xilinx-soc-family.inc

# Linux Configuration
KERNEL_IMAGETYPE ?= "Image"

# Support multilib on zynqmp
DEFAULTTUNE_virtclass-multilib-lib32 ?= "armv7vethf-neon-vfpv4"

WIC_DEPENDS ?= "virtual/kernel virtual/bootloader virtual/boot-bin virtual/arm-trusted-firmware"

UBOOT_SUFFIX ?= "bin"

XSERVER_EXT_zynqmp ?= "xf86-video-armsoc"
```

## meta-xilinx/meta-xilinx-bsp/conf/machine/include/tune-cortexrm.inc
```bitbake
DEFAULTTUNE ?= "cortexr5"

require conf/machine/include/arm/arch-armv8a.inc

TUNEVALID[armrm] = "Enable ARM Cortex-R/M Family"
MACHINEOVERRIDES =. "${@bb.utils.contains('TUNE_FEATURES', 'armrm', 'armrm:', '' ,d)}"

TUNEVALID[cortexr5] = "Enable Cortex-r5 specific processor optimizations"
TUNE_CCARGS .= "${@bb.utils.contains('TUNE_FEATURES', 'cortexr5', ' -mcpu=cortex-r5', '', d)}"

AVAILTUNES += "cortexr5"
ARMPKGARCH_tune-cortexr5 = "cortexr5"

TUNE_FEATURES_tune-cortexr5 = "armrm cortexr5"
PACKAGE_EXTRA_ARCHS_tune-cortexr5 = "${TUNE_PKGARCH}"

AVAILTUNES += "cortexr5f"
ARMPKGARCH_tune-cortexr5f = "cortexr5f"

TUNE_FEATURES_tune-cortexr5f = "armrm cortexr5 vfpv3d16 callconvention-hard"
PACKAGE_EXTRA_ARCHS_tune-cortexr5f = "${TUNE_PKGARCH}"
```

## meta-xilinx/meta-xilinx-bsp/conf/machine/include/tune-versal.inc
```bitbake
DEFAULTTUNE ?= "aarch64"
SOC_FAMILY ?= "versal"

# Available SOC_VARIANT's for versal:
# virt

SOC_VARIANT ?= ""

require conf/machine/include/arm/arch-armv8.inc
require conf/machine/include/soc-family.inc

# Linux Configuration
KERNEL_IMAGETYPE ?= "Image"
```

## meta-xilinx/meta-xilinx-bsp/conf/machine/include/tune-zynq.inc
```bitbake
DEFAULTTUNE ?= "cortexa9thf-neon"
SOC_FAMILY ?= "zynq"

# Available SOC_VARIANT's for zynq:
# 7zs - Zynq-7000 Single A9 Core
# 7z  - Zynq-7000 Dual A9 Core

SOC_VARIANT ?= "7z"

require conf/machine/include/tune-cortexa9.inc
require conf/machine/include/soc-family.inc

# Linux Configuration
KERNEL_IMAGETYPE ?= "uImage"

# Set default load address.
# Override with KERNEL_EXTRA_ARGS_<board> += "..." in machine file if required
KERNEL_EXTRA_ARGS_zynq += "UIMAGE_LOADADDR=0x8000"
```

## meta-xilinx/meta-xilinx-bsp/conf/machine/include/tune-zynqmp.inc
```bitbake
DEFAULTTUNE ?= "aarch64"
SOC_FAMILY ?= "zynqmp"

# Available SOC_VARIANT's for zynqmp:
# "cg" - Zynq UltraScale+  CG Devices
# "eg" - Zynq UltraScale+  EG Devices
# "ev" - Zynq UltraScale+  EV Devices

SOC_VARIANT ?= "eg"

require conf/machine/include/arm/arch-armv8.inc
require conf/machine/include/soc-family.inc

# Linux Configuration
KERNEL_IMAGETYPE ?= "Image"

# Support multilib on zynqmp
DEFAULTTUNE_virtclass-multilib-lib32 ?= "armv7vethf-neon-vfpv4"
```

## meta-xilinx/meta-xilinx-bsp/conf/machine/include/xilinx-board.inc
```bitbake
BOARD ??= ""
BOARD_VARIANT ??= ""

MACHINEOVERRIDES =. "${@['', '${BOARD}:']['${BOARD}' != '']}"
MACHINEOVERRIDES =. "${@['', '${BOARD}${BOARD_VARIANT}:']['${BOARD_VARIANT}' != '']}"


BOARD_ARCH ?= "${BOARD}"
BOARDVARIANT_ARCH ?= "${BOARD}${BOARD_VARIANT}"

PACKAGE_EXTRA_ARCHS_append = " ${BOARD_ARCH}"
PACKAGE_EXTRA_ARCHS_append = "${@['', ' ${BOARDVARIANT_ARCH}'][d.getVar('BOARDVARIANT_ARCH') != d.getVar('BOARD_ARCH')]}"
```

## meta-xilinx/meta-xilinx-bsp/conf/machine/include/xilinx-soc-family.inc
```bitbake
require conf/machine/include/soc-family.inc

SOC_VARIANT ??= ""
MACHINEOVERRIDES =. "${@['', '${SOC_FAMILY}${SOC_VARIANT}:']['${SOC_VARIANT}' != '']}"

SOC_FAMILY_ARCH ?= "${SOC_FAMILY}"
SOC_VARIANT_ARCH ?= "${SOC_FAMILY}${SOC_VARIANT}"

PACKAGE_EXTRA_ARCHS_append = " ${SOC_FAMILY_ARCH}"
PACKAGE_EXTRA_ARCHS_append = "${@['', ' ${SOC_VARIANT_ARCH}'][d.getVar('SOC_VARIANT_ARCH') != d.getVar('SOC_FAMILY_ARCH')]}"
```

## meta-xilinx/meta-xilinx-bsp/conf/machine/include/zynqmp-pmu-config.inc
```bitbake
# Enable the use of zynqmp-pmu for specific recipes only
def zynqmp_pmu_enable_for_bpns(d):
    bpn = d.getVar("BPN")
    crossbpns = ["binutils", "gcc"]
    targetbpns = ["libgcc", "newlib", "libgloss"]
    if bpn in targetbpns:
        return True
    if bpn in crossbpns and bb.data.inherits_class('cross', d):
        return True
    return False

BBCLASSEXTEND_append = "${@' zynqmp-pmu' if zynqmp_pmu_enable_for_bpns(d) else ''}"

# Add the pkgarch to the extra list, this is done to avoid warnings about
# missing manifests due to implicit dependency chains on populate_sysroot when
# a recipe/task depends on a IMAGE_EXTRADEPENDS/do_deploy task which is
# provided by a zynqmp-pmu-* target.
PACKAGE_EXTRA_ARCHS_append = " microblazeel-v9.2-bs-cmp"
```

## meta-xilinx/meta-xilinx-bsp/conf/machine/kc705-microblazeel.conf
```bitbake
#@TYPE: Machine
#@NAME: kc705-microblazeel
#@DESCRIPTION: Machine support for Xilinx KC705 Embedded Kit.
#

require conf/machine/include/tune-microblaze.inc
require conf/machine/include/machine-xilinx-default.inc

TUNE_FEATURES_tune-microblaze += "v11.0 barrel-shift reorder pattern-compare multiply-high divide-hard"

MACHINE_FEATURES = ""

USE_VT = ""
SERIAL_CONSOLES ?= "115200;ttyS0"

KERNEL_IMAGETYPE ?= "linux.bin.ub"

MACHINE_ESSENTIAL_EXTRA_RDEPENDS += "device-tree"

EXTRA_IMAGEDEPENDS += "virtual/bitstream virtual/bootloader"

UBOOT_MACHINE = "microblaze-generic_defconfig"
```
