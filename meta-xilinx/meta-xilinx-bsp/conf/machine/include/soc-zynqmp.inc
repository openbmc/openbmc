## meta-xilinx/meta-xilinx-bsp/conf/machine/zc702-zynq7.conf
```bitbake
#@TYPE: Machine
#@NAME: zc702-zynq7
#@DESCRIPTION: Machine support for ZC702 Evaluation Board.
#
# For details on the Evaluation board:
#     http://www.xilinx.com/products/boards-and-kits/EK-Z7-ZC702-G.htm
# For documentation and design files for the ZC702:
#     http://www.xilinx.com/support/index.html/content/xilinx/en/supportNav/boards_and_kits/zynq-7000_soc_boards_and_kits/zynq-7000_soc_zc702_evaluation_kit.html
# For the FSBL 'zynq_fsbl_0.elf' refer to UG873 and the associated design files.
#
SOC_VARIANT ?= "7z"

require conf/machine/include/tune-zynq.inc
require conf/machine/include/machine-xilinx-overrides.inc
require conf/machine/include/machine-xilinx-default.inc
require conf/machine/include/machine-xilinx-board.inc
require conf/machine/include/machine-xilinx-qemu.inc

MACHINE_FEATURES = "rtc ext2 ext3 vfat usbhost"

# u-boot configuration
UBOOT_MACHINE = "zynq_zc702_config"
SPL_BINARY = "spl/boot.bin"

EXTRA_IMAGEDEPENDS += " \
		u-boot-zynq-uenv \
		virtual/boot-bin \
		"

SERIAL_CONSOLE = "115200 ttyPS0"

KERNEL_DEVICETREE = "zynq-zc702.dtb"

IMAGE_BOOT_FILES += "boot.bin uEnv.txt ${KERNEL_IMAGETYPE}-zynq-zc702.dtb"

# Although not fully supported you can run this machine on the mainline QEMU 'xilinx-zynq-a9' machine
IMAGE_CLASSES += "qemuboot"
QB_MEM = "-m 1024"
QB_MACHINE = "-machine xilinx-zynq-a9"
QB_OPT_APPEND = "-nographic -serial null -serial mon:stdio"
QB_NETWORK_DEVICE = "-net nic,netdev=net0,macaddr=@MAC@"

# Xilinx's fork of QEMU has much better results, so let's default to that
# Use qemu-xilinx instead of mainline
PREFERRED_PROVIDER_qemu-helper-native = "qemu-xilinx-helper-native"

IMAGE_CLASSES += "qemuboot-xilinx"
```
