## meta-xilinx/meta-xilinx-bsp/conf/machine/microblazeel-v11.0-bs-cmp-mh-div-generic.conf
```bitbake
#@TYPE: Machine
#@NAME: microblazeel-v11.0-bs-cmp-mh-div-generic
#@DESCRIPTION: microblazeel-v11.0-bs-cmp-mh-div

require conf/machine/include/tune-microblaze.inc
require conf/machine/include/machine-xilinx-default.inc

TUNE_FEATURES_tune-microblaze += "v11.0 barrel-shift pattern-compare reorder divide-hard multiply-high"

MACHINE_FEATURES = ""

KERNEL_IMAGETYPE = "linux.bin.ub"
KERNEL_IMAGETYPES = ""

SERIAL_CONSOLES ?= "115200;ttyS0"

EXTRA_IMAGEDEPENDS += "libyaml-native python3-cython-native python3-pyyaml-native"
```

## meta-xilinx/meta-xilinx-bsp/conf/machine/microblazeel-v11.0-bs-cmp-ml-generic.conf
```bitbake
#@TYPE: Machine
#@NAME: microblazeel-v11.0-bs-cmp-ml-generic
#@DESCRIPTION: microblazeel-v11.0-bs-cmp-ml

require conf/machine/include/tune-microblaze.inc
require conf/machine/include/machine-xilinx-default.inc

TUNE_FEATURES_tune-microblaze += "v11.0 barrel-shift reorder pattern-compare multiply-low"

MACHINE_FEATURES = ""

KERNEL_IMAGETYPE = "linux.bin.ub"
KERNEL_IMAGETYPES = ""

SERIAL_CONSOLES ?= "115200;ttyS0"

EXTRA_IMAGEDEPENDS += "libyaml-native python3-cython-native python3-pyyaml-native"
```

## meta-xilinx/meta-xilinx-bsp/conf/machine/microzed-zynq7.conf
```bitbake
#@TYPE: Machine
#@NAME: microzed-zynq7
#@DESCRIPTION: Machine support for microZed. (http://www.microzed.org/)

require conf/machine/include/soc-zynq.inc
require conf/machine/include/machine-xilinx-default.inc

MACHINE_FEATURES = "ext2 vfat usbhost"

# u-boot configuration
PREFERRED_PROVIDER_virtual/bootloader = "u-boot"
UBOOT_MACHINE = "xilinx_zynq_virt_defconfig"
SPL_BINARY ?= "spl/boot.bin"
UBOOT_ELF = "u-boot"

EXTRA_IMAGEDEPENDS += " \
		u-boot-zynq-uenv \
		virtual/boot-bin \
		virtual/bootloader \
		u-boot-zynq-scr \
		"

SERIAL_CONSOLES ?= "115200;ttyPS0"

KERNEL_DEVICETREE = "zynq-microzed.dtb"

IMAGE_BOOT_FILES += " \
		boot.bin \
		uEnv.txt \
		"
```

## meta-xilinx/meta-xilinx-bsp/conf/machine/ml605-qemu-microblazeel.conf
```bitbake
#@TYPE: Machine
#@NAME: ml605-qemu-microblazeel
#@DESCRIPTION: MicroBlaze QEMU machine support ('petalogix-ml605' model)

require conf/machine/include/tune-microblaze.inc
require conf/machine/include/machine-xilinx-default.inc
require conf/machine/include/machine-xilinx-qemu.inc

TUNE_FEATURES_tune-microblaze += "v8.50 barrel-shift reorder pattern-compare divide-hard multiply-high fpu-hard"

MACHINE_FEATURES = ""

USE_VT = ""
SERIAL_CONSOLES ?= "115200;ttyS0"

KERNEL_IMAGETYPE ?= "linux.bin.ub"

# Use the networking setup from qemuarm
MACHINEOVERRIDES_prepend_pn-init-ifupdown = "qemuall:"
FILESOVERRIDES_append_pn-init-ifupdown = ":qemuarm"

# This machine is a targeting a QEMU model, runqemu setup:
QB_MEM = "-m 256"
QB_MACHINE = "-machine petalogix-ml605"
QB_OPT_APPEND = "-nographic -serial mon:stdio"
QB_NETWORK_DEVICE = "-net nic,netdev=net0,macaddr=@MAC@"
```

## meta-xilinx/meta-xilinx-bsp/conf/machine/picozed-zynq7.conf
```bitbake
#@TYPE: Machine
#@NAME: picozed-zynq7
#@DESCRIPTION: Machine support for picoZed. (http://www.picozed.org/)
#
# Note: This machine configuration is intended as a generic config for
# the picozed SOM. It also covers the multiple SKUs for the picoZed
# including 7010, 7020, 7015 and 7030.

require conf/machine/include/soc-zynq.inc
require conf/machine/include/machine-xilinx-default.inc

MACHINE_FEATURES = "ext2 vfat usbhost usbgadget"

# u-boot configuration
PREFERRED_PROVIDER_virtual/bootloader = "u-boot"
UBOOT_MACHINE = "xilinx_zynq_virt_defconfig"
SPL_BINARY ?= "spl/boot.bin"
UBOOT_ELF = "u-boot"

EXTRA_IMAGEDEPENDS += " \
		u-boot-zynq-uenv \
		virtual/boot-bin \
		virtual/bootloader \
		u-boot-zynq-scr \
		"

SERIAL_CONSOLES ?= "115200;ttyPS0"

MACHINE_ESSENTIAL_EXTRA_RDEPENDS += "device-tree"

IMAGE_BOOT_FILES += " \
		boot.bin \
		uEnv.txt \
		"
```

## meta-xilinx/meta-xilinx-bsp/conf/machine/qemu-zynq7.conf
```bitbake
#@TYPE: Machine
#@NAME: qemu-zynq7
#@DESCRIPTION: Zynq QEMU machine support ('xilinx-zynq-a9' model)

SOC_VARIANT ?= "7z"

require conf/machine/include/tune-zynq.inc
require conf/machine/include/machine-xilinx-overrides.inc
require conf/machine/include/machine-xilinx-default.inc
require conf/machine/include/machine-xilinx-qemu.inc

MACHINE_FEATURES = "ext2 vfat"

SERIAL_CONSOLE = "115200 ttyPS0"

MACHINE_ESSENTIAL_EXTRA_RDEPENDS += "device-tree"
IMAGE_BOOT_FILES += "${MACHINE}.dtb"

# Use the networking setup from qemuarm
FILESOVERRIDES_append_pn-init-ifupdown = ":qemuarm"

# This machine is a targeting a QEMU model, runqemu setup:
IMAGE_CLASSES += "qemuboot"
QB_MEM = "-m 1024"
QB_MACHINE = "-machine xilinx-zynq-a9"
QB_OPT_APPEND = "-nographic -serial null -serial mon:stdio"
QB_NETWORK_DEVICE = "-net nic,netdev=net0,macaddr=@MAC@"
```

## meta-xilinx/meta-xilinx-bsp/conf/machine/s3adsp1800-qemu-microblazeeb.conf
```bitbake
#@TYPE: Machine
#@NAME: s3adsp1800-qemu-microblazeeb
#@DESCRIPTION: MicroBlaze QEMU machine support ('petalogix-s3adsp1800' model)

require conf/machine/include/tune-microblaze.inc
require conf/machine/include/machine-xilinx-default.inc
require conf/machine/include/machine-xilinx-qemu.inc

TUNE_FEATURES_tune-microblaze += "v8.00 bigendian barrel-shift pattern-compare multiply-low"

MACHINE_FEATURES = ""

USE_VT = ""
SERIAL_CONSOLES ?= "115200;ttyUL0"

KERNEL_IMAGETYPE ?= "linux.bin.ub"

# This machine is a targeting a QEMU model, runqemu setup:
QB_MEM = "-m 256"
QB_MACHINE = "-machine petalogix-s3adsp1800"
QB_OPT_APPEND = "-nographic -serial mon:stdio"
QB_NETWORK_DEVICE = "-net nic,netdev=net0,macaddr=@MAC@"
```

## meta-xilinx/meta-xilinx-bsp/conf/machine/system-zcu102.conf
```bitbake
#@TYPE: Machine
#@NAME: system-zcu102
#@DESCRIPTION: Machine supporting the architectures in the ZCU102 evaluation board.

# This machine sets up a build for a heterogeneous architecture board.
# In this specific case, this refers to a zcu102-zynqmp board, which
# should build artifacts for the hard microblaze architecture, and the
# cortex-a53.

# This is meant to be used as a base case and adapting it to
# other boards should be fairly simple.

# To build a full system, simply invoke the command:
# $ bitbake <image>
# which is analogous to
# $ bitbake mc::<image>
# Where image can be core-image-minimal for example
# If a user wants to build a package for a certain architecture
# a similar command can be invoked, just changing the parameter
# between : and : to the desired multiconfig from one of the
# declared values below.
# For example, to build the xilstandalone library for the microblaze:
# $ bitbake mc:pmumc:xilstandalone
# or to build fsbl for cortexa53:
# $ bitbake mc:fsblmc:zyqmp-fsbl


# These artifacts are the pmu firmware along with the fsbl and the
# Linux OS respectively

# Keep in mind that there would still be a wiring required to merge
# the artifacts from their respective deploy directories using bootgen.
BBMULTICONFIG = "fsblmc pmumc"

# The following should be changed to the machine which corresponds to
# the architecture of a specific device, in this case cortexa53
# But there are several hard coded expected values from several
# repos, e.g. linux-xlnx which expects a defconfig depending on
# the machine that is being used, as a TEMPORARY solution and
# to prove how multiconfig can be used to build a full system
# with heterogeneous architectures we'll use MACHINE=zcu102-zynqmp.

# The downside is that this stills needs xsct and would technically
# build two pmu firmwrares and two fsbls, one coming from our
# multiconfig and one that uses xsct respectively, once the values
# mentioned above are fixed, this should work properly with:
# MACHINE = "cortexa53-zynqmp"

MACHINE = "zcu102-zynqmp"
require conf/machine/${MACHINE}.conf

# Use the same format for TMPDIR  as in the other multiconfigs so its less confusing.
TMPDIR = "${TOPDIR}/tmp-${MACHINE}-${TCLIBC}"

# Create dependencies for Linux only, other multiconfig applications,
# can be built separately, e.g. bitbake mc:pmumc:pmufw
# in this case, linux cannot, also worth mentioning that these should
# eventually be set on a recipe level and would probably be useful to
# create a chain of dependencies: pmufw<-fsbl<-Linux
do_image[mcdepends] += "multiconfig::fsblmc:zynqmp-fsbl:do_deploy"
do_image[mcdepends] += "multiconfig::pmumc:pmufw:do_deploy"
```

## meta-xilinx/meta-xilinx-bsp/conf/machine/ultra96-zynqmp.conf
```bitbake
#@TYPE: Machine
#@NAME: ultra96-zynqmp
#@DESCRIPTION: Machine support for Ultra96 Evaluation Board.
#

require conf/machine/include/soc-zynqmp.inc
require conf/machine/include/machine-xilinx-default.inc
require conf/machine/include/xilinx-board.inc

BOARD = "ultra96"

MACHINE_FEATURES = "rtc ext2 ext3 vfat usbhost usbgadget wifi bluetooth mipi"

UBOOT_MACHINE = "xilinx_zynqmp_virt_defconfig"
SPL_BINARY ?= "spl/boot.bin"

SERIAL_CONSOLES ?= "115200;ttyPS0"


KERNEL_DEVICETREE = "xilinx/zynqmp-zcu100-revC.dtb"

PMU_FIRMWARE_IMAGE_NAME ?= "pmu-firmware-zynqmp-pmu"
PMU_FIRMWARE_DEPLOY_DIR ?= "${TOPDIR}/pmutmp/deploy/images/zynqmp-pmu"

EXTRA_IMAGEDEPENDS += " \
		u-boot-zynq-uenv \
		arm-trusted-firmware \
		virtual/boot-bin \
		virtual/bootloader \
		u-boot-zynq-scr \
		"
IMAGE_BOOT_FILES += " \
               uEnv.txt \
               atf-uboot.ub \
               boot.scr \
               "
MACHINE_ESSENTIAL_EXTRA_RRECOMMENDS += "linux-firmware-wl18xx"
```

## meta-xilinx/meta-xilinx-bsp/conf/machine/v350-versal.conf
```bitbake
#@TYPE: Machine
#@NAME: v350-versal
##@DESCRIPTION: Machine support for v350 versal.

require conf/machine/include/soc-versal.inc
require conf/machine/include/machine-xilinx-default.inc

MACHINE_FEATURES = "rtc ext2 ext3 vfat usbhost"

UBOOT_MACHINE ?= "xilinx_versal_virt_defconfig"

SERIAL_CONSOLES ?= "115200;ttyAMA0"

EXTRA_IMAGEDEPENDS += " \
   arm-trusted-firmware \
   virtual/boot-bin \
   virtual/bootloader \
   virtual/psm-firmware \
   virtual/plm \
   u-boot-zynq-scr \
"

IMAGE_BOOT_FILES += " \
    boot.bin \
    ${@bb.utils.contains('PREFERRED_PROVIDER_virtual/dtb', 'device-tree', 'system.dtb', '', d)} \
    Image \
    boot.scr \
"
```

## meta-xilinx/meta-xilinx-bsp/conf/machine/vck-sc-zynqmp.conf
```bitbake
#@TYPE: Machine
#@NAME: vck-sc-zynqmp 
##@DESCRIPTION: Machine support for vck190 system controller.


require conf/machine/include/soc-zynqmp.inc
require conf/machine/include/machine-xilinx-default.inc

MACHINE_FEATURES = "rtc ext2 ext3 vfat usbhost"

UBOOT_MACHINE ?= "xilinx_zynqmp_virt_defconfig"
SPL_BINARY ?= "spl/boot.bin"

SERIAL_CONSOLES ?= "115200;ttyPS0"

# PMU instance args
PMU_FIRMWARE_DEPLOY_DIR ?= "${TOPDIR}/pmutmp/deploy/images/zynqmp-pmu"
PMU_FIRMWARE_IMAGE_NAME ?= "pmu-firmware-zynqmp-pmu"

EXTRA_IMAGEDEPENDS += " \
   u-boot-zynq-uenv \
   arm-trusted-firmware \
   virtual/boot-bin \
   virtual/bootloader \
   u-boot-zynq-scr \
"
IMAGE_BOOT_FILES += " \
    uEnv.txt \
    atf-uboot.ub \
    boot.scr \
"
```

## meta-xilinx/meta-xilinx-bsp/conf/machine/versal-mb.conf
```bitbake
DEFAULTTUNE ?= "microblaze"

require conf/machine/include/soc-versal.inc

# Endianess, multiplier, barrel shift, pattern compare, floating point double or single, are the possibilities
AVAILTUNES += "microblaze"
TUNE_FEATURES_tune-microblaze = "microblaze v11.0 barrel-shift pattern-compare"
PACKAGE_EXTRA_ARCHS_tune-microblaze = "${TUNE_PKGARCH}"

LINKER_HASH_STYLE_microblaze = ""
```

## meta-xilinx/meta-xilinx-bsp/conf/machine/vmk180-versal.conf
```bitbake
#@TYPE: Machine
#@NAME: vmk180-versal
##@DESCRIPTION: Machine support for vmk180-versal .

require conf/machine/include/soc-versal.inc
require conf/machine/include/machine-xilinx-default.inc
require conf/machine/include/machine-xilinx-qemu.inc

MACHINE_FEATURES = "rtc ext2 ext3 vfat usbhost"

UBOOT_MACHINE ?= "xilinx_versal_virt_defconfig"

SERIAL_CONSOLES ?= "115200;ttyAMA0"

IMAGE_CLASSES += "image-types-xilinx-qemu"
IMAGE_FSTYPES += "wic.qemu-sd"
WKS_FILES ?= "sdimage-bootpart.wks"

EXTRA_IMAGEDEPENDS += " \
   arm-trusted-firmware \
   virtual/boot-bin \
   virtual/bootloader \
   virtual/psm-firmware \
   virtual/plm \
   u-boot-zynq-scr \
   qemu-devicetrees \
   virtual/cdo \
"

IMAGE_BOOT_FILES += " \
    boot.bin \
    ${@bb.utils.contains('PREFERRED_PROVIDER_virtual/dtb', 'device-tree', 'system.dtb', '', d)} \
    Image \
    boot.scr \
"

# This machine has a QEMU model, runqemu setup:
QB_MEM = "-m 8G"
QB_DEFAULT_KERNEL = "none"
QB_NETWORK_DEVICE = ""
QB_KERNEL_CMDLINE_APPEND ?= ""
QB_NET = "none"

QB_DEFAULT_FSTYPE_qemuboot-xilinx = "wic.qemu-sd"
QB_OPT_APPEND_append_qemuboot-xilinx = " -boot mode=5"
QB_ROOTFS_OPT_qemuboot-xilinx = " -drive if=sd,index=1,file=@ROOTFS@,format=raw"

# Use booti 80000 6000000 4000000 to launch
QB_OPT_APPEND ?= " -serial null -serial null -serial mon:stdio -display none"

QB_OPT_APPEND_append_qemuboot-xilinx = " \
    -hw-dtb ${DEPLOY_DIR_IMAGE}/qemu-hw-devicetrees/multiarch/board-versal-ps-vc-p-a2197-00.dtb \
    -display none \
    -net nic -net user,tftp=${DEPLOY_DIR_IMAGE} \
    "

# PLM instance args
QB_PLM_OPT = " \
    -M microblaze-fdt \
    -device loader,file=${DEPLOY_DIR_IMAGE}/BOOT-${MACHINE}_bh.bin,addr=0xF201E000,force-raw  \
    -device loader,addr=0xf0000000,data=0xba020004,data-len=4 \
    -device loader,addr=0xf0000004,data=0xb800fffc,data-len=4 \
    -device loader,file=${DEPLOY_DIR_IMAGE}/CDO/pmc_cdo.bin,addr=0xf2000000,force-raw \
    -device loader,file=${DEPLOY_DIR_IMAGE}/plm-${MACHINE}.elf,cpu-num=1 \
    -device loader,addr=0xF1110624,data=0x0,data-len=4 \
    -device loader,addr=0xF1110620,data=0x1,data-len=4 \
    -hw-dtb ${DEPLOY_DIR_IMAGE}/qemu-hw-devicetrees/multiarch/board-versal-pmc-vc-p-a2197-00.dtb \
    -display none \
    "
QB_OPT_APPEND_append_qemuboot-xilinx = " -plm-args '${QB_PLM_OPT}'"
```

## meta-xilinx/meta-xilinx-bsp/conf/machine/zc1275-zynqmp.conf
```bitbake
#@TYPE: Machine
#@NAME: zc1275-zynqmp
#@DESCRIPTION: Machine support for ZC1275 Evaluation Board.
#

SOC_VARIANT ?= "dr"

require conf/machine/include/tune-zynqmp.inc
require conf/machine/include/machine-xilinx-overrides.inc
require conf/machine/include/machine-xilinx-default.inc

MACHINE_FEATURES = "rtc ext2 ext3 vfat usbhost"

UBOOT_MACHINE = "xilinx_zynqmp_zc1275_revB_defconfig"
SPL_BINARY ?= "spl/boot.bin"

SERIAL_CONSOLE ?= "115200 ttyPS0"

SERIAL_CONSOLES_CHECK = "${SERIAL_CONSOLES}"

KERNEL_DEVICETREE = "xilinx/zynqmp-zc1275-revB.dtb"

PREFERRED_PROVIDER_virtual/kernel ?= "linux-xlnx"
PREFERRED_PROVIDER_virtual/bootloader ?= "u-boot-xlnx"

PMU_FIRMWARE_IMAGE_NAME ?= "pmu-firmware-zynqmp-pmu"
PMU_FIRMWARE_DEPLOY_DIR ?= "${TOPDIR}/pmutmp/deploy/images/zynqmp-pmu"

EXTRA_IMAGEDEPENDS += " \
		u-boot-zynq-uenv \
		arm-trusted-firmware \
		virtual/boot-bin \
		virtual/bootloader \
		"
IMAGE_BOOT_FILES += " \
		uEnv.txt \
		atf-uboot.ub \
		"
```
