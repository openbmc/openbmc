## meta-xilinx/meta-xilinx-bsp/conf/machine/microblaze-tc.conf
```bitbake
require conf/multilib.conf
require conf/machine/include/microblaze/arch-microblaze.inc
require conf/machine/include/baremetal-tc.conf

# ILP request an alternative machine dictionary
INHERIT += "xlnx-standalone"
PACKAGEQA_EXTRA_MACHDEFFUNCS .= '${@bb.utils.contains("TUNE_FEATURES", "64-bit", " xlnx_mb64_dict", "", d)}'

# GNU hash style not supported
LINKER_HASH_STYLE_microblaze = ""

# Define all of the multilibs supproted by this configuration
MULTILIB_GLOBAL_VARIANTS = "${@extend_variants(d,'MULTILIBS','multilib')}"

MULTILIBS += "multilib:libmble"
MULTILIBS += "multilib:libmbbs"
MULTILIBS += "multilib:libmbp"
MULTILIBS += "multilib:libmbm"
MULTILIBS += "multilib:libmbfpd"
MULTILIBS += "multilib:libmbmfpd"
MULTILIBS += "multilib:libmbpm"
MULTILIBS += "multilib:libmbpfpd"
MULTILIBS += "multilib:libmbpmfpd"
MULTILIBS += "multilib:libmbbsp"
MULTILIBS += "multilib:libmbbsm"
MULTILIBS += "multilib:libmbbsfpd"
MULTILIBS += "multilib:libmbbsmfpd"
MULTILIBS += "multilib:libmbbspm"
MULTILIBS += "multilib:libmbbspfpd"
MULTILIBS += "multilib:libmbbspmfpd"
MULTILIBS += "multilib:libmblem64"
MULTILIBS += "multilib:libmblebs"
MULTILIBS += "multilib:libmblep"
MULTILIBS += "multilib:libmblem"
MULTILIBS += "multilib:libmblefpd"
MULTILIBS += "multilib:libmblemfpd"
MULTILIBS += "multilib:libmblepm"
MULTILIBS += "multilib:libmblepfpd"
MULTILIBS += "multilib:libmblepmfpd"
MULTILIBS += "multilib:libmblebsp"
MULTILIBS += "multilib:libmblebsm"
MULTILIBS += "multilib:libmblebsfpd"
MULTILIBS += "multilib:libmblebsmfpd"
MULTILIBS += "multilib:libmblebspm"
MULTILIBS += "multilib:libmblebspfpd"
MULTILIBS += "multilib:libmblebspmfpd"
MULTILIBS += "multilib:libmblem64bs"
MULTILIBS += "multilib:libmblem64p"
MULTILIBS += "multilib:libmblem64m"
MULTILIBS += "multilib:libmblem64fpd"
MULTILIBS += "multilib:libmblem64mfpd"
MULTILIBS += "multilib:libmblem64pm"
MULTILIBS += "multilib:libmblem64pfpd"
MULTILIBS += "multilib:libmblem64pmfpd"
MULTILIBS += "multilib:libmblem64bsp"
MULTILIBS += "multilib:libmblem64bsm"
MULTILIBS += "multilib:libmblem64bsfpd"
MULTILIBS += "multilib:libmblem64bsmfpd"
MULTILIBS += "multilib:libmblem64bspm"
MULTILIBS += "multilib:libmblem64bspfpd"
MULTILIBS += "multilib:libmblem64bspmfpd"


# Base configuration
# CFLAGS:
DEFAULTTUNE = "microblaze"

AVAILTUNES += "microblaze"
BASE_LIB_tune-microblaze = "lib"
TUNE_FEATURES_tune-microblaze = "microblaze bigendian"
PACKAGE_EXTRA_ARCHS_tune-microblaze = "${TUNE_PKGARCH}"


# le
# CFLAGS: -mlittle-endian
DEFAULTTUNE_virtclass-multilib-libmble = "microblazele"

AVAILTUNES += "microblazele"
BASE_LIB_tune-microblazele = "lib/le"
TUNE_FEATURES_tune-microblazele = "microblaze"
PACKAGE_EXTRA_ARCHS_tune-microblazele = "${TUNE_PKGARCH}"


# bs
# CFLAGS: -mxl-barrel-shift
DEFAULTTUNE_virtclass-multilib-libmbbs = "microblazebs"

AVAILTUNES += "microblazebs"
BASE_LIB_tune-microblazebs = "lib/bs"
TUNE_FEATURES_tune-microblazebs = "microblaze bigendian barrel-shift"
PACKAGE_EXTRA_ARCHS_tune-microblazebs = "${TUNE_PKGARCH}"


# p
# CFLAGS: -mxl-pattern-compare
DEFAULTTUNE_virtclass-multilib-libmbp = "microblazep"

AVAILTUNES += "microblazep"
BASE_LIB_tune-microblazep = "lib/p"
TUNE_FEATURES_tune-microblazep = "microblaze bigendian pattern-compare"
PACKAGE_EXTRA_ARCHS_tune-microblazep = "${TUNE_PKGARCH}"


# m
# CFLAGS: -mno-xl-soft-mul
DEFAULTTUNE_virtclass-multilib-libmbm = "microblazem"

AVAILTUNES += "microblazem"
BASE_LIB_tune-microblazem = "lib/m"
TUNE_FEATURES_tune-microblazem = "microblaze bigendian multiply-low"
PACKAGE_EXTRA_ARCHS_tune-microblazem = "${TUNE_PKGARCH}"


# fpd
# CFLAGS: -mhard-float
DEFAULTTUNE_virtclass-multilib-libmbfpd = "microblazefpd"

AVAILTUNES += "microblazefpd"
BASE_LIB_tune-microblazefpd = "lib/fpd"
TUNE_FEATURES_tune-microblazefpd = "microblaze bigendian fpu-hard"
PACKAGE_EXTRA_ARCHS_tune-microblazefpd = "${TUNE_PKGARCH}"


# m/fpd
# CFLAGS: -mno-xl-soft-mul -mhard-float
DEFAULTTUNE_virtclass-multilib-libmbmfpd = "microblazemfpd"

AVAILTUNES += "microblazemfpd"
BASE_LIB_tune-microblazemfpd = "lib/m/fpd"
TUNE_FEATURES_tune-microblazemfpd = "microblaze bigendian multiply-low fpu-hard"
PACKAGE_EXTRA_ARCHS_tune-microblazemfpd = "${TUNE_PKGARCH}"


# p/m
# CFLAGS: -mxl-pattern-compare -mno-xl-soft-mul
DEFAULTTUNE_virtclass-multilib-libmbpm = "microblazepm"

AVAILTUNES += "microblazepm"
BASE_LIB_tune-microblazepm = "lib/p/m"
TUNE_FEATURES_tune-microblazepm = "microblaze bigendian pattern-compare multiply-low"
PACKAGE_EXTRA_ARCHS_tune-microblazepm = "${TUNE_PKGARCH}"


# p/fpd
# CFLAGS: -mxl-pattern-compare -mhard-float
DEFAULTTUNE_virtclass-multilib-libmbpfpd = "microblazepfpd"

AVAILTUNES += "microblazepfpd"
BASE_LIB_tune-microblazepfpd = "lib/p/fpd"
TUNE_FEATURES_tune-microblazepfpd = "microblaze bigendian pattern-compare fpu-hard"
PACKAGE_EXTRA_ARCHS_tune-microblazepfpd = "${TUNE_PKGARCH}"


# p/m/fpd
# CFLAGS: -mxl-pattern-compare -mno-xl-soft-mul -mhard-float
DEFAULTTUNE_virtclass-multilib-libmbpmfpd = "microblazepmfpd"

AVAILTUNES += "microblazepmfpd"
BASE_LIB_tune-microblazepmfpd = "lib/p/m/fpd"
TUNE_FEATURES_tune-microblazepmfpd = "microblaze bigendian pattern-compare multiply-low fpu-hard"
PACKAGE_EXTRA_ARCHS_tune-microblazepmfpd = "${TUNE_PKGARCH}"


# bs/p
# CFLAGS: -mxl-barrel-shift -mxl-pattern-compare
DEFAULTTUNE_virtclass-multilib-libmbbsp = "microblazebsp"

AVAILTUNES += "microblazebsp"
BASE_LIB_tune-microblazebsp = "lib/bs/p"
TUNE_FEATURES_tune-microblazebsp = "microblaze bigendian barrel-shift pattern-compare"
PACKAGE_EXTRA_ARCHS_tune-microblazebsp = "${TUNE_PKGARCH}"


# bs/m
# CFLAGS: -mxl-barrel-shift -mno-xl-soft-mul
DEFAULTTUNE_virtclass-multilib-libmbbsm = "microblazebsm"

AVAILTUNES += "microblazebsm"
BASE_LIB_tune-microblazebsm = "lib/bs/m"
TUNE_FEATURES_tune-microblazebsm = "microblaze bigendian barrel-shift multiply-low"
PACKAGE_EXTRA_ARCHS_tune-microblazebsm = "${TUNE_PKGARCH}"


# bs/fpd
# CFLAGS: -mxl-barrel-shift -mhard-float
DEFAULTTUNE_virtclass-multilib-libmbbsfpd = "microblazebsfpd"

AVAILTUNES += "microblazebsfpd"
BASE_LIB_tune-microblazebsfpd = "lib/bs/fpd"
TUNE_FEATURES_tune-microblazebsfpd = "microblaze bigendian barrel-shift fpu-hard"
PACKAGE_EXTRA_ARCHS_tune-microblazebsfpd = "${TUNE_PKGARCH}"


# bs/m/fpd
# CFLAGS: -mxl-barrel-shift -mno-xl-soft-mul -mhard-float
DEFAULTTUNE_virtclass-multilib-libmbbsmfpd = "microblazebsmfpd"

AVAILTUNES += "microblazebsmfpd"
BASE_LIB_tune-microblazebsmfpd = "lib/bs/m/fpd"
TUNE_FEATURES_tune-microblazebsmfpd = "microblaze bigendian barrel-shift multiply-low fpu-hard"
PACKAGE_EXTRA_ARCHS_tune-microblazebsmfpd = "${TUNE_PKGARCH}"


# bs/p/m
# CFLAGS: -mxl-barrel-shift -mxl-pattern-compare -mno-xl-soft-mul
DEFAULTTUNE_virtclass-multilib-libmbbspm = "microblazebspm"

AVAILTUNES += "microblazebspm"
BASE_LIB_tune-microblazebspm = "lib/bs/p/m"
TUNE_FEATURES_tune-microblazebspm = "microblaze bigendian barrel-shift pattern-compare multiply-low"
PACKAGE_EXTRA_ARCHS_tune-microblazebspm = "${TUNE_PKGARCH}"


# bs/p/fpd
# CFLAGS: -mxl-barrel-shift -mxl-pattern-compare -mhard-float
DEFAULTTUNE_virtclass-multilib-libmbbspfpd = "microblazebspfpd"

AVAILTUNES += "microblazebspfpd"
BASE_LIB_tune-microblazebspfpd = "lib/bs/p/fpd"
TUNE_FEATURES_tune-microblazebspfpd = "microblaze bigendian barrel-shift pattern-compare fpu-hard"
PACKAGE_EXTRA_ARCHS_tune-microblazebspfpd = "${TUNE_PKGARCH}"


# bs/p/m/fpd
# CFLAGS: -mxl-barrel-shift -mxl-pattern-compare -mno-xl-soft-mul -mhard-float
DEFAULTTUNE_virtclass-multilib-libmbbspmfpd = "microblazebspmfpd"

AVAILTUNES += "microblazebspmfpd"
BASE_LIB_tune-microblazebspmfpd = "lib/bs/p/m/fpd"
TUNE_FEATURES_tune-microblazebspmfpd = "microblaze bigendian barrel-shift pattern-compare multiply-low fpu-hard"
PACKAGE_EXTRA_ARCHS_tune-microblazebspmfpd = "${TUNE_PKGARCH}"


# le/m64
# CFLAGS: -mlittle-endian -m64
DEFAULTTUNE_virtclass-multilib-libmblem64 = "microblazele64"

AVAILTUNES += "microblazele64"
BASE_LIB_tune-microblazele64 = "lib/le/m64"
TUNE_FEATURES_tune-microblazele64 = "microblaze 64-bit"
PACKAGE_EXTRA_ARCHS_tune-microblazele64 = "${TUNE_PKGARCH}"


# le/bs
# CFLAGS: -mlittle-endian -mxl-barrel-shift
DEFAULTTUNE_virtclass-multilib-libmblebs = "microblazelebs"

AVAILTUNES += "microblazelebs"
BASE_LIB_tune-microblazelebs = "lib/le/bs"
TUNE_FEATURES_tune-microblazelebs = "microblaze barrel-shift"
PACKAGE_EXTRA_ARCHS_tune-microblazelebs = "${TUNE_PKGARCH}"


# le/p
# CFLAGS: -mlittle-endian -mxl-pattern-compare
DEFAULTTUNE_virtclass-multilib-libmblep = "microblazelep"

AVAILTUNES += "microblazelep"
BASE_LIB_tune-microblazelep = "lib/le/p"
TUNE_FEATURES_tune-microblazelep = "microblaze pattern-compare"
PACKAGE_EXTRA_ARCHS_tune-microblazelep = "${TUNE_PKGARCH}"


# le/m
# CFLAGS: -mlittle-endian -mno-xl-soft-mul
DEFAULTTUNE_virtclass-multilib-libmblem = "microblazelem"

AVAILTUNES += "microblazelem"
BASE_LIB_tune-microblazelem = "lib/le/m"
TUNE_FEATURES_tune-microblazelem = "microblaze multiply-low"
PACKAGE_EXTRA_ARCHS_tune-microblazelem = "${TUNE_PKGARCH}"


# le/fpd
# CFLAGS: -mlittle-endian -mhard-float
DEFAULTTUNE_virtclass-multilib-libmblefpd = "microblazelefpd"

AVAILTUNES += "microblazelefpd"
BASE_LIB_tune-microblazelefpd = "lib/le/fpd"
TUNE_FEATURES_tune-microblazelefpd = "microblaze fpu-hard"
PACKAGE_EXTRA_ARCHS_tune-microblazelefpd = "${TUNE_PKGARCH}"


# le/m/fpd
# CFLAGS: -mlittle-endian -mno-xl-soft-mul -mhard-float
DEFAULTTUNE_virtclass-multilib-libmblemfpd = "microblazelemfpd"

AVAILTUNES += "microblazelemfpd"
BASE_LIB_tune-microblazelemfpd = "lib/le/m/fpd"
TUNE_FEATURES_tune-microblazelemfpd = "microblaze multiply-low fpu-hard"
PACKAGE_EXTRA_ARCHS_tune-microblazelemfpd = "${TUNE_PKGARCH}"


# le/p/m
# CFLAGS: -mlittle-endian -mxl-pattern-compare -mno-xl-soft-mul
DEFAULTTUNE_virtclass-multilib-libmblepm = "microblazelepm"

AVAILTUNES += "microblazelepm"
BASE_LIB_tune-microblazelepm = "lib/le/p/m"
TUNE_FEATURES_tune-microblazelepm = "microblaze pattern-compare multiply-low"
PACKAGE_EXTRA_ARCHS_tune-microblazelepm = "${TUNE_PKGARCH}"


# le/p/fpd
# CFLAGS: -mlittle-endian -mxl-pattern-compare -mhard-float
DEFAULTTUNE_virtclass-multilib-libmblepfpd = "microblazelepfpd"

AVAILTUNES += "microblazelepfpd"
BASE_LIB_tune-microblazelepfpd = "lib/le/p/fpd"
TUNE_FEATURES_tune-microblazelepfpd = "microblaze pattern-compare fpu-hard"
PACKAGE_EXTRA_ARCHS_tune-microblazelepfpd = "${TUNE_PKGARCH}"


# le/p/m/fpd
# CFLAGS: -mlittle-endian -mxl-pattern-compare -mno-xl-soft-mul -mhard-float
DEFAULTTUNE_virtclass-multilib-libmblepmfpd = "microblazelepmfpd"

AVAILTUNES += "microblazelepmfpd"
BASE_LIB_tune-microblazelepmfpd = "lib/le/p/m/fpd"
TUNE_FEATURES_tune-microblazelepmfpd = "microblaze pattern-compare multiply-low fpu-hard"
PACKAGE_EXTRA_ARCHS_tune-microblazelepmfpd = "${TUNE_PKGARCH}"


# le/bs/p
# CFLAGS: -mlittle-endian -mxl-barrel-shift -mxl-pattern-compare
DEFAULTTUNE_virtclass-multilib-libmblebsp = "microblazelebsp"

AVAILTUNES += "microblazelebsp"
BASE_LIB_tune-microblazelebsp = "lib/le/bs/p"
TUNE_FEATURES_tune-microblazelebsp = "microblaze barrel-shift pattern-compare"
PACKAGE_EXTRA_ARCHS_tune-microblazelebsp = "${TUNE_PKGARCH}"


# le/bs/m
# CFLAGS: -mlittle-endian -mxl-barrel-shift -mno-xl-soft-mul
DEFAULTTUNE_virtclass-multilib-libmblebsm = "microblazelebsm"

AVAILTUNES += "microblazelebsm"
BASE_LIB_tune-microblazelebsm = "lib/le/bs/m"
TUNE_FEATURES_tune-microblazelebsm = "microblaze barrel-shift multiply-low"
PACKAGE_EXTRA_ARCHS_tune-microblazelebsm = "${TUNE_PKGARCH}"


# le/bs/fpd
# CFLAGS: -mlittle-endian -mxl-barrel-shift -mhard-float
DEFAULTTUNE_virtclass-multilib-libmblebsfpd = "microblazelebsfpd"

AVAILTUNES += "microblazelebsfpd"
BASE_LIB_tune-microblazelebsfpd = "lib/le/bs/fpd"
TUNE_FEATURES_tune-microblazelebsfpd = "microblaze barrel-shift fpu-hard"
PACKAGE_EXTRA_ARCHS_tune-microblazelebsfpd = "${TUNE_PKGARCH}"


# le/bs/m/fpd
# CFLAGS: -mlittle-endian -mxl-barrel-shift -mno-xl-soft-mul -mhard-float
DEFAULTTUNE_virtclass-multilib-libmblebsmfpd = "microblazelebsmfpd"

AVAILTUNES += "microblazelebsmfpd"
BASE_LIB_tune-microblazelebsmfpd = "lib/le/bs/m/fpd"
TUNE_FEATURES_tune-microblazelebsmfpd = "microblaze barrel-shift multiply-low fpu-hard"
PACKAGE_EXTRA_ARCHS_tune-microblazelebsmfpd = "${TUNE_PKGARCH}"


# le/bs/p/m
# CFLAGS: -mlittle-endian -mxl-barrel-shift -mxl-pattern-compare -mno-xl-soft-mul
DEFAULTTUNE_virtclass-multilib-libmblebspm = "microblazelebspm"

AVAILTUNES += "microblazelebspm"
BASE_LIB_tune-microblazelebspm = "lib/le/bs/p/m"
TUNE_FEATURES_tune-microblazelebspm = "microblaze barrel-shift pattern-compare multiply-low"
PACKAGE_EXTRA_ARCHS_tune-microblazelebspm = "${TUNE_PKGARCH}"


# le/bs/p/fpd
# CFLAGS: -mlittle-endian -mxl-barrel-shift -mxl-pattern-compare -mhard-float
DEFAULTTUNE_virtclass-multilib-libmblebspfpd = "microblazelebspfpd"

AVAILTUNES += "microblazelebspfpd"
BASE_LIB_tune-microblazelebspfpd = "lib/le/bs/p/fpd"
TUNE_FEATURES_tune-microblazelebspfpd = "microblaze barrel-shift pattern-compare fpu-hard"
PACKAGE_EXTRA_ARCHS_tune-microblazelebspfpd = "${TUNE_PKGARCH}"


# le/bs/p/m/fpd
# CFLAGS: -mlittle-endian -mxl-barrel-shift -mxl-pattern-compare -mno-xl-soft-mul -mhard-float
DEFAULTTUNE_virtclass-multilib-libmblebspmfpd = "microblazelebspmfpd"

AVAILTUNES += "microblazelebspmfpd"
BASE_LIB_tune-microblazelebspmfpd = "lib/le/bs/p/m/fpd"
TUNE_FEATURES_tune-microblazelebspmfpd = "microblaze barrel-shift pattern-compare multiply-low fpu-hard"
PACKAGE_EXTRA_ARCHS_tune-microblazelebspmfpd = "${TUNE_PKGARCH}"


# le/m64/bs
# CFLAGS: -mlittle-endian -m64 -mxl-barrel-shift
DEFAULTTUNE_virtclass-multilib-libmblem64bs = "microblazele64bs"

AVAILTUNES += "microblazele64bs"
BASE_LIB_tune-microblazele64bs = "lib/le/m64/bs"
TUNE_FEATURES_tune-microblazele64bs = "microblaze 64-bit barrel-shift"
PACKAGE_EXTRA_ARCHS_tune-microblazele64bs = "${TUNE_PKGARCH}"


# le/m64/p
# CFLAGS: -mlittle-endian -m64 -mxl-pattern-compare
DEFAULTTUNE_virtclass-multilib-libmblem64p = "microblazele64p"

AVAILTUNES += "microblazele64p"
BASE_LIB_tune-microblazele64p = "lib/le/m64/p"
TUNE_FEATURES_tune-microblazele64p = "microblaze 64-bit pattern-compare"
PACKAGE_EXTRA_ARCHS_tune-microblazele64p = "${TUNE_PKGARCH}"


# le/m64/m
# CFLAGS: -mlittle-endian -m64 -mno-xl-soft-mul
DEFAULTTUNE_virtclass-multilib-libmblem64m = "microblazele64m"

AVAILTUNES += "microblazele64m"
BASE_LIB_tune-microblazele64m = "lib/le/m64/m"
TUNE_FEATURES_tune-microblazele64m = "microblaze 64-bit multiply-low"
PACKAGE_EXTRA_ARCHS_tune-microblazele64m = "${TUNE_PKGARCH}"


# le/m64/fpd
# CFLAGS: -mlittle-endian -m64 -mhard-float
DEFAULTTUNE_virtclass-multilib-libmblem64fpd = "microblazele64fpd"

AVAILTUNES += "microblazele64fpd"
BASE_LIB_tune-microblazele64fpd = "lib/le/m64/fpd"
TUNE_FEATURES_tune-microblazele64fpd = "microblaze 64-bit fpu-hard"
PACKAGE_EXTRA_ARCHS_tune-microblazele64fpd = "${TUNE_PKGARCH}"


# le/m64/m/fpd
# CFLAGS: -mlittle-endian -m64 -mno-xl-soft-mul -mhard-float
DEFAULTTUNE_virtclass-multilib-libmblem64mfpd = "microblazele64mfpd"

AVAILTUNES += "microblazele64mfpd"
BASE_LIB_tune-microblazele64mfpd = "lib/le/m64/m/fpd"
TUNE_FEATURES_tune-microblazele64mfpd = "microblaze 64-bit multiply-low fpu-hard"
PACKAGE_EXTRA_ARCHS_tune-microblazele64mfpd = "${TUNE_PKGARCH}"


# le/m64/p/m
# CFLAGS: -mlittle-endian -m64 -mxl-pattern-compare -mno-xl-soft-mul
DEFAULTTUNE_virtclass-multilib-libmblem64pm = "microblazele64pm"

AVAILTUNES += "microblazele64pm"
BASE_LIB_tune-microblazele64pm = "lib/le/m64/p/m"
TUNE_FEATURES_tune-microblazele64pm = "microblaze 64-bit pattern-compare multiply-low"
PACKAGE_EXTRA_ARCHS_tune-microblazele64pm = "${TUNE_PKGARCH}"


# le/m64/p/fpd
# CFLAGS: -mlittle-endian -m64 -mxl-pattern-compare -mhard-float
DEFAULTTUNE_virtclass-multilib-libmblem64pfpd = "microblazele64pfpd"

AVAILTUNES += "microblazele64pfpd"
BASE_LIB_tune-microblazele64pfpd = "lib/le/m64/p/fpd"
TUNE_FEATURES_tune-microblazele64pfpd = "microblaze 64-bit pattern-compare fpu-hard"
PACKAGE_EXTRA_ARCHS_tune-microblazele64pfpd = "${TUNE_PKGARCH}"


# le/m64/p/m/fpd
# CFLAGS: -mlittle-endian -m64 -mxl-pattern-compare -mno-xl-soft-mul -mhard-float
DEFAULTTUNE_virtclass-multilib-libmblem64pmfpd = "microblazele64pmfpd"

AVAILTUNES += "microblazele64pmfpd"
BASE_LIB_tune-microblazele64pmfpd = "lib/le/m64/p/m/fpd"
TUNE_FEATURES_tune-microblazele64pmfpd = "microblaze 64-bit pattern-compare multiply-low fpu-hard"
PACKAGE_EXTRA_ARCHS_tune-microblazele64pmfpd = "${TUNE_PKGARCH}"


# le/m64/bs/p
# CFLAGS: -mlittle-endian -m64 -mxl-barrel-shift -mxl-pattern-compare
DEFAULTTUNE_virtclass-multilib-libmblem64bsp = "microblazele64bsp"

AVAILTUNES += "microblazele64bsp"
BASE_LIB_tune-microblazele64bsp = "lib/le/m64/bs/p"
TUNE_FEATURES_tune-microblazele64bsp = "microblaze 64-bit barrel-shift pattern-compare"
PACKAGE_EXTRA_ARCHS_tune-microblazele64bsp = "${TUNE_PKGARCH}"


# le/m64/bs/m
# CFLAGS: -mlittle-endian -m64 -mxl-barrel-shift -mno-xl-soft-mul
DEFAULTTUNE_virtclass-multilib-libmblem64bsm = "microblazele64bsm"

AVAILTUNES += "microblazele64bsm"
BASE_LIB_tune-microblazele64bsm = "lib/le/m64/bs/m"
TUNE_FEATURES_tune-microblazele64bsm = "microblaze 64-bit barrel-shift multiply-low"
PACKAGE_EXTRA_ARCHS_tune-microblazele64bsm = "${TUNE_PKGARCH}"


# le/m64/bs/fpd
# CFLAGS: -mlittle-endian -m64 -mxl-barrel-shift -mhard-float
DEFAULTTUNE_virtclass-multilib-libmblem64bsfpd = "microblazele64bsfpd"

AVAILTUNES += "microblazele64bsfpd"
BASE_LIB_tune-microblazele64bsfpd = "lib/le/m64/bs/fpd"
TUNE_FEATURES_tune-microblazele64bsfpd = "microblaze 64-bit barrel-shift fpu-hard"
PACKAGE_EXTRA_ARCHS_tune-microblazele64bsfpd = "${TUNE_PKGARCH}"


# le/m64/bs/m/fpd
# CFLAGS: -mlittle-endian -m64 -mxl-barrel-shift -mno-xl-soft-mul -mhard-float
DEFAULTTUNE_virtclass-multilib-libmblem64bsmfpd = "microblazele64bsmfpd"

AVAILTUNES += "microblazele64bsmfpd"
BASE_LIB_tune-microblazele64bsmfpd = "lib/le/m64/bs/m/fpd"
TUNE_FEATURES_tune-microblazele64bsmfpd = "microblaze 64-bit barrel-shift multiply-low fpu-hard"
PACKAGE_EXTRA_ARCHS_tune-microblazele64bsmfpd = "${TUNE_PKGARCH}"


# le/m64/bs/p/m
# CFLAGS: -mlittle-endian -m64 -mxl-barrel-shift -mxl-pattern-compare -mno-xl-soft-mul
DEFAULTTUNE_virtclass-multilib-libmblem64bspm = "microblazele64bspm"

AVAILTUNES += "microblazele64bspm"
BASE_LIB_tune-microblazele64bspm = "lib/le/m64/bs/p/m"
TUNE_FEATURES_tune-microblazele64bspm = "microblaze 64-bit barrel-shift pattern-compare multiply-low"
PACKAGE_EXTRA_ARCHS_tune-microblazele64bspm = "${TUNE_PKGARCH}"


# le/m64/bs/p/fpd
# CFLAGS: -mlittle-endian -m64 -mxl-barrel-shift -mxl-pattern-compare -mhard-float
DEFAULTTUNE_virtclass-multilib-libmblem64bspfpd = "microblazele64bspfpd"

AVAILTUNES += "microblazele64bspfpd"
BASE_LIB_tune-microblazele64bspfpd = "lib/le/m64/bs/p/fpd"
TUNE_FEATURES_tune-microblazele64bspfpd = "microblaze 64-bit barrel-shift pattern-compare fpu-hard"
PACKAGE_EXTRA_ARCHS_tune-microblazele64bspfpd = "${TUNE_PKGARCH}"


# le/m64/bs/p/m/fpd
# CFLAGS: -mlittle-endian -m64 -mxl-barrel-shift -mxl-pattern-compare -mno-xl-soft-mul -mhard-float
DEFAULTTUNE_virtclass-multilib-libmblem64bspmfpd = "microblazele64bspmfpd"

AVAILTUNES += "microblazele64bspmfpd"
BASE_LIB_tune-microblazele64bspmfpd = "lib/le/m64/bs/p/m/fpd"
TUNE_FEATURES_tune-microblazele64bspmfpd = "microblaze 64-bit barrel-shift pattern-compare multiply-low fpu-hard"
PACKAGE_EXTRA_ARCHS_tune-microblazele64bspmfpd = "${TUNE_PKGARCH}"
```
