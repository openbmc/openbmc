## meta-xilinx/meta-xilinx-bsp/conf/machine/zc706-zynq7.conf
```bitbake
#@TYPE: Machine
#@NAME: zc706-zynq7
#@DESCRIPTION: Machine support for ZC706 Evaluation Board.
#
# For details on the Evaluation board:
#     http://www.xilinx.com/products/boards-and-kits/EK-Z7-ZC706-G.htm
# For documentation and design files for the ZC702:
#     http://www.xilinx.com/support/index.html/content/xilinx/en/supportNav/boards_and_kits/zynq-7000_soc_boards_and_kits/zynq-7000_soc_zc706_evaluation_kit.html
# For the FSBL 'zynq_fsbl_0.elf' refer to UG873 and the associated design files.
#

require conf/machine/include/soc-zynq.inc
require conf/machine/include/machine-xilinx-default.inc
require conf/machine/include/machine-xilinx-qemu.inc

MACHINE_FEATURES = "rtc ext2 ext3 vfat usbhost usbgadget"

# u-boot configuration
UBOOT_MACHINE = "xilinx_zynq_virt_defconfig"
SPL_BINARY ?= "spl/boot.bin"

EXTRA_IMAGEDEPENDS += " \
		u-boot-zynq-uenv \
		virtual/boot-bin \
		virtual/bootloader \
		u-boot-zynq-scr \
		"

SERIAL_CONSOLES ?= "115200;ttyPS0"

KERNEL_DEVICETREE = "zynq-zc706.dtb"

IMAGE_BOOT_FILES += " \
		boot.bin \
		uEnv.txt \
		boot.scr \
		"

QB_MEM = "-m 1024"
QB_NETWORK_DEVICE = "-net nic,netdev=eth0 -netdev user,id=eth0,tftp=/tftpboot -net nic"
QB_DEFAULT_KERNEL_qemuboot-xilinx = "zImage"

QB_SYSTEM_NAME ?= "${@qemu_target_binary(d)}"
QB_DEFAULT_FSTYPE = "cpio.gz.u-boot"
QB_DTB = "system.dtb"
QB_ROOTFS_OPT_qemuboot-xilinx = " -drive if=sd,index=1,file=@ROOTFS@,format=raw"

# Replicate BootROM like behaviour, having loaded SPL and PMU(ROM+FW)
QB_OPT_APPEND = " \
	-nographic -serial null -serial mon:stdio \
	-initrd ${DEPLOY_DIR_IMAGE}/petalinux-image-minimal-zc706-zynq7.cpio.gz.u-boot \
	-gdb tcp::9000 \
	-device loader,addr=0xf8000008,data=0xDF0D,data-len=4 \
	-device loader,addr=0xf8000140,data=0x00500801,data-len=4 \
	-device loader,addr=0xf800012c,data=0x1ed044d,data-len=4 \
	-device loader,addr=0xf8000108,data=0x0001e008,data-len=4 \
	-device loader,addr=0xF8000910,data=0xF,data-len=0x4 \
	"
```

## meta-xilinx/meta-xilinx-bsp/conf/machine/zcu102-zynqmp.conf
```bitbake
#@TYPE: Machine
#@NAME: zcu102-zynqmp
#@DESCRIPTION: Machine support for ZCU102 Evaluation Board.

require conf/machine/include/soc-zynqmp.inc
require conf/machine/include/machine-xilinx-default.inc
require conf/machine/include/machine-xilinx-qemu.inc

MACHINE_FEATURES = "rtc ext2 ext3 vfat usbhost"

UBOOT_MACHINE = "xilinx_zynqmp_virt_defconfig"
SPL_BINARY ?= "spl/boot.bin"

# Default SD image build onfiguration, use qemu-sd to pad
IMAGE_CLASSES += "image-types-xilinx-qemu"
IMAGE_FSTYPES += "wic.qemu-sd"
WKS_FILES ?= "sdimage-bootpart.wks"

SERIAL_CONSOLES ?= "115200;ttyPS0"

KERNEL_DEVICETREE = "xilinx/zynqmp-zcu102-rev1.0.dtb"

EXTRA_IMAGEDEPENDS += " \
		u-boot-zynq-uenv \
		arm-trusted-firmware \
		qemu-devicetrees \
		virtual/boot-bin \
		virtual/bootloader \
		u-boot-zynq-scr \
		"

IMAGE_BOOT_FILES += " \
		uEnv.txt \
		atf-uboot.ub \
		${@bb.utils.contains('PREFERRED_PROVIDER_virtual/dtb', 'device-tree', 'system.dtb', '', d)} \
		boot.scr \
		"

# This machine has a QEMU model, runqemu setup:
QB_MEM = "-m 4096"
QB_OPT_APPEND ?= "-nographic -serial mon:stdio -serial null"
QB_NETWORK_DEVICE = "-net nic -net nic -net nic -net nic,netdev=net0,macaddr=@MAC@"

# Replicate BootROM like behaviour, having loaded SPL and PMU(ROM+FW)
QB_OPT_APPEND_append_qemuboot-xilinx = " \
		-hw-dtb ${DEPLOY_DIR_IMAGE}/qemu-hw-devicetrees/multiarch/zcu102-arm.dtb \
		${@qemu_zynqmp_unhalt(d, True)} \
		-device loader,file=${DEPLOY_DIR_IMAGE}/arm-trusted-firmware.elf,cpu-num=0 \
		-device loader,file=${DEPLOY_DIR_IMAGE}/u-boot.elf \
		-device loader,file=${DEPLOY_DIR_IMAGE}/system.dtb,addr=0x100000 \
		"

# Attach the rootfs disk image to the second SD interface of QEMU (which is SD0)
QB_DEFAULT_FSTYPE_qemuboot-xilinx = "wic.qemu-sd"
QB_OPT_APPEND_append_qemuboot-xilinx = " -boot mode=5"
QB_ROOTFS_OPT_qemuboot-xilinx = " -drive if=sd,index=1,file=@ROOTFS@,format=raw"

# PMU instance args
PMU_ROM ?= "${DEPLOY_DIR_IMAGE}/pmu-rom.elf"
PMU_FIRMWARE_DEPLOY_DIR ?=  "${@ '${TOPDIR}/pmutmp/deploy/images/microblaze-pmu' if d.getVar('BBMULTICONFIG') == 'pmu' else '${TOPDIR}/tmp/deploy/images/${MACHINE}'}"
PMU_FIRMWARE_IMAGE_NAME ?= "${@ 'pmu-firmware-microblaze-pmu' if d.getVar('BBMULTICONFIG') == 'pmu' else 'pmu-zcu102-zynqmp'}"

QB_PMU_OPT = " \
		-M microblaze-fdt \
		-display none \
		-hw-dtb ${DEPLOY_DIR_IMAGE}/qemu-hw-devicetrees/multiarch/zynqmp-pmu.dtb \
		-kernel ${PMU_ROM} \
		-device loader,file=${PMU_FIRMWARE_DEPLOY_DIR}/${PMU_FIRMWARE_IMAGE_NAME}.elf \
		-device loader,addr=0xfd1a0074,data=0x1011003,data-len=4 \
		-device loader,addr=0xfd1a007C,data=0x1010f03,data-len=4 \
		"
QB_OPT_APPEND_append_qemuboot-xilinx = " -pmu-args '${QB_PMU_OPT}'"

do_write_qemuboot_conf[depends] += "u-boot-zynq-uenv:do_deploy"
```

## meta-xilinx/meta-xilinx-bsp/conf/machine/zcu104-zynqmp.conf
```bitbake
#@TYPE: Machine
#@NAME: zcu104-zynqmp
#@DESCRIPTION: Machine support for ZCU104 Evaluation Board.
#

SOC_VARIANT ?= "ev"

require conf/machine/include/tune-zynqmp.inc
require conf/machine/include/machine-xilinx-overrides.inc
require conf/machine/include/machine-xilinx-default.inc
require conf/machine/include/machine-xilinx-board.inc
include conf/machine/include/zynqmp-pmu-config.inc

MACHINE_FEATURES = "rtc ext2 ext3 vfat usbhost"

UBOOT_MACHINE = "xilinx_zynqmp_zcu104_revC_defconfig"
SPL_BINARY = "spl/boot.bin"

SERIAL_CONSOLE ?= "115200 ttyPS0"

SERIAL_CONSOLES_CHECK = "${SERIAL_CONSOLES}"

KERNEL_DEVICETREE = "xilinx/zynqmp-zcu104-revC.dtb"

PREFERRED_PROVIDER_virtual/kernel ?= "linux-xlnx"
PREFERRED_PROVIDER_virtual/bootloader ?= "u-boot-xlnx"
PREFERRED_PROVIDER_virtual/pmu-firmware ?= "zynqmp-pmu-pmu-firmware"

EXTRA_IMAGEDEPENDS += " \
		u-boot-zynq-uenv \
		arm-trusted-firmware \
		virtual/pmu-firmware \
		virtual/boot-bin \
		"
IMAGE_BOOT_FILES += "uEnv.txt atf-uboot.ub ${KERNEL_IMAGETYPE}-zynqmp-zcu104-revC.dtb"

MACHINE_HWCODECS = "libomxil-xlnx"
```

## meta-xilinx/meta-xilinx-bsp/conf/machine/zcu106-zynqmp.conf
```bitbake
#@TYPE: Machine
#@NAME: zcu106-zynqmp
#@DESCRIPTION: Machine support for ZCU106 Evaluation Board.

SOC_VARIANT ?= "ev"

require conf/machine/include/tune-zynqmp.inc
require conf/machine/include/machine-xilinx-overrides.inc
require conf/machine/include/machine-xilinx-default.inc

MACHINE_FEATURES = "rtc ext2 ext3 vfat usbhost"

UBOOT_MACHINE = "xilinx_zynqmp_zcu106_revA_defconfig"
SPL_BINARY ?= "spl/boot.bin"

SERIAL_CONSOLE = "115200 ttyPS0"
SERIAL_CONSOLES_CHECK = "${SERIAL_CONSOLES}"

KERNEL_DEVICETREE = "xilinx/zynqmp-zcu106-revA.dtb"

PREFERRED_PROVIDER_virtual/kernel ?= "linux-xlnx"
PREFERRED_PROVIDER_virtual/bootloader ?= "u-boot-xlnx"

PMU_FIRMWARE_IMAGE_NAME ?= "pmu-firmware-zynqmp-pmu"
PMU_FIRMWARE_DEPLOY_DIR ?= "${TOPDIR}/pmutmp/deploy/images/zynqmp-pmu"

EXTRA_IMAGEDEPENDS += " \
		u-boot-zynq-uenv \
		arm-trusted-firmware \
		virtual/boot-bin \
		virtual/bootloader \
		"

IMAGE_BOOT_FILES += " \
		uEnv.txt \
		atf-uboot.ub \
		"

MACHINE_HWCODECS = "libomxil-xlnx"
```

## meta-xilinx/meta-xilinx-bsp/conf/machine/zcu208-zynqmp.conf
```bitbake
#@TYPE: Machine
#@NAME: zcu208-zynqmp
#@DESCRIPTION: Machine support for ZCU208 Evaluation Board.
#

SOC_VARIANT ?= "dr"

require conf/machine/include/soc-zynqmp.inc
require conf/machine/include/machine-xilinx-default.inc

MACHINE_FEATURES = "rtc ext2 ext3 vfat usbhost"

UBOOT_MACHINE = "xilinx_zynqmp_virt_defconfig"
SPL_BINARY ?= "spl/boot.bin"

SERIAL_CONSOLES ?= "115200;ttyPS0"


PMU_FIRMWARE_IMAGE_NAME ?= "pmu-firmware-zynqmp-pmu"
PMU_FIRMWARE_DEPLOY_DIR ?= "${TOPDIR}/pmutmp/deploy/images/zynqmp-pmu"

EXTRA_IMAGEDEPENDS += " \
		u-boot-zynq-uenv \
		arm-trusted-firmware \
		virtual/boot-bin \
		virtual/bootloader \
		u-boot-zynq-scr \
		"
IMAGE_BOOT_FILES += " \
		uEnv.txt \
		atf-uboot.ub \
		boot.scr \
		"
```

## meta-xilinx/meta-xilinx-bsp/conf/machine/zedboard-zynq7.conf
```bitbake
#@TYPE: Machine
#@NAME: zedboard-zynq7
#@DESCRIPTION: Machine support for ZedBoard. (http://www.zedboard.org/)
#
# For details on the Evaluation board:
#     http://www.zedboard.org/content/overview
# For design files (including 'zynq_fsbl_0.elf') for the ZedBoard:
#     http://www.zedboard.org/reference-designs-categories/zynq-concepts-tools-and-techniques-zedboard
#

require conf/machine/include/soc-zynq.inc
require conf/machine/include/machine-xilinx-default.inc

# u-boot configuration
UBOOT_MACHINE = "xilinx_zynq_virt_defconfig"
SPL_BINARY ?= "spl/boot.bin"

EXTRA_IMAGEDEPENDS += " \
		u-boot-zynq-uenv \
		virtual/boot-bin \
		virtual/bootloader \
		u-boot-zynq-scr \
		"

SERIAL_CONSOLES ?= "115200;ttyPS0"

KERNEL_DEVICETREE = "zynq-zed.dtb"

IMAGE_BOOT_FILES += " \
		boot.bin \
		uEnv.txt \
		boot.scr \
		"
```

## meta-xilinx/meta-xilinx-bsp/conf/machine/zybo-linux-bd-zynq7.conf
```bitbake
#@TYPE: Machine
#@NAME: zybo-linux-bd-zynq7
#@DESCRIPTION: Machine support for zybo-linux-bd project.
#
# generated base on ZYBO linux-bd project
#

require conf/machine/include/soc-zynq.inc
require conf/machine/include/machine-xilinx-default.inc

PREFERRED_PROVIDER_virtual/bootloader ?= "u-boot"

MACHINE_FEATURES = "ext2 vfat usbhost usbgadget keyboard screen alsa sdio"
SERIAL_CONSOLES ?= "115200;ttyPS0"

MACHINE_ESSENTIAL_EXTRA_RDEPENDS += "device-tree"

UBOOT_MACHINE = "xilinx_zynq_virt_defconfig"
SPL_BINARY ?= "spl/boot.bin"
FORCE_PLATFORM_INIT = "1"
UBOOT_ELF = "u-boot"

EXTRA_IMAGEDEPENDS += " \
		u-boot-zynq-uenv \
		virtual/boot-bin \
		virtual/bitstream \
		virtual/bootloader \
		u-boot-zynq-scr \
		"

IMAGE_BOOT_FILES += " \
		boot.bin \
		bitstream \
		uEnv.txt \
		"

KERNEL_FEATURES += " \
		bsp/xilinx/zybo-linux-bd-zynq7/zybo-linux-bd-zynq7.scc \
		features/xilinx/v4l2/v4l2.scc \
		"
```

## meta-xilinx/meta-xilinx-bsp/conf/machine/zybo-zynq7.conf
```bitbake
#@TYPE: Machine
#@NAME: zybo-zynq7
#@DESCRIPTION: Machine support for ZYBO.
#
# For details on the ZYBO board:
#     https://www.digilentinc.com/Products/Detail.cfm?Prod=ZYBO
#

require conf/machine/include/soc-zynq.inc
require conf/machine/include/machine-xilinx-default.inc

MACHINE_FEATURES = "ext2 vfat usbhost usbgadget"

# u-boot configuration
PREFERRED_PROVIDER_virtual/bootloader = "u-boot"
UBOOT_MACHINE = "xilinx_zynq_virt_defconfig"
SPL_BINARY ?= "spl/boot.bin"
UBOOT_ELF = "u-boot"

EXTRA_IMAGEDEPENDS += " \
		u-boot-zynq-uenv \
		virtual/boot-bin \
		virtual/bootloader \
		u-boot-zynq-scr \
		"

SERIAL_CONSOLES ?= "115200;ttyPS0"

KERNEL_DEVICETREE = "zynq-zybo.dtb"

IMAGE_BOOT_FILES += " \
		boot.bin \
		uEnv.txt \
		"
```

## meta-xilinx/meta-xilinx-bsp/conf/machine/zynq-generic.conf
```bitbake
#@TYPE: Machine
#@NAME: Generic Zynq
#@DESCRIPTION: Generic Zynq Device

require conf/machine/include/soc-zynq.inc
require conf/machine/include/machine-xilinx-default.inc
require conf/machine/include/machine-xilinx-qemu.inc
require conf/machine/include/xilinx-board.inc

MACHINE_FEATURES = "rtc ext2 ext3 vfat usbhost usbgadget"

EXTRA_IMAGEDEPENDS += "libyaml-native python3-cython-native python3-pyyaml-native"

UBOOT_MACHINE ?= "xilinx_zynq_virt_defconfig"

SERIAL_CONSOLES ?= "115200;ttyPS0"

MACHINE_ESSENTIAL_EXTRA_RDEPENDS += "device-tree"

HDF_MACHINE = "zc702-zynq7"

QB_MEM = "-m 1024"
QB_NETWORK_DEVICE = "-net nic,netdev=eth0 -netdev user,id=eth0,tftp=/tftpboot -net nic"
QB_DEFAULT_KERNEL_qemuboot-xilinx = "zImage"

QB_SYSTEM_NAME ?= "${@qemu_target_binary(d)}"
QB_DEFAULT_FSTYPE = "cpio.gz.u-boot"
QB_DTB = "system.dtb"
QB_ROOTFS_OPT_qemuboot-xilinx = " -drive if=sd,index=1,file=@ROOTFS@,format=raw"

# Replicate BootROM like behaviour, having loaded SPL and PMU(ROM+FW)
QB_OPT_APPEND = " \
	-nographic -serial null -serial mon:stdio \
	-initrd ${DEPLOY_DIR_IMAGE}/petalinux-image-minimal-zynq-generic.cpio.gz.u-boot \
	-gdb tcp::9000 \
	-device loader,addr=0xf8000008,data=0xDF0D,data-len=4 \
	-device loader,addr=0xf8000140,data=0x00500801,data-len=4 \
	-device loader,addr=0xf800012c,data=0x1ed044d,data-len=4 \
	-device loader,addr=0xf8000108,data=0x0001e008,data-len=4 \
	-device loader,addr=0xF8000910,data=0xF,data-len=0x4 \
	"
```

## meta-xilinx/meta-xilinx-bsp/conf/machine/zynqmp-generic.conf
```bitbake
#@TYPE: Machine
#@NAME:
#@DESCRIPTION: zynqmp devices

require conf/machine/include/tune-zynqmp.inc
require conf/machine/include/machine-xilinx-overrides.inc
require conf/machine/include/machine-xilinx-default.inc
require conf/machine/include/machine-xilinx-qemu.inc

MACHINE_FEATURES = "rtc ext2 ext3 vfat usbhost"

PREFERRED_PROVIDER_qemu-helper-native = "qemu-xilinx-helper-native"

EXTRA_IMAGEDEPENDS += "libyaml-native python3-cython-native python3-pyyaml-native"
```

## meta-xilinx/meta-xilinx-contrib/conf/layer.conf
```bitbake
# We have a conf and classes directory, add to BBPATH
BBPATH .= ":${LAYERDIR}"

# We have a packages directory, add to BBFILES
BBFILES += "${LAYERDIR}/recipes-*/*/*.bb"
BBFILES += "${LAYERDIR}/recipes-*/*/*.bbappend"

BBFILE_COLLECTIONS += "xilinx-contrib"
BBFILE_PATTERN_xilinx-contrib = "^${LAYERDIR}/"
BBFILE_PRIORITY_xilinx-contrib = "5"

LAYERDEPENDS_xilinx-contrib = "core"
LAYERDEPENDS_xilinx-contrib = "xilinx"

LAYERSERIES_COMPAT_xilinx-contrib = "dunfell gatesgarth"

XILINX_RELEASE_VERSION = "v2020.2"
```

## meta-xilinx/meta-xilinx-contrib/conf/machine/minized-zynq7.conf
```bitbake
#@TYPE: Machine
#@NAME: minized-zynq7
#@DESCRIPTION: Machine support for MiniZed. (http://www.minized.org/)

require conf/machine/include/tune-zynq.inc
require conf/machine/include/machine-xilinx-default.inc

MACHINE_FEATURES = "ext2 vfat usbhost wifi bluetooth"

# u-boot configuration
PREFERRED_PROVIDER_virtual/bootloader = "u-boot"
UBOOT_MACHINE = "zynq_minized_config"

EXTRA_IMAGEDEPENDS += " \
		u-boot-zynq-uenv \
		virtual/bootloader \
		"

SERIAL_CONSOLES ?= "115200;ttyPS0"

MACHINE_ESSENTIAL_EXTRA_RDEPENDS += "device-tree"

MACHINE_ESSENTIAL_EXTRA_RRECOMMENDS += "linux-firmware-bcm43430"

IMAGE_BOOT_FILES += " \
		uEnv.txt \
		"
```

## meta-xilinx/meta-xilinx-pynq/conf/layer.conf
```bitbake
# We have a conf and classes directory, add to BBPATH
BBPATH .= ":${LAYERDIR}"

# We have a packages directory, add to BBFILES
BBFILES += "${LAYERDIR}/recipes-*/*/*.bb"
BBFILES += "${LAYERDIR}/recipes-*/*/*.bbappend"

BBFILE_COLLECTIONS += "xilinx-pynq"
BBFILE_PATTERN_xilinx-pynq = "^${LAYERDIR}/"
BBFILE_PRIORITY_xilinx-pynq = "5"

LAYERDEPENDS_xilinx-pynq = "core xilinx"

LAYERSERIES_COMPAT_xilinx-pynq = "dunfell gatesgarth"
```

## meta-xilinx/meta-xilinx-standalone/conf/distro/xilinx-freertos.conf
```bitbake
require conf/distro/xilinx-standalone.inc

DISTRO_NAME_append = " (freertos)"

XLNX_CMAKE_SYSTEM_NAME = "FreeRTOS"

# We need to pass FREERTOS_BSP compliler flag it is consumed
# esw components.
ESW_CFLAGS += " -DFREERTOS_BSP"
```

## meta-xilinx/meta-xilinx-standalone/conf/distro/xilinx-standalone.conf
```bitbake
require conf/distro/xilinx-standalone.inc

DISTRO_NAME_append = " (lto)"

# By default we want to optimize for size.
FULL_OPTIMIZATION = "-O2 -pipe ${DEBUG_FLAGS}"

# Workaround for microblaze -Os bug
FULL_OPTIMIZATION_microblaze = "-O2 -pipe ${DEBUG_FLAGS}"

# We also need to use Link Time Optimization for many items, make this the
# default.
ESW_CFLAGS += " -flto -ffat-lto-objects"
```
