## meta-xilinx/meta-xilinx-standalone/conf/distro/xilinx-standalone.inc
```bitbake
DISTRO_NAME = "Xilinx Standalone Distro"
DISTRO_VERSION = "1.0"
TARGET_VENDOR = "-xilinx"

# Make sure any users get the xilinx-standalone distro override
DISTROOVERRIDES_prepend = "${@'xilinx-standalone:' if d.getVar('DISTRO') != "xilinx-standalone" else ''}"

TCLIBC = "newlib"
TCLIBCAPPEND =""

# Change SDK name
SDK_VERSION = "xilinx-standalone"

require conf/distro/include/yocto-uninative.inc
INHERIT += "uninative"

# Hold this until it gets merged in core, we need libc.a and libgloss.a for cross-canadian
LIBC_DEPENDENCIES_append = " newlib-staticdev libgloss-staticdev"

ESW_CFLAGS ?= ""

INHERIT += "buildhistory"

# Cortex R5 requires an additional cflag to be passed for compatibility with the embeddedsw
TUNE_CCARGS .= "${@bb.utils.contains('TUNE_FEATURES', 'cortexr5', ' -DARMR5', '', d)}"

# Make sure all regular recipes are excluded from compatibility
# Avoid using this for native, nativesdk or cross recipes
COMPATOS = ""
# Set the regex for target recipes only, follow TARGET_OS default
COMPATOS_class-target = ".*-linux${LIBCEXTENSION}${ABIEXTENSION}"
COMPATIBLE_HOST ?= "${COMPATOS}"

# Clear defaults
DISTRO_FEATURES_BACKFILL_xilinx-standalone = ""
VIRTUAL-RUNTIME_init_manager_xilinx-standalone = ""

PREFERRED_PROVIDER_virtual/kernel = "linux-dummy"

# Hold this until it gets merged in core, we need libc.a and libgloss.a for cross-canadian
LIBC_DEPENDENCIES_append = " newlib-staticdev libgloss-staticdev"

# No cached configsite files
TOOLCHAIN_NEED_CONFIGSITE_CACHE = ""

# Workaround for pulling in nativesdk-mingw-w64-winpthreads
TOOLCHAIN_HOST_TASK_append_sdkmingw32 = " nativesdk-mingw-w64-winpthreads"
```

## meta-xilinx/meta-xilinx-standalone/conf/layer.conf
```bitbake
# We have a conf and classes directory, add to BBPATH
BBPATH .= ":${LAYERDIR}"

# We have recipes-* directories, add to BBFILES
BBFILES += "${LAYERDIR}/recipes-*/*/*.bb \
	${LAYERDIR}/recipes-*/*/*.bbappend \
        ${LAYERDIR}/recipes-*/*.bb \
	${LAYERDIR}/recipes-*/*.bbappend \
        "

BBFILE_COLLECTIONS += "xilinx-standalone"
BBFILE_PATTERN_xilinx-standalone = "^${LAYERDIR}/"
BBFILE_PRIORITY_xilinx-standalone = "7"

LAYERDEPENDS_xilinx-standalone = "core xilinx"
LAYERRECOMMENDS_xilinx-standalone = "xilinx-microblaze"

LAYERSERIES_COMPAT_xilinx-standalone = "dunfell gatesgarth"
XILINX_RELEASE_VERSION = "v2020.2"
```

## meta-xilinx/meta-xilinx-standalone/conf/machine/zynqmp-pmu.conf
```bitbake
DEFAULTTUNE ?= "microblaze"

require conf/machine/include/microblaze/arch-microblaze.inc

# Endianess, multiplier, barrel shift, pattern compare, floating point double or single, are the possibilities
AVAILTUNES += "microblaze"
TUNE_FEATURES_tune-microblaze = "microblaze v9.2 barrel-shift pattern-compare"
PACKAGE_EXTRA_ARCHS_tune-microblaze = "${TUNE_PKGARCH}"
SOC_FAMILY = "zynqmp"

TARGET_LINK_HASH_STYLE_microblaze = ""
```

## meta-yadro/conf/layer.conf
```bitbake
# We have a conf and classes directory, add to BBPATH
BBPATH .= ":${LAYERDIR}"

# We have recipes-* directories, add to BBFILES
BBFILES += "${LAYERDIR}/recipes-*/*/*.bb \
            ${LAYERDIR}/recipes-*/*/*.bbappend"

BBFILE_COLLECTIONS += "yadro-layer"
BBFILE_PATTERN_yadro-layer = "^${LAYERDIR}/"
BBFILE_PATTERN_IGNORE_EMPTY_yadro-layer = "1"

LAYERSERIES_COMPAT_yadro-layer = "warrior zeus dunfell"
```

## meta-yadro/meta-nicole/conf/machine/nicole.conf
```bitbake
KMACHINE = "aspeed"
KERNEL_DEVICETREE = "${KMACHINE}-bmc-opp-${MACHINE}.dtb"

PREFERRED_PROVIDER_virtual/bootloader = "u-boot-aspeed"
PREFERRED_PROVIDER_u-boot = "u-boot-aspeed"
PREFERRED_PROVIDER_u-boot-fw-utils = "u-boot-fw-utils-aspeed"
UBOOT_MACHINE = "ast_g5_ncsi_config"

require conf/machine/include/ast2500.inc
require conf/machine/include/obmc-bsp-common.inc
require conf/machine/include/openpower.inc
require conf/machine/include/p9.inc

IMAGE_FEATURES:remove = " obmc-fan-control obmc-fan-mgmt"

PREFERRED_PROVIDER_virtual/openpower-fru-vpd-layout = "nicole-openpower-fru-vpd-layout-native"
PREFERRED_PROVIDER_virtual/openpower-fru-inventory = "nicole-openpower-fru-inventory-native"
PREFERRED_PROVIDER_virtual/openpower-fru-properties = "nicole-openpower-fru-properties-native"
PREFERRED_PROVIDER_virtual/phosphor-led-manager-config-native = "nicole-led-manager-config-native"
```

## meta-yadro/meta-vegman/conf/machine/include/vegman.inc
```bitbake
OVERRIDES .= ":vegman"
KMACHINE = "aspeed"
KERNEL_DEVICETREE = "aspeed/${KMACHINE}-bmc-${MACHINE}.dtb"
UBOOT_MACHINE = "evb-ast2500_defconfig"
UBOOT_DEVICETREE = "ast2500-evb"

require conf/machine/include/ast2500.inc
include conf/machine/include/vegman-bsp.inc
require ${@bb.utils.contains('BSP_TYPE', 'vegman', '', 'conf/machine/include/obmc-bsp-common.inc', d)}

SERIAL_CONSOLES = "115200;ttyS3 115200;ttyS4"
FLASH_SIZE = "65536"

IMAGE_FEATURES += "allow-root-login"

MACHINE_FEATURES += " \
    obmc-chassis-state-mgmt \
    obmc-host-ipmi \
    obmc-host-state-mgmt \
    obmc-phosphor-chassis-mgmt \
    obmc-phosphor-fan-mgmt \
    obmc-phosphor-flash-mgmt \
"

VIRTUAL-RUNTIME_obmc-host-state-manager ?= "x86-power-control"
VIRTUAL-RUNTIME_obmc-chassis-state-manager ?= "x86-power-control"
VIRTUAL-RUNTIME_obmc-discover-system-state ?= "x86-power-control"
VIRTUAL-RUNTIME_obmc-sensors-hwmon ?= "dbus-sensors"

PREFERRED_PROVIDER_virtual/obmc-chassis-mgmt = "packagegroup-yadro-apps"
PREFERRED_PROVIDER_virtual/obmc-fan-mgmt = "packagegroup-yadro-apps"
PREFERRED_PROVIDER_virtual/obmc-flash-mgmt = "packagegroup-yadro-apps"
PREFERRED_PROVIDER_virtual/obmc-system-mgmt = "packagegroup-yadro-apps"
PREFERRED_PROVIDER_virtual/obmc-host-ipmi-hw ?= "phosphor-ipmi-kcs"

PREFERRED_PROVIDER_virtual/phosphor-led-manager-config-native = "vegman-led-manager-config-native"

PREFERRED_PROVIDER_virtual/bootloader = "u-boot-aspeed-sdk"
PREFERRED_PROVIDER_u-boot = "u-boot-aspeed-sdk"
PREFERRED_PROVIDER_u-boot-fw-utils = "u-boot-fw-utils-aspeed-sdk"
```

## meta-yadro/meta-vegman/conf/machine/tatlin-archive-x86.conf
```bitbake
require conf/machine/include/vegman.inc
# Apply all the machine override from the VEGMAN Sx20, because
# the TATLIN.ARCHIVE.xS have an exactly same hardware as the VEGMAN Sx20
MACHINEOVERRIDES .= ":vegman-sx20"
KERNEL_DEVICETREE = "${KMACHINE}-bmc-vegman-sx20.dtb"
```

## meta-yadro/meta-vegman/conf/machine/vegman-rx20.conf
```bitbake
require conf/machine/include/vegman.inc
PREFERRED_PROVIDER_virtual/phosphor-led-manager-config-native = "rx20-led-manager-config-native"
```
