## meta-phosphor/conf/distro/include/phosphor-mrw.inc
```bitbake
DISTRO_FEATURES += "obmc-mrw"
DISTRO_FEATURES_FILTER_NATIVE += "obmc-mrw"
DISTRO_FEATURES_FILTER_NATIVESDK += "obmc-mrw"

DISTROOVERRIDES .= ":df-mrw"

VIRTUAL-RUNTIME_phosphor-hwmon-config:df-mrw ?= "phosphor-hwmon-config-mrw"

PREFERRED_PROVIDER_virtual/phosphor-ipmi-fru-inventory:df-mrw ?= "phosphor-ipmi-fru-inventory-mrw-native"
PREFERRED_PROVIDER_virtual/phosphor-ipmi-fru-properties:df-mrw ?= "phosphor-ipmi-fru-properties-mrw-native"
PREFERRED_PROVIDER_virtual/phosphor-ipmi-fru-read-inventory:df-mrw ?= "phosphor-ipmi-fru-read-inventory-mrw-native"
PREFERRED_PROVIDER_virtual/phosphor-ipmi-sensor-inventory:df-mrw ?= "phosphor-ipmi-sensor-inventory-mrw-native"
PREFERRED_PROVIDER_virtual/phosphor-ipmi-inventory-sel:df-mrw ?= "phosphor-ipmi-inventory-sel-mrw-native"
PREFERRED_PROVIDER_virtual/phosphor-logging-callouts:df-mrw ?= "phosphor-logging-callouts-mrw-native"
PREFERRED_PROVIDER_virtual/phosphor-fan-presence-config:df-mrw ?= "phosphor-fan-presence-mrw"
PREFERRED_PROVIDER_virtual/phosphor-fan-control-fan-config:df-mrw ?= "phosphor-fan-control-fan-config-mrw"
```

## meta-phosphor/conf/distro/include/phosphor-no-ipmi-rmcp.inc
```bitbake
DISTRO_FEATURES += "phosphor-no-ipmi-rmcp"
DISTROOVERRIDES += ":df-phosphor-no-ipmi-rmcp"

# libpam will disable IPMI modules when ipmi-rmcp is enabled, so we need to
# add pam-ipmi as a BAD_RECOMMENDATIONS.  Presently, these PAM modules are
# only used for phosphor-net-ipmid anyhow.
BAD_RECOMMENDATIONS:append = "pam-ipmi"
```

## meta-phosphor/conf/distro/include/phosphor-no-webui.inc
```bitbake
DISTRO_FEATURES += "phosphor-no-webui"
DISTROOVERRIDES .= ":df-phosphor-no-webui"
```

## meta-phosphor/conf/distro/include/phosphor-pkg-tweaks.inc
```bitbake
## Some packages do not allow a simple bbappend to tweak the PACKAGECONFIG
## because they can end up inheriting bbclasses, which cause other
## side-effects before the bbappend is applied.  Place tweaks for those
## packages in this file.

# Disable python from btrfs-tools
PACKAGECONFIG:remove:pn-btrfs-tools = "python"
```

## meta-phosphor/conf/distro/include/phosphor-production.inc
```bitbake
# This feature enables settings that may be more appropriate for production
# or deployment environments than development.

DISTRO_FEATURES += "phosphor-production"
DISTROOVERRIDES .= ":df-phosphor-production"
```

## meta-phosphor/conf/distro/include/phosphor-static-norootfs.inc
```bitbake
DISTRO_FEATURES += "obmc-static-norootfs"
DISTROOVERRIDES .= ":df-obmc-static-norootfs"
```

## meta-phosphor/conf/distro/include/phosphor-tiny.inc
```bitbake
# Include this to get minimum flash image created
DISTROOVERRIDES .= ":openbmc-phosphor-tiny"
```

## meta-phosphor/conf/distro/include/pldm.inc
```bitbake
DISTRO_FEATURES += "pldm"
DISTROOVERRIDES .= ":df-pldm"
require conf/distro/include/mctp.inc
```

## meta-phosphor/conf/layer.conf
```bitbake
# We have a conf and classes directory, add to BBPATH
BBPATH .= ":${LAYERDIR}"

# We have recipes-* directories, add to BBFILES
BBFILES += "${LAYERDIR}/recipes-*/*/*.bb \
            ${LAYERDIR}/recipes-*/*/*.bbappend"

BBFILE_COLLECTIONS += "phosphor-layer"
BBFILE_PATTERN_phosphor-layer := "^${LAYERDIR}/"
LAYERVERSION_phosphor-layer = "1"
LAYERDEPENDS_phosphor-layer = "core"
LAYERDEPENDS_phosphor-layer += "openembedded-layer"
LAYERDEPENDS_phosphor-layer += "meta-python"
LAYERDEPENDS_phosphor-layer += "networking-layer"
LAYERSERIES_COMPAT_phosphor-layer = "scarthgap styhead"

IMAGE_FEATURES[validitems] += "tools-profile"

BBFILES_DYNAMIC += " \
    aspeed-layer:${LAYERDIR}/dynamic-layers/aspeed-layer/recipes-*/*/*.bb \
    aspeed-layer:${LAYERDIR}/dynamic-layers/aspeed-layer/recipes-*/*/*.bbappend \
    nuvoton-layer:${LAYERDIR}/dynamic-layers/nuvoton-layer/recipes-*/*/*.bb \
    nuvoton-layer:${LAYERDIR}/dynamic-layers/nuvoton-layer/recipes-*/*/*.bbappend \
    tpm-layer:${LAYERDIR}/dynamic-layers/tpm-layer/recipes-*/*/*.bb \
    tpm-layer:${LAYERDIR}/dynamic-layers/tpm-layer/recipes-*/*/*.bbappend \
"
```

## meta-phosphor/conf/machine/include/ibm-power9-cpu.inc
```bitbake
MACHINEOVERRIDES =. "ibm-power9-cpu:"
require conf/machine/include/ibm-power-cpu.inc
```

## meta-phosphor/conf/machine/include/image-type/mmc.inc
```bitbake
IMAGE_FSTYPES += "wic.xz mmc-ext4-tar"
INITRAMFS_IMAGE = "obmc-phosphor-initramfs"
```

## meta-phosphor/conf/machine/include/image-type/static-norootfs.inc
```bitbake
INITRAMFS_CTYPE="zst"

IMAGE_FSTYPES += "cpio.${INITRAMFS_CTYPE}.fitImage mtd-static-norootfs"

# We don't want to build an initial kernel-based FIT image because the
# initramfs is going to be the eventual rootfs from this image and not
# a smaller initramfs.
INITRAMFS_IMAGE = ""
KERNEL_IMAGETYPE = "${ARCH_DEFAULT_KERNELIMAGETYPE}"
KERNEL_IMAGETYPES = "${ARCH_DEFAULT_KERNELIMAGETYPE}"
```

## meta-phosphor/conf/machine/include/image-type/static.inc
```bitbake
IMAGE_FSTYPES += "mtd-static mtd-static-tar mtd-static-alltar"
INITRAMFS_IMAGE = "obmc-phosphor-initramfs"
```

## meta-phosphor/conf/machine/include/obmc-bsp-common.inc
```bitbake
#@TYPE: Machine
#@NAME: OpenBMC
#@DESCRIPTION: Common machine configuration for OpenBMC chips

# FIT images are now built by the linux-yocto-fitimage recipe
KERNEL_CLASSES ?= "kernel-fit-extra-artifacts"
KERNEL_IMAGETYPE ?= "zImage"
KERNEL_IMAGETYPES ?= "zImage"

FLASH_SIZE ?= "32768"

OBMC_IMAGE_INCLUDE = "static"
OBMC_IMAGE_INCLUDE:df-obmc-static-norootfs = "static-norootfs"
OBMC_IMAGE_INCLUDE:df-obmc-ubi-fs = "ubi-fs"
OBMC_IMAGE_INCLUDE:df-phosphor-mmc = "mmc"

require conf/machine/include/image-type/${OBMC_IMAGE_INCLUDE}.inc

INITRAMFS_CTYPE ?= "xz"
INITRAMFS_FSTYPES = "cpio.${INITRAMFS_CTYPE}"
```

## meta-phosphor/conf/machine/include/obmc-evb-common.inc
```bitbake
# EVB systems have different packages they can support, due to not having a
# managed host.  Enable this machine override to allow other recipes to know
# that the machine is a special type.
MACHINEOVERRIDES =. "phosphor-evb:"
```

## meta-phosphor/conf/machine/include/redundant-bmc.inc
```bitbake
MACHINEOVERRIDES:append = ":mf-redundant-bmc"
MACHINE_FEATURES:append = " redundant-bmc"
```

## meta-phosphor/conf/machine/include/sample.inc
```bitbake
OBMC_MACHINE_FEATURES += "\
        obmc-phosphor-fan-mgmt \
        obmc-phosphor-chassis-mgmt \
        obmc-phosphor-sensor-mgmt \
        obmc-phosphor-flash-mgmt \
        "

PREFERRED_PROVIDER_virtual/obmc-host-ipmi-hw = "host-ipmi-hw-example"
PREFERRED_PROVIDER_virtual/obmc-chassis-mgmt = "obmc-phosphor-chassisd"
PREFERRED_PROVIDER_virtual/obmc-event-mgmt = "obmc-phosphor-event"
PREFERRED_PROVIDER_virtual/obmc-fan-mgmt = "obmc-phosphor-fand"
PREFERRED_PROVIDER_virtual/obmc-flash-mgmt = "obmc-phosphor-flashd"
PREFERRED_PROVIDER_virtual/obmc-sensor-mgmt = "obmc-phosphor-sensord"
PREFERRED_PROVIDER_virtual/obmc-system-mgmt = "obmc-phosphor-sysd"
PREFERRED_PROVIDER_virtual/obmc-user-mgmt = "obmc-phosphor-user"
```
