## meta-phosphor/conf/machine/include/tpm1.inc
```bitbake
MACHINE_FEATURES:append = " tpm1"
MACHINEOVERRIDES:append = ":mf-tpm1"
DISTRO_FEATURES:append = " tpm"
```

## meta-phosphor/conf/machine/include/tpm2.inc
```bitbake
MACHINE_FEATURES:append = " tpm2"
MACHINEOVERRIDES:append = ":mf-tpm2"
DISTRO_FEATURES:append = " tpm2"
```

## meta-portwell/meta-neptune/conf/layer.conf
```bitbake
# We have a conf and classes directory, add to BBPATH
BBPATH .= ":${LAYERDIR}"

# We have recipes-* directories, add to BBFILES
BBFILES += "${LAYERDIR}/recipes-*/*/*.bb \
            ${LAYERDIR}/recipes-*/*/*.bbappend"

BBFILE_COLLECTIONS += "neptune"
BBFILE_PATTERN_neptune = ""

LAYERSERIES_COMPAT_neptune = "dunfell gatesgarth"
```

## meta-portwell/meta-neptune/conf/machine/neptune.conf
```bitbake
KMACHINE = "aspeed"
KERNEL_DEVICETREE = "${KMACHINE}-bmc-portwell-${MACHINE}.dtb"

UBOOT_MACHINE = "ast_g5_ncsi_config"

require conf/machine/include/ast2500.inc
require conf/machine/include/obmc-bsp-common.inc

OBMC_MACHINE_FEATURES += "\
        obmc-phosphor-fan-mgmt \
        obmc-phosphor-chassis-mgmt \
        obmc-phosphor-flash-mgmt \
        obmc-host-ipmi \
        obmc-host-ctl \
        obmc-host-state-mgmt \
        obmc-chassis-state-mgmt \
        obmc-bmc-state-mgmt \
        "
FLASH_SIZE = "32768"
VIRTUAL-RUNTIME_skeleton_workbook = "${MACHINE}-config"
```

## meta-qualcomm/conf/layer.conf
```bitbake
# We have a conf and classes directory, add to BBPATH
BBPATH =. "${LAYERDIR}:"

# We have recipes-* directories, add to BBFILES
BBFILES += "${LAYERDIR}/recipes-*/*/*.bb \
            ${LAYERDIR}/recipes-*/*/*.bbappend"

BBFILE_COLLECTIONS += "qualcomm-layer"
BBFILE_PATTERN_qualcomm-layer := "^${LAYERDIR}/"

LAYERSERIES_COMPAT_qualcomm-layer = "scarthgap styhead"

QCOMBASE = '${@os.path.normpath("${LAYERDIR}/")}'
```

## meta-qualcomm/conf/machine/qcom-bmc-ast2600.conf
```bitbake
KERNEL_DEVICETREE = "aspeed/aspeed-ast2600-evb.dtb"

UBOOT_MACHINE = "ast2600_openbmc_spl_defconfig"
UBOOT_DEVICETREE = "ast2600-evb"
SPL_BINARY = "spl/u-boot-spl.bin"
SOCSEC_SIGN_ENABLE = "0"

require conf/machine/include/ast2600.inc
include conf/machine/include/obmc-bsp-common.inc

SERIAL_CONSOLES = "115200;ttyS4"

MACHINE_FEATURES += "\
    obmc-bmc-state-mgmt \
    obmc-host-ipmi \
    obmc-host-state-mgmt \
    "

FLASH_SIZE = "65536"

include conf/distro/include/mctp.inc

VIRTUAL-RUNTIME_obmc-sensors-hwmon = "dbus-sensors"

PREFERRED_PROVIDER_virtual/obmc-host-ipmi-hw = "phosphor-ipmi-ssif"

FEATURE_PACKAGES_obmc-system-mgmt = ""
```

## meta-qualcomm/conf/machine/qcom-dc-scm-v1.conf
```bitbake
KMACHINE = "aspeed"
KERNEL_DEVICETREE = "aspeed/aspeed-bmc-qcom-dc-scm-v1.dtb"
UBOOT_MACHINE = "ast2600_openbmc_spl_defconfig"
UBOOT_DEVICETREE = "ast2600-qcom-dc-scm-v1"
SPL_BINARY = "spl/u-boot-spl.bin"

# Disable hardware root of trust by default.
SOCSEC_SIGN_ENABLE = "0"

# Flash size is 64M
FLASH_SIZE = "65536"

require conf/machine/include/ast2600.inc
require conf/machine/include/obmc-bsp-common.inc

SERIAL_CONSOLES = "115200;ttyS4"

OBMC_MACHINE_FEATURES += "\
        obmc-bmc-state-mgmt \
        obmc-host-ipmi \
        obmc-host-state-mgmt \
        "

PREFERRED_PROVIDER_virtual/obmc-host-ipmi-hw = "phosphor-ipmi-ssif"

FEATURE_PACKAGES_obmc-system-mgmt = ""
```

## meta-qualcomm/meta-centriq2400-rep/conf/layer.conf
```bitbake
# We have a conf and classes directory, add to BBPATH
BBPATH .= ":${LAYERDIR}"

# We have recipes-* directories, add to BBFILES
BBFILES += "${LAYERDIR}/recipes-*/*/*.bb \
            ${LAYERDIR}/recipes-*/*/*.bbappend"

BBFILE_COLLECTIONS += "centriq2400-rep"
BBFILE_PATTERN_centriq2400-rep = ""
```

## meta-quanta/conf/layer.conf
```bitbake
# We have a conf and classes directory, add to BBPATH
BBPATH .= ":${LAYERDIR}"

# We have recipes-* directories, add to BBFILES
BBFILES += "${LAYERDIR}/meta-common/recipes-*/*/*.bb \
            ${LAYERDIR}/meta-common/recipes-*/*/*.bbappend"

BBFILE_COLLECTIONS += "quanta-layer"
BBFILE_PATTERN_quanta-layer := "^${LAYERDIR}/"
LAYERSERIES_COMPAT_quanta-layer = "scarthgap styhead"
LAYERDEPENDS_quanta-layer = "phosphor-layer"
```

## meta-quanta/meta-f0b/conf/layer.conf
```bitbake
# We have a conf and classes directory, add to BBPATH
BBPATH .= ":${LAYERDIR}"

# We have recipes-* directories, add to BBFILES
BBFILES += "${LAYERDIR}/recipes-*/*/*.bb \
            ${LAYERDIR}/recipes-*/*/*.bbappend"

BBFILE_COLLECTIONS += "f0b-layer"
BBFILE_PATTERN_f0b-layer = ""
LAYERSERIES_COMPAT_f0b-layer = "scarthgap styhead"
```

## meta-quanta/meta-f0b/conf/machine/f0b.conf
```bitbake
KMACHINE = "aspeed"

# The device tree of F0B is not ready yet, temporarily replace it with aspeed-ast2500-evb.dtb
KERNEL_DEVICETREE = "aspeed/${KMACHINE}-ast2500-evb.dtb"

PREFERRED_PROVIDER_virtual/bootloader = "u-boot-aspeed"
PREFERRED_PROVIDER_u-boot = "u-boot-aspeed"
PREFERRED_PROVIDER_u-boot-fw-utils = "u-boot-fw-utils-aspeed"
UBOOT_MACHINE = "ast_g5_phy_config"

MACHINE_EXTRA_RRECOMMENDS = "kernel-modules"

# Overwrite flash offsets
FLASH_UBOOT_OFFSET = "0"
FLASH_KERNEL_OFFSET = "512"
FLASH_UBI_OFFSET = "${FLASH_KERNEL_OFFSET}"
FLASH_ROFS_OFFSET = "4864"
FLASH_RWFS_OFFSET = "49152"
FLASH_SIZE = "65536"

require conf/machine/include/ast2500.inc
require conf/machine/include/obmc-bsp-common.inc

IMAGE_FEATURES:remove = "obmc-system-mgmt"

PREFERRED_PROVIDER_virtual/obmc-host-ipmi-hw = "phosphor-ipmi-kcs"
PREFERRED_PROVIDER_virtual/phosphor-ipmi-fru-inventory = "f0b-ipmi-inventory-map-native"
PREFERRED_PROVIDER_virtual/phosphor-ipmi-fru-read-inventory = "f0b-ipmi-fru-read-inventory-native"
```

## meta-quanta/meta-gbs/conf/bblayers.conf.sample
```bitbake
# LAYER_CONF_VERSION is increased each time build/conf/bblayers.conf
# changes incompatibly
LCONF_VERSION = "8"

BBPATH = "${TOPDIR}"
BBFILES ?= ""

BBLAYERS ?= " \
  ##OEROOT##/meta \
  ##OEROOT##/meta-openembedded/meta-oe \
  ##OEROOT##/meta-openembedded/meta-networking \
  ##OEROOT##/meta-openembedded/meta-python \
  ##OEROOT##/meta-phosphor \
  ##OEROOT##/meta-nuvoton \
  ##OEROOT##/meta-google \
  ##OEROOT##/meta-quanta \
  ##OEROOT##/meta-quanta/meta-gbs \
  "
BBLAYERS_NON_REMOVABLE ?= " \
  ##OEROOT##/meta \
  ##OEROOT##/meta-openembedded/meta-oe \
  ##OEROOT##/meta-openembedded/meta-networking \
  ##OEROOT##/meta-openembedded/meta-python \
  ##OEROOT##/meta-phosphor \
  ##OEROOT##/meta-nuvoton \
  ##OEROOT##/meta-google \
  ##OEROOT##/meta-quanta \
  ##OEROOT##/meta-quanta/meta-gbs \
  "
```

## meta-quanta/meta-gbs/conf/layer.conf
```bitbake
# We have a conf and classes directory, add to BBPATH
BBPATH .= ":${LAYERDIR}"

# We have recipes-* directories, add to BBFILES
BBFILES += "${LAYERDIR}/recipes-*/*/*.bb \
            ${LAYERDIR}/recipes-*/*/*.bbappend"

BBFILE_COLLECTIONS += "gbs-layer"
BBFILE_PATTERN_gbs-layer := "^${LAYERDIR}/"
LAYERSERIES_COMPAT_gbs-layer = "scarthgap styhead"
LAYERDEPENDS_gbs-layer = "core phosphor-layer google-layer quanta-layer"
```

## meta-quanta/meta-gbs/conf/machine/gbs.conf
```bitbake
KMACHINE = "nuvoton"
KERNEL_DEVICETREE = "nuvoton/${KMACHINE}-npcm730-gbs.dtb"

UBOOT_MACHINE = "PolegSVB_spinor_minimal_config"
UBOOT_DEVICETREE = "nuvoton-npcm730-gbs"
IGPS_MACHINE = "GBS"

MACHINEOVERRIDES .= ":npcm7xx"

require conf/machine/include/npcm7xx.inc
require conf/machine/include/obmc-bsp-common.inc

SERIAL_CONSOLES = "115200;ttyS0"
GBMC_NCSI_IF_NAME = "eth0"

# Overwrite flash offsets
FLASH_KERNEL_OFFSET:flash-65536 = "2048"
FLASH_ROFS_OFFSET:flash-65536 = "7168"
FLASH_RWFS_OFFSET:flash-65536 = "62400"
FLASH_SIZE = "65536"

PREFERRED_PROVIDER_virtual/obmc-host-ipmi-hw = "phosphor-ipmi-kcs"
PREFERRED_PROVIDER_virtual/phosphor-led-manager-config-native = "gbs-led-manager-config-native"
PREFERRED_PROVIDER_virtual/bios-update = "gbs-bios-update"
PREFERRED_PROVIDER_virtual/bmc-update = "gbs-bmc-update"

# Remove unneeded binaries from image
IMAGE_FEATURES:remove = "obmc-bmc-state-mgmt"
IMAGE_FEATURES:remove = "obmc-bmcweb"
IMAGE_FEATURES:remove = "obmc-chassis-mgmt"
IMAGE_FEATURES:remove = "obmc-chassis-state-mgmt"
IMAGE_FEATURES:remove = "obmc-console"
IMAGE_FEATURES:remove = "obmc-devtools"
IMAGE_FEATURES:remove = "obmc-fan-control"
IMAGE_FEATURES:remove = "obmc-fan-mgmt"
IMAGE_FEATURES:remove = "obmc-flash-mgmt"
IMAGE_FEATURES:remove = "obmc-health-monitor"
IMAGE_FEATURES:remove = "obmc-host-ipmi"
IMAGE_FEATURES:remove = "obmc-host-state-mgmt"
IMAGE_FEATURES:remove = "obmc-ikvm"
IMAGE_FEATURES:remove = "obmc-inventory"
IMAGE_FEATURES:remove = "obmc-leds"
IMAGE_FEATURES:remove = "obmc-logging-mgmt"
IMAGE_FEATURES:remove = "obmc-remote-logging-mgmt"
IMAGE_FEATURES:remove = "obmc-net-ipmi"
IMAGE_FEATURES:remove = "obmc-sensors"
IMAGE_FEATURES:remove = "obmc-software"
IMAGE_FEATURES:remove = "obmc-system-mgmt"
IMAGE_FEATURES:remove = "obmc-telemetry"
IMAGE_FEATURES:remove = "obmc-debug-collector"
IMAGE_FEATURES:remove = "obmc-settings-mgmt"
IMAGE_FEATURES:remove = "obmc-network-mgmt"
IMAGE_FEATURES:remove = "obmc-user-mgmt"
IMAGE_FEATURES:remove = "obmc-user-mgmt-ldap"
IMAGE_FEATURES:remove = "obmc-dmtf-pmci"
IMAGE_FEATURES:remove = "obmc-webui"
OBMC_IMAGE_BASE_INSTALL:remove = "packagegroup-obmc-apps-extras"
PACKAGECONFIG:remove:pn-entity-manager = "ipmi-fru"
```

## meta-quanta/meta-gsj/conf/distro/openbmc-gsj.conf
```bitbake
require conf/distro/openbmc-phosphor.conf

DISTRO_FEATURES:remove = "avahi"
DISTRO_FEATURES:remove = "slp"
```

## meta-quanta/meta-gsj/conf/layer.conf
```bitbake
# We have a conf and classes directory, add to BBPATH
BBPATH .= ":${LAYERDIR}"

# We have recipes-* directories, add to BBFILES
BBFILES += "${LAYERDIR}/recipes-*/*/*.bb \
            ${LAYERDIR}/recipes-*/*/*.bbappend"

BBFILE_COLLECTIONS += "gsj-layer"
BBFILE_PATTERN_gsj-layer := "^${LAYERDIR}/"
LAYERSERIES_COMPAT_gsj-layer = "langdale mickledore"
LAYERDEPENDS_gsj-layer = "core phosphor-layer google-layer quanta-layer"
```

## meta-quanta/meta-gsj/conf/machine/gsj.conf
```bitbake
KMACHINE = "nuvoton"
KERNEL_DEVICETREE = "${KMACHINE}-npcm730-gsj.dtb"

UBOOT_MACHINE = "PolegSVB_config"
IGPS_MACHINE = "EB"

FLASH_SIZE = "32768"
require conf/machine/include/npcm7xx.inc
require conf/machine/include/obmc-bsp-common.inc

IMAGE_FSTYPES += " cpio.${INITRAMFS_CTYPE}.u-boot"
IMAGE_FSTYPES += " mtd-ubi-tar"

MACHINE_FEATURES += "\
        obmc-phosphor-fan-mgmt \
        obmc-phosphor-chassis-mgmt \
        obmc-phosphor-flash-mgmt \
        obmc-host-state-mgmt \
        obmc-chassis-state-mgmt \
        obmc-bmc-state-mgmt \
        "
# Remove unneeded binaries from image
IMAGE_FEATURES:remove = "obmc-bmc-state-mgmt"
IMAGE_FEATURES:remove = "obmc-bmcweb"
IMAGE_FEATURES:remove = "obmc-chassis-state-mgmt"
IMAGE_FEATURES:remove = "obmc-chassis-mgmt"
IMAGE_FEATURES:remove = "obmc-console"
IMAGE_FEATURES:remove = "obmc-devtools"
IMAGE_FEATURES:remove = "obmc-fan-control"
IMAGE_FEATURES:remove = "obmc-fan-mgmt"
IMAGE_FEATURES:remove = "obmc-flash-mgmt"
IMAGE_FEATURES:remove = "obmc-fru-ipmi"
IMAGE_FEATURES:remove = "obmc-health-monitor"
IMAGE_FEATURES:remove = "obmc-host-ipmi"
IMAGE_FEATURES:remove = "obmc-host-state-mgmt"
IMAGE_FEATURES:remove = "obmc-ikvm"
IMAGE_FEATURES:remove = "obmc-inventory"
IMAGE_FEATURES:remove = "obmc-leds"
IMAGE_FEATURES:remove = "obmc-logging-mgmt"
IMAGE_FEATURES:remove = "obmc-remote-logging-mgmt"
IMAGE_FEATURES:remove = "obmc-rng"
IMAGE_FEATURES:remove = "obmc-sensors"
IMAGE_FEATURES:remove = "obmc-settings-mgmt"
IMAGE_FEATURES:remove = "obmc-software"
IMAGE_FEATURES:remove = "obmc-system-mgmt"
IMAGE_FEATURES:remove = "obmc-user-mgmt"
IMAGE_FEATURES:remove = "obmc-user-mgmt-ldap"
IMAGE_FEATURES:remove = "obmc-debug-collector"
IMAGE_FEATURES:remove = "obmc-network-mgmt"
IMAGE_FEATURES:remove = "obmc-telemetry"
OBMC_IMAGE_BASE_INSTALL:remove = "packagegroup-obmc-apps-extras"

PREFERRED_PROVIDER_virtual/obmc-chassis-mgmt = "packagegroup-gsj-apps"
PREFERRED_PROVIDER_virtual/obmc-fan-mgmt = "packagegroup-gsj-apps"
PREFERRED_PROVIDER_virtual/obmc-flash-mgmt = "packagegroup-gsj-apps"
PREFERRED_PROVIDER_virtual/phosphor-ipmi-fru-inventory = "gsj-ipmi-inventory-map-native"
PREFERRED_PROVIDER_virtual/phosphor-ipmi-fru-properties = "gsj-ipmi-fru-properties-native"
PREFERRED_PROVIDER_virtual/phosphor-ipmi-fru-read-inventory = "gsj-ipmi-fru-read-inventory-native"
PREFERRED_PROVIDER_virtual/phosphor-ipmi-sensor-inventory = "gsj-ipmi-sensor-map-native"
PREFERRED_PROVIDER_virtual/phosphor-led-manager-config-native = "gsj-led-manager-config-native"
```

## meta-quanta/meta-olympus-nuvoton/conf/distro/olympus-emmc-entity.conf
```bitbake
require conf/distro/openbmc-phosphor.conf
require conf/distro/include/phosphor-mmc.inc

VIRTUAL-RUNTIME_obmc-inventory-manager = "entity-manager"
VIRTUAL-RUNTIME_obmc-sensors-hwmon = "dbus-sensors"
PREFERRED_PROVIDER_virtual/obmc-inventory-data = "entity-manager"

DISTRO = "olympus-emmc"
DISTRO:append = "-entity"
DISTRO_NAME = "Nuvoton OpenBMC (Olympus-Entity Manager)"
DISTRO_FEATURES:append = " entity-manager"
DISTRO_FEATURES:append = " ipmi-fru"
DISTROOVERRIDES .= ":olympus-entity"
BAD_RECOMMENDATIONS:remove = "e2fsprogs-e2fsck"

# eMMC layout
# max uboot image size in SPI partition is 768K
MMC_UBOOT_SIZE = "640"

WKS_FILE ?= "emmc-olympus.wks.in"
WKS_FILE_DEPENDS ?= " \
    virtual/bootloader \
    virtual/kernel \
    "
IMAGE_BOOT_FILES ?= "fitImage-${INITRAMFS_IMAGE}-${MACHINE}-${MACHINE};fitImage"
```

## meta-quanta/meta-olympus-nuvoton/conf/distro/olympus-emmc.conf
```bitbake
require conf/distro/openbmc-phosphor.conf
require conf/distro/include/phosphor-mmc.inc

DISTRO = "olympus-emmc"
BAD_RECOMMENDATIONS:remove = "e2fsprogs-e2fsck"

# eMMC layout
# max uboot image size in SPI partition is 768K
MMC_UBOOT_SIZE = "640"

WKS_FILE ?= "emmc-olympus.wks.in"
WKS_FILE_DEPENDS ?= " \
    virtual/bootloader \
    virtual/kernel \
    "
IMAGE_BOOT_FILES ?= "fitImage-${INITRAMFS_IMAGE}-${MACHINE}-${MACHINE};fitImage"
```

## meta-quanta/meta-olympus-nuvoton/conf/distro/olympus-entity.conf
```bitbake
require conf/distro/openbmc-phosphor.conf

VIRTUAL-RUNTIME_obmc-inventory-manager = "entity-manager"
VIRTUAL-RUNTIME_obmc-sensors-hwmon = "dbus-sensors"
PREFERRED_PROVIDER_virtual/obmc-inventory-data = "entity-manager"

DISTRO = "olympus-entity"
DISTRO_NAME = "Nuvoton OpenBMC (Olympus-Entity Manager)"
DISTRO_FEATURES:append = " entity-manager"
DISTRO_FEATURES:append = " ipmi-fru"
DISTROOVERRIDES .= ":olympus-entity"

# Remove unneeded binaries from image
IMAGE_FEATURES:remove = "obmc-health-monitor"
```

## meta-quanta/meta-olympus-nuvoton/conf/layer.conf
```bitbake
# We have a conf and classes directory, add to BBPATH
BBPATH .= ":${LAYERDIR}"

# We have recipes-* directories, add to BBFILES
BBFILES += "${LAYERDIR}/recipes-*/*/*.bb \
            ${LAYERDIR}/recipes-*/*/*.bbappend"

BBFILE_COLLECTIONS += "olympus-nuvoton-layer"
BBFILE_PATTERN_olympus-nuvoton-layer := "^${LAYERDIR}/"
LAYERSERIES_COMPAT_olympus-nuvoton-layer = "dunfell gatesgarth"
```
