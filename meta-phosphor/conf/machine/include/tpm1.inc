## meta-quanta/meta-olympus-nuvoton/conf/machine/olympus-nuvoton.conf
```bitbake
KMACHINE = "nuvoton"
KERNEL_DEVICETREE = "${KMACHINE}-npcm750-runbmc-olympus.dtb"

require conf/machine/include/npcm7xx.inc
require conf/machine/include/obmc-bsp-common.inc

FLASH_SIZE = "65536"
# avoid image_types_phosphor.bbclass override
FLASH_UBOOT_OFFSET:flash-65536 = "0"
FLASH_KERNEL_OFFSET:flash-65536 = "2048"
FLASH_ROFS_OFFSET:flash-65536 = "8192"
FLASH_RWFS_OFFSET:flash-65536 = "62464"

UBOOT_MACHINE = "PolegRunBMC_defconfig"
UBOOT_DEVICETREE = "nuvoton-npcm750-olympus"
IGPS_MACHINE = "RunBMC"

IMAGE_FSTYPES += " cpio.${INITRAMFS_CTYPE}.u-boot"
IMAGE_FSTYPES += "${@bb.utils.contains('DISTRO_FEATURES', \
        'phosphor-mmc', \
        'wic.gz mmc-ext4-tar', \
        '', d)}"

MACHINE_FEATURES += "\
        obmc-phosphor-fan-mgmt \
        obmc-phosphor-chassis-mgmt \
        obmc-phosphor-flash-mgmt \
        obmc-host-ipmi \
        obmc-host-state-mgmt \
        obmc-chassis-state-mgmt \
        obmc-bmc-state-mgmt \
        "

KCS_DEVICE = "ipmi-kcs1"

VIRTUAL-RUNTIME_obmc-host-state-manager = "x86-power-control"
VIRTUAL-RUNTIME_obmc-chassis-state-manager = "x86-power-control"
VIRTUAL-RUNTIME_obmc-discover-system-state = "x86-power-control"

PREFERRED_PROVIDER_virtual/obmc-chassis-mgmt = "packagegroup-olympus-nuvoton-apps"
PREFERRED_PROVIDER_virtual/obmc-fan-mgmt = "packagegroup-olympus-nuvoton-apps"
PREFERRED_PROVIDER_virtual/obmc-flash-mgmt = "packagegroup-olympus-nuvoton-apps"
PREFERRED_PROVIDER_virtual/obmc-system-mgmt = "packagegroup-olympus-nuvoton-apps"
PREFERRED_PROVIDER_virtual/obmc-host-ipmi-hw = "phosphor-ipmi-kcs"
PREFERRED_PROVIDER_virtual/phosphor-led-manager-config-native = "olympus-nuvoton-led-manager-config-native"
PREFERRED_PROVIDER_virtual/phosphor-logging-callouts = "olympus-nuvoton-phosphor-logging-callouts-native"

MACHINEOVERRIDES .= ":olympus-nuvoton"
```

## meta-quanta/meta-q71l/conf/machine/quanta-q71l.conf
```bitbake
KMACHINE = "aspeed"
KERNEL_DEVICETREE = "${KMACHINE}-bmc-${MACHINE}.dtb"

require conf/machine/include/ast2400.inc
require conf/machine/include/obmc-bsp-common.inc

UBOOT_MACHINE_palmetto = "ast_g4_ncsi_config"
UBOOT_ENTRYPOINT = "0x40008000"
UBOOT_LOADADDRESS = "0x40008000"

FLASH_SIZE = "32768"

# If we included the openpower.inc we'd get these from that.
#OBMC_MACHINE_FEATURES += "\
#        obmc-phosphor-fan-mgmt \
#        obmc-phosphor-chassis-mgmt \
#        obmc-phosphor-flash-mgmt \
#        obmc-host-ipmi \
#        obmc-host-ctl \
#        obmc-host-state-mgmt \
#        obmc-chassis-state-mgmt \
#        obmc-bmc-state-mgmt \
#        "
# But we don't, and it's ok :D  We're pulling in specific packages in an image recipe.

# These are meant to include the inventory config.yaml and so on.
PREFERRED_PROVIDER_virtual/phosphor-ipmi-fru-inventory = "q71l-ipmi-inventory-map-native"
PREFERRED_PROVIDER_virtual/phosphor-ipmi-sensor-inventory = "q71l-ipmi-sensor-map-native"
PREFERRED_PROVIDER_virtual/phosphor-ipmi-fru-merge-config = "q71l-ipmi-fru-merge-config-native"


PREFERRED_PROVIDER_virtual/obmc-host-ipmi-hw = "phosphor-ipmi-bt"
```

## meta-quanta/meta-runbmc-nuvoton/conf/layer.conf
```bitbake
# We have a conf and classes directory, add to BBPATH
BBPATH .= ":${LAYERDIR}"

# We have recipes-* directories, add to BBFILES
BBFILES += "${LAYERDIR}/recipes-*/*/*.bb \
            ${LAYERDIR}/recipes-*/*/*.bbappend"

BBFILE_COLLECTIONS += "runbmc-nuvoton-layer"
BBFILE_PATTERN_runbmc-nuvoton-layer := "^${LAYERDIR}/"
LAYERSERIES_COMPAT_runbmc-nuvoton-layer = "thud warrior"
```
