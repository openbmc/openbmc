## import-layers/meta-raspberrypi/conf/machine/raspberrypi3.conf
```bitbake
#@TYPE: Machine
#@NAME: RaspberryPi 3 Development Board
#@DESCRIPTION: Machine configuration for the RaspberryPi 3

DEFAULTTUNE ?= "cortexa7thf-neon-vfpv4"
require conf/machine/include/tune-cortexa7.inc
include conf/machine/include/rpi-base.inc

MACHINE_EXTRA_RRECOMMENDS += "\
    linux-firmware-bcm43430 \
    linux-firmware-bcm43455 \
    linux-firmware-bcm43430a1-hcd \
    linux-firmware-bcm4345c0-hcd \
"

SDIMG_KERNELIMAGE ?= "kernel7.img"
UBOOT_MACHINE = "rpi_3_32b_config"
SERIAL_CONSOLE ?= "115200 ttyS0"
VC4_CMA_SIZE ?= "cma-256"
```

## import-layers/meta-raspberrypi/scripts/lib/image/canned-wks/sdimage-raspberrypi.wks
```
# short-description: Create Raspberry Pi SD card image
# long-description: Creates a partitioned SD card image for use with
# Raspberry Pi. Boot files are located in the first vfat partition.

part /boot --source bootimg-partition --ondisk mmcblk --fstype=vfat --label boot --active --align 4096 --size 20
part / --source rootfs --ondisk mmcblk --fstype=ext4 --label root --align 4096
```

## import-layers/meta-virtualization/conf/distro/include/meta-virt-default-versions.inc
```bitbake
# Meta-virtuailization PREFERED_VERSION

PREFERRED_VERSION_python-blinker = "1.3"
PREFERRED_VERSION_python-gevent = "1.0.1"
PREFERRED_VERSION_python-m2crypto = "0.22.3"
PREFERRED_VERSION_python-pyyaml = "3.11"
PREFERRED_VERSION_python-redis = "2.10.3"
PREFERRED_VERSION_python-sqlalchemy = "1.1.5"
PREFERRED_VERSION_python-werkzeug = "0.10.4"
```

## import-layers/meta-virtualization/conf/distro/include/virt_security_flags.inc
```bitbake
# Build errors with the pie options enabled
SECURITY_CFLAGS_pn-libvirt = "${SECURITY_NO_PIE_CFLAGS}"

# This has text relco errors with the pie options enabled
SECURITY_CFLAGS_pn-lxc = "${SECURITY_NO_PIE_CFLAGS}"
```

## import-layers/meta-virtualization/conf/layer.conf
```bitbake
# We have a conf and classes directory, append to BBPATH
BBPATH .= ":${LAYERDIR}"

# We have a recipes directory, add to BBFILES
BBFILES += "${LAYERDIR}/recipes*/*/*.bb ${LAYERDIR}/recipes*/*/*.bbappend"

BBFILE_COLLECTIONS += "virtualization-layer"
BBFILE_PATTERN_virtualization-layer := "^${LAYERDIR}/"
BBFILE_PRIORITY_virtualization-layer = "8"

# Custom licenses used by some packages in this layer
LICENSE_PATH += "${LAYERDIR}/files/custom-licenses"

# This should only be incremented on significant changes that will
# cause compatibility issues with other layers
LAYERVERSION_virtualization-layer = "1"
LAYERSERIES_COMPAT_virtualization-layer = "sumo"
LAYERDEPENDS_virtualization-layer = "core networking-layer"

# Override security flags
require conf/distro/include/virt_security_flags.inc

PREFERRED_PROVIDER_virtual/runc ?= "runc-docker"
PREFERRED_PROVIDER_virtual/containerd ?= "containerd-opencontainers"

# Sanity check for meta-virtualization layer.
# Setting SKIP_META_VIRT_SANITY_CHECK to "1" would skip the bbappend files check.
INHERIT += "sanity-meta-virt"

require ${@bb.utils.contains('DISTRO_FEATURES', 'virtualization', 'meta-virt-default-versions.inc', '', d)}
```

## import-layers/yocto-poky/meta-poky/conf/distro/include/poky-floating-revisions.inc
```bitbake
#
# Package Versions for cutting edge testing:
#

#SRCREV_pn-opkg-native ?= "${AUTOREV}"
#SRCREV_pn-opkg-sdk ?= "${AUTOREV}"
#SRCREV_pn-opkg ?= "${AUTOREV}"
#SRCREV_pn-opkg-utils-native ?= "${AUTOREV}"
#SRCREV_pn-opkg-utils ?= "${AUTOREV}"
SRCREV_pn-gconf-dbus ?= "${AUTOREV}"
SRCREV_pn-matchbox-common ?= "${AUTOREV}"
SRCREV_pn-matchbox-config-gtk ?= "${AUTOREV}"
SRCREV_pn-matchbox-desktop ?= "${AUTOREV}"
SRCREV_pn-matchbox-keyboard ?= "${AUTOREV}"
SRCREV_pn-matchbox-panel-2 ?= "${AUTOREV}"
SRCREV_pn-matchbox-themes-extra ?= "${AUTOREV}"
SRCREV_pn-matchbox-terminal ?= "${AUTOREV}"
SRCREV_pn-matchbox-wm ?= "${AUTOREV}"
SRCREV_pn-settings-daemon ?= "${AUTOREV}"
SRCREV_pn-screenshot ?= "${AUTOREV}"
SRCREV_pn-libfakekey ?= "${AUTOREV}"
SRCREV_pn-psplash ?= "${AUTOREV}"
SRCREV_pn-gtk-sato-engine ?= "${AUTOREV}"
SRCREV_pn-matchbox-theme-sato ?= "${AUTOREV}"
SRCREV_pn-sato-icon-theme ?= "${AUTOREV}"
SRCREV_pn-matchbox-desktop-sato ?= "${AUTOREV}"
SRCREV_pn-oh-puzzles ?= "${AUTOREV}"
SRCREV_pn-libowl ?= "${AUTOREV}"
SRCREV_pn-fstests ?= "${AUTOREV}"
SRCREV_pn-xvideo-tests ?= "${AUTOREV}"
SRCREV_pn-clutter ?= "${AUTOREV}"
SRCREV_pn-clutter-gst ?= "${AUTOREV}"
SRCREV_pn-libmatchbox ?= "${AUTOREV}"
SRCREV_pn-ofono ?= "${AUTOREV}"

SRCREV_pn-dri2proto = "${AUTOREV}"
#PREFERRED_VERSION_dri2proto ?= "1.99.1+git%"
SRCREV_pn-libdrm = "${AUTOREV}"
#PREFERRED_VERSION_libdrm ?= "2.4.0+git%"
SRCREV_pn-libxcb = "${AUTOREV}"
#PREFERRED_VERSION_libxcb ?= "1.1.90.1+gitr%"
SRCREV_pn-lib-proto = "${AUTOREV}"
#PREFERRED_VERSION_xcb-proto ?= "1.2+gitr%"
SRCREV_pn-libxcb-sdk = "${AUTOREV}"
#PREFERRED_VERSION_libxcb-sdk ?= "1.1.90.1+gitr%"
SRCREV_pn-xf86-input-evdev = "${AUTOREV}"
#PREFERRED_VERSION_xf86-input-evdev ?= "2.0.4"
SRCREV_pn-xf86-input-mouse = "${AUTOREV}"
#PREFERRED_VERSION_xf86-input-mouse ?= "1.3.0+git%"
SRCREV_pn-xf86-input-keyboard = "${AUTOREV}"
#PREFERRED_VERSION_xf86-input-keyboard ?= "1.3.1+git%"
SRCREV_pn-xf86-input-synaptics = "${AUTOREV}"
#PREFERRED_VERSION_xf86-input-synaptics ?= "0.15.2+git%"

#SRCDATE_oprofile ?= "${DATE}"

PREFERRED_VERSION_oprofile ?= "0.9.4+cvs${SRCDATE_oprofile}"
```

## import-layers/yocto-poky/meta-poky/conf/distro/poky-lsb.conf
```bitbake
require conf/distro/poky.conf
require conf/distro/include/security_flags.inc

DISTRO = "poky-lsb"
DISTROOVERRIDES = "poky:linuxstdbase"

DISTRO_FEATURES_append = " pam largefile opengl"
PREFERRED_PROVIDER_virtual/libx11 = "libx11"

# Ensure the kernel nfs server is enabled
KERNEL_FEATURES_append_pn-linux-yocto = " features/nfsd/nfsd-enable.scc"

# Use the LTSI Kernel for LSB Testing
PREFERRED_VERSION_linux-yocto_linuxstdbase ?= "4.14%"
```

## import-layers/yocto-poky/meta-poky/conf/distro/poky.conf
```bitbake
DISTRO = "poky"
DISTRO_NAME = "Poky (Yocto Project Reference Distro)"
DISTRO_VERSION = "2.1"
DISTRO_CODENAME = "krogoth"
SDK_VENDOR = "-pokysdk"
SDK_VERSION := "${@'${DISTRO_VERSION}'.replace('snapshot-${DATE}','snapshot')}"

MAINTAINER = "Poky <poky@yoctoproject.org>"

TARGET_VENDOR = "-poky"

LOCALCONF_VERSION = "1"

DISTRO_VERSION[vardepsexclude] = "DATE"
SDK_VERSION[vardepsexclude] = "DATE"

# Override these in poky based distros
POKY_DEFAULT_DISTRO_FEATURES = "largefile opengl ptest multiarch wayland"
POKY_DEFAULT_EXTRA_RDEPENDS = "packagegroup-core-boot"
POKY_DEFAULT_EXTRA_RRECOMMENDS = "kernel-module-af-packet"

DISTRO_FEATURES ?= "${DISTRO_FEATURES_DEFAULT} ${DISTRO_FEATURES_LIBC} ${POKY_DEFAULT_DISTRO_FEATURES}"

PREFERRED_VERSION_linux-yocto ?= "4.4%"
PREFERRED_VERSION_linux-yocto_qemux86 ?= "4.4%"
PREFERRED_VERSION_linux-yocto_qemux86-64 ?= "4.4%"
PREFERRED_VERSION_linux-yocto_qemuarm ?= "4.4%"
PREFERRED_VERSION_linux-yocto_qemumips ?= "4.4%"
PREFERRED_VERSION_linux-yocto_qemumips64 ?= "4.4%"
PREFERRED_VERSION_linux-yocto_qemuppc ?= "4.4%"

SDK_NAME = "${DISTRO}-${TCLIBC}-${SDK_ARCH}-${IMAGE_BASENAME}-${TUNE_PKGARCH}"
SDKPATH = "/opt/${DISTRO}/${SDK_VERSION}"

DISTRO_EXTRA_RDEPENDS += " ${POKY_DEFAULT_EXTRA_RDEPENDS}"
DISTRO_EXTRA_RRECOMMENDS += " ${POKY_DEFAULT_EXTRA_RRECOMMENDS}"

POKYQEMUDEPS = "${@bb.utils.contains("INCOMPATIBLE_LICENSE", "GPL-3.0", "", "packagegroup-core-device-devel",d)}"
DISTRO_EXTRA_RDEPENDS_append_qemuarm = " ${POKYQEMUDEPS}"
DISTRO_EXTRA_RDEPENDS_append_qemuarm64 = " ${POKYQEMUDEPS}"
DISTRO_EXTRA_RDEPENDS_append_qemumips = " ${POKYQEMUDEPS}"
DISTRO_EXTRA_RDEPENDS_append_qemuppc = " ${POKYQEMUDEPS}"
DISTRO_EXTRA_RDEPENDS_append_qemux86 = " ${POKYQEMUDEPS}"
DISTRO_EXTRA_RDEPENDS_append_qemux86-64 = " ${POKYQEMUDEPS}"

TCLIBCAPPEND = ""

QEMU_TARGETS ?= "arm aarch64 i386 mips mipsel mips64 ppc x86_64"
# Other QEMU_TARGETS "mips64el sh4"

PREMIRRORS ??= "\
bzr://.*/.*   http://downloads.yoctoproject.org/mirror/sources/ \n \
cvs://.*/.*   http://downloads.yoctoproject.org/mirror/sources/ \n \
git://.*/.*   http://downloads.yoctoproject.org/mirror/sources/ \n \
gitsm://.*/.* http://downloads.yoctoproject.org/mirror/sources/ \n \
hg://.*/.*    http://downloads.yoctoproject.org/mirror/sources/ \n \
osc://.*/.*   http://downloads.yoctoproject.org/mirror/sources/ \n \
p4://.*/.*    http://downloads.yoctoproject.org/mirror/sources/ \n \
svn://.*/.*   http://downloads.yoctoproject.org/mirror/sources/ \n"

MIRRORS =+ "\
ftp://.*/.*      http://downloads.yoctoproject.org/mirror/sources/ \n \
http://.*/.*     http://downloads.yoctoproject.org/mirror/sources/ \n \
https://.*/.*    http://downloads.yoctoproject.org/mirror/sources/ \n"

# The CONNECTIVITY_CHECK_URI's are used to test whether we can succesfully
# fetch from the network (and warn you if not). To disable the test set
# the variable to be empty.
# Git example url: git://git.yoctoproject.org/yocto-firewall-test;protocol=git;rev=master
CONNECTIVITY_CHECK_URIS ?= "https://www.example.com/"

SANITY_TESTED_DISTROS ?= " \
            poky-1.7 \n \
            poky-1.8 \n \
            poky-2.0 \n \
            Ubuntu-14.04 \n \
            Ubuntu-14.10 \n \
            Ubuntu-15.04 \n \
            Ubuntu-15.10 \n \
            Fedora-21 \n \
            Fedora-22 \n \
            Fedora-23 \n \
            CentOS-6.* \n \
            CentOS-7.* \n \
            Debian-7.* \n \
            Debian-8.* \n \
            openSUSE-project-13.2 \n \
            "
#
# OELAYOUT_ABI allows us to notify users when the format of TMPDIR changes in 
# an incompatible way. Such changes should usually be detailed in the commit
# that breaks the format and have been previously discussed on the mailing list 
# with general agreement from the core team.
#
OELAYOUT_ABI = "11"

# add poky sanity bbclass
INHERIT += "poky-sanity"

# QA check settings - a little stricter than the OE-Core defaults
WARN_TO_ERROR_QA = "already-stripped compile-host-path install-host-path \
                    installed-vs-shipped ldflags pn-overrides rpaths staticdev \
                    useless-rpaths"
WARN_QA_remove = "${WARN_TO_ERROR_QA}"
ERROR_QA_append = " ${WARN_TO_ERROR_QA}"

require conf/distro/include/poky-world-exclude.inc
require conf/distro/include/no-static-libs.inc
require conf/distro/include/yocto-uninative.inc
INHERIT += "uninative"
```

## import-layers/yocto-poky/meta-selftest/recipes-test/images/wic-image-minimal.wks
```
# short-description: Example of partitioned image with complex layout
# long-description: This image contains boot partition and 3 rootfs partitions
# created from core-image-minimal and wic-image-minimal image recipes.

part /boot --source bootimg-pcbios --ondisk sda --label boot --active --align 1024
part / --source rootfs --ondisk sda --fstype=ext4 --label platform --align 1024 --use-uuid
part /media --source rootfs --rootfs-dir=wic-image-minimal --ondisk sda --fstype=ext4 --label uuid-test --align 1024 --use-uuid --fsuuid 2c71ef06-a81d-4735-9d3a-379b69c6bdba
part /mnt --source rootfs --rootfs-dir=wic-image-minimal --ondisk sda --fstype=ext4 --label core --align 1024

bootloader --ptable gpt --timeout=0  --append="rootwait console=tty0"
```

## import-layers/yocto-poky/meta-yocto-bsp/conf/machine/beaglebone.conf
```bitbake
#@TYPE: Machine
#@NAME: Beaglebone machine
#@DESCRIPTION: Machine configuration for http://beagleboard.org/bone and http://beagleboard.org/black boards

PREFERRED_PROVIDER_virtual/xserver ?= "xserver-xorg"
XSERVER ?= "xserver-xorg \
           xf86-video-modesetting \
           "

MACHINE_EXTRA_RRECOMMENDS = " kernel-modules kernel-devicetree"

EXTRA_IMAGEDEPENDS += "u-boot"

DEFAULTTUNE ?= "cortexa8hf-neon"
include conf/machine/include/tune-cortexa8.inc

IMAGE_FSTYPES += "tar.bz2 jffs2 wic wic.bmap"
EXTRA_IMAGECMD_jffs2 = "-lnp "
WKS_FILE ?= "beaglebone.wks"
IMAGE_INSTALL_append = " kernel-devicetree kernel-image-zimage"
do_image_wic[depends] += "mtools-native:do_populate_sysroot dosfstools-native:do_populate_sysroot"

SERIAL_CONSOLE = "115200 ttyO0"

PREFERRED_PROVIDER_virtual/kernel ?= "linux-yocto"
PREFERRED_VERSION_linux-yocto ?= "4.12%"

KERNEL_IMAGETYPE = "zImage"
KERNEL_DEVICETREE = "am335x-bone.dtb am335x-boneblack.dtb am335x-bonegreen.dtb"
KERNEL_EXTRA_ARGS += "LOADADDR=${UBOOT_ENTRYPOINT}"

SPL_BINARY = "MLO"
UBOOT_SUFFIX = "img"
UBOOT_MACHINE = "am335x_boneblack_config"
UBOOT_ENTRYPOINT = "0x80008000"
UBOOT_LOADADDRESS = "0x80008000"

MACHINE_FEATURES = "usbgadget usbhost vfat alsa"

IMAGE_BOOT_FILES ?= "u-boot.${UBOOT_SUFFIX} MLO"
```

## import-layers/yocto-poky/meta-yocto-bsp/conf/machine/edgerouter.conf
```bitbake
#@TYPE: Machine
#@NAME: Edgerouter
#@DESCRIPTION: Edgerouter

require conf/machine/include/tune-mips64.inc

MACHINE_FEATURES = "pci ext2 ext3 serial"

KERNEL_IMAGETYPE = "vmlinux"
KERNEL_ALT_IMAGETYPE = "vmlinux.bin"
KERNEL_IMAGE_STRIP_EXTRA_SECTIONS  = ".comment"

PREFERRED_PROVIDER_virtual/kernel ?= "linux-yocto"
PREFERRED_VERSION_linux-yocto ?= "4.4%"

SERIAL_CONSOLE = "115200 ttyS0"
USE_VT ?= "0"

MACHINE_EXTRA_RRECOMMENDS = " kernel-modules"

IMAGE_FSTYPES ?= "jffs2 tar.bz2"
JFFS2_ERASEBLOCK = "0x10000"
```

## import-layers/yocto-poky/meta-yocto-bsp/conf/machine/genericx86-64.conf
```bitbake
#@TYPE: Machine
#@NAME: Generic X86_64.

#@DESCRIPTION: Machine configuration for generic X86_64 (64-bit) PCs and servers. Supports a moderately wide range of drivers that should boot and be usable on "typical" hardware.

DEFAULTTUNE ?= "core2-64"
require conf/machine/include/tune-core2.inc
require conf/machine/include/genericx86-common.inc

PREFERRED_VERSION_linux-yocto ?= "4.10%"

SERIAL_CONSOLES_CHECK = "ttyS0"
```

## import-layers/yocto-poky/meta-yocto-bsp/conf/machine/include/genericx86-common.inc
```bitbake
include conf/machine/include/x86-base.inc
MACHINE_FEATURES += "wifi efi pcbios"

PREFERRED_PROVIDER_virtual/kernel ?= "linux-yocto"
PREFERRED_VERSION_linux-yocto ?= "4.4%"
PREFERRED_PROVIDER_virtual/xserver ?= "xserver-xorg"
XSERVER ?= "${XSERVER_X86_BASE} \
            ${XSERVER_X86_EXT} \
            ${XSERVER_X86_I915} \
            ${XSERVER_X86_I965} \
            ${XSERVER_X86_FBDEV} \
            ${XSERVER_X86_VESA} \
            ${XSERVER_X86_MODESETTING} \
           "

MACHINE_EXTRA_RRECOMMENDS += "linux-firmware eee-acpi-scripts"

GLIBC_ADDONS = "nptl"

EXTRA_OECONF_append_pn-matchbox-panel-2 = " --with-battery=acpi"
```

## import-layers/yocto-poky/meta-yocto-bsp/wic/beaglebone.wks
```
# short-description: Create SD card image for Beaglebone
# long-description: Creates a partitioned SD card image for Beaglebone.
# Boot files are located in the first vfat partition.

part /boot --source bootimg-partition --ondisk mmcblk --fstype=vfat --label boot --active --align 4 --size 16
part / --source rootfs --ondisk mmcblk --fstype=ext4 --label root --align 4
```

## import-layers/yocto-poky/meta-yocto-bsp/wic/mpc8315e-rdb.wks
```
# short-description: Create SD card image for MPC8315E-RDB
# long-description: Create a partitioned SD card image for Freescale MPC8315E-RDB reference hardware.
part /boot --source bootimg-partition --ondisk sdb --fstype=ext3 --label boot
part / --source rootfs --ondisk sdb --fstype=ext3 --label root
```

## import-layers/yocto-poky/meta-yocto/conf/layer.conf
```bitbake
# Dummy file to allow for meta-yocto -> meta-poky transition
BBPATH =. "${LAYERDIR}/../meta-poky:"
```

## import-layers/yocto-poky/meta/conf/distro/include/as-needed.inc
```bitbake
ASNEEDED = "-Wl,--as-needed"

ASNEEDED_pn-babeltrace = ""
ASNEEDED_pn-console-tools = ""
ASNEEDED_pn-distcc = ""
ASNEEDED_pn-openobex = ""
ASNEEDED_pn-icu = ""
ASNEEDED_pn-pciutils = ""
ASNEEDED_pn-puzzles = ""
ASNEEDED_pn-pulseaudio = ""
ASNEEDED_pn-rpm = ""

TARGET_LDFLAGS += "${ASNEEDED}"
```
