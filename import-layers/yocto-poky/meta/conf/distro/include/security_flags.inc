## import-layers/yocto-poky/meta/conf/machine/include/tune-ppce5500.inc
```bitbake
DEFAULTTUNE ?= "ppce5500"

require conf/machine/include/powerpc/arch-powerpc64.inc

TUNEVALID[e5500] = "Enable Freescale e5500 specific processor optimizations"
TUNE_CCARGS .= "${@bb.utils.contains('TUNE_FEATURES', 'e5500', ' -mcpu=e5500', '', d)}"

AVAILTUNES += "ppce5500 ppc64e5500"
TUNE_FEATURES_tune-ppce5500 = "m32 fpu-hard e5500"
BASE_LIB_tune-ppce5500 = "lib"
TUNE_PKGARCH_tune-ppce5500 = "ppce5500"
PACKAGE_EXTRA_ARCHS_tune-ppce5500 = "${PACKAGE_EXTRA_ARCHS_tune-powerpc} ppce5500"

TUNE_FEATURES_tune-ppc64e5500 = "m64 fpu-hard e5500"
BASE_LIB_tune-ppc64e5500 = "lib64"
TUNE_PKGARCH_tune-ppc64e5500 = "ppc64e5500"
PACKAGE_EXTRA_ARCHS_tune-ppc64e5500 = "${PACKAGE_EXTRA_ARCHS_tune-powerpc64} ppc64e5500"

# glibc configure options to get e5500 specific library (for sqrt)
GLIBC_EXTRA_OECONF += "${@bb.utils.contains('TUNE_FEATURES', 'e5500', '--with-cpu=e5500', '', d)}"

# QEMU usermode fails with invalid instruction error (YOCTO: #10304)
MACHINE_FEATURES_BACKFILL_CONSIDERED_append = "${@bb.utils.contains('TUNE_FEATURES', 'e5500', ' qemu-usermode', '', d)}"
```

## import-layers/yocto-poky/meta/conf/machine/include/tune-sh3.inc
```bitbake
DEFAULTTUNE ?= "sh3"

require conf/machine/include/sh/arch-sh.inc

TUNEVALID[sh3] = "Enable SH3 optimizations"
TUNE_CCARGS .= "${@bb.utils.contains('TUNE_FEATURES', 'sh3', ' -m3', '', d)}"

AVAILTUNES += "sh3 sh3eb"
TUNE_FEATURES_tune-sh3 = "sh3"
TUNE_ARCH_tune-sh3 = "sh3"
TUNE_PKGARCH_tune-sh3 = "sh3"
PACKAGE_EXTRA_ARCHS_tune-sh3 = "sh sh3"

TUNE_FEATURES_tune-sh3eb = "sh3 bigendian"
TUNE_ARCH_tune-sh3eb = "sh3eb"
TUNE_PKGARCH_tune-sh3eb = "sh3eb"
PACKAGE_EXTRA_ARCHS_tune-sh3eb = "sheb sh3eb"
```

## import-layers/yocto-poky/meta/conf/machine/include/tune-sh4.inc
```bitbake
DEFAULTTUNE ?= "sh4"

# Pull in sh4 for compatibility...
require conf/machine/include/sh/arch-sh.inc

TUNEVALID[sh4] = "Enable SH4 optimizations"
TUNE_CCARGS .= "${@bb.utils.contains('TUNE_FEATURES', 'sh4', ' -m4', '', d)}"

# NOTE: If you want to optimize to sh4a, conf/machine/include/tune-sh4a.inc.
# But it is not compatible for sh4.
# The binary optimized by m4a doesn't operate on sh4. It works on sh4a only.
TUNEVALID[sh4a] = "Enable SH4a optimizations"
TUNE_CCARGS .= "${@bb.utils.contains('TUNE_FEATURES', 'sh4a', ' -m4a', '', d)}"

AVAILTUNES += "sh4 sh4eb sh4a sh4aeb"
TUNE_FEATURES_tune-sh4 = "sh4"
TUNE_ARCH_tune-sh4 = "sh4"
TUNE_PKGARCH_tune-sh4 = "sh4"
PACKAGE_EXTRA_ARCHS_tune-sh4 = "sh sh4"

TUNE_FEATURES_tune-sh4eb = "sh4 bigendian"
TUNE_ARCH_tune-sh4eb = "sh4eb"
TUNE_PKGARCH_tune-sh4eb = "sh4eb"
PACKAGE_EXTRA_ARCHS_tune-sh4eb = "sheb sh4eb"

TUNE_FEATURES_tune-sh4a = "sh4a"
TUNE_ARCH_tune-sh4a = "sh4"
TUNE_PKGARCH_tune-sh4a = "sh4a"
PACKAGE_EXTRA_ARCHS_tune-sh4a = "sh sh4 sh4a"

TUNE_FEATURES_tune-sh4aeb = "sh4a bigendian"
TUNE_ARCH_tune-sh4aeb = "sh4eb"
TUNE_PKGARCH_tune-sh4aeb = "sh4aeb"
PACKAGE_EXTRA_ARCHS_tune-sh4aeb = "sheb sh4eb sh4aeb"
```

## import-layers/yocto-poky/meta/conf/machine/include/tune-supersparc.inc
```bitbake
TUNE_ARCH = "sparc"

TUNE_CCARGS = "-mcpu=supersparc"
TUNE_PKGARCH = "supersparc"
```
