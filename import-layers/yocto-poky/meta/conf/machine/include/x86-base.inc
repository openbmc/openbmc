## import-layers/yocto-poky/scripts/lib/bsp/substrate/target/arch/x86_64/conf/machine/machine.conf
```bitbake
# yocto-bsp-filename {{=machine}}.conf
#@TYPE: Machine
#@NAME: {{=machine}}

#@DESCRIPTION: Machine configuration for {{=machine}} systems

{{ if kernel_choice == "custom": preferred_kernel = "linux-yocto-custom" }}
{{ if kernel_choice == "linux-yocto-dev": preferred_kernel = "linux-yocto-dev" }}
{{ if kernel_choice == "custom" or kernel_choice == "linux-yocto-dev" : }}
PREFERRED_PROVIDER_virtual/kernel ?= "{{=preferred_kernel}}"

{{ if kernel_choice != "custom" and kernel_choice != "linux-yocto-dev": preferred_kernel = kernel_choice.split('_')[0] }}
{{ if kernel_choice != "custom" and kernel_choice != "linux-yocto-dev": preferred_kernel_version = kernel_choice.split('_')[1] }}
{{ if kernel_choice != "custom" and kernel_choice != "linux-yocto-dev": }}
PREFERRED_PROVIDER_virtual/kernel ?= "{{=preferred_kernel}}"
PREFERRED_VERSION_{{=preferred_kernel}} ?= "{{=preferred_kernel_version}}%"

{{ input type:"choicelist" name:"tunefile" prio:"40" msg:"Which machine tuning would you like to use?" default:"tune_core2" }}
{{ input type:"choice" val:"tune_core2" msg:"Core2 tuning optimizations" }}
{{ input type:"choice" val:"tune_corei7" msg:"Corei7 tuning optimizations" }}
{{ if tunefile == "tune_core2": }}
DEFAULTTUNE ?= "core2-64"
require conf/machine/include/tune-core2.inc
{{ if tunefile == "tune_corei7": }}
DEFAULTTUNE ?= "corei7-64"
require conf/machine/include/tune-corei7.inc

require conf/machine/include/x86-base.inc

MACHINE_FEATURES += "wifi efi pcbios"

{{ input type:"boolean" name:"xserver" prio:"50" msg:"Do you need support for X? (y/n)" default:"y" }}

{{ if xserver == "y": }}
{{ input type:"choicelist" name:"xserver_choice" prio:"50" msg:"Please select an xserver for this machine:" default:"xserver_i915" }}

{{ input type:"choice" val:"xserver_vesa" msg:"VESA xserver support" }}
{{ input type:"choice" val:"xserver_i915" msg:"i915 xserver support" }}
{{ input type:"choice" val:"xserver_i965" msg:"i965 xserver support" }}
{{ input type:"choice" val:"xserver_fbdev" msg:"fbdev xserver support" }}
{{ input type:"choice" val:"xserver_modesetting" msg:"modesetting xserver support" }}
{{ if xserver == "y": }}
XSERVER ?= "${XSERVER_X86_BASE} \
           ${XSERVER_X86_EXT} \
{{ if xserver == "y" and xserver_choice == "xserver_vesa": }}
           ${XSERVER_X86_VESA} \
{{ if xserver == "y" and xserver_choice == "xserver_i915": }}
           ${XSERVER_X86_I915} \
{{ if xserver == "y" and xserver_choice == "xserver_i965": }}
           ${XSERVER_X86_I965} \
{{ if xserver == "y" and xserver_choice == "xserver_fbdev": }}
           ${XSERVER_X86_FBDEV} \
{{ if xserver == "y" and xserver_choice == "xserver_modesetting": }}
           ${XSERVER_X86_MODESETTING} \
{{ if xserver == "y": }}
           "

MACHINE_EXTRA_RRECOMMENDS += "linux-firmware v86d eee-acpi-scripts"

EXTRA_OECONF_append_pn-matchbox-panel-2 = " --with-battery=acpi"

GLIBC_ADDONS = "nptl"

{{ if xserver == "y" and xserver_choice == "xserver_vesa": }}
APPEND += "video=vesafb vga=0x318"
```

## import-layers/yocto-poky/scripts/lib/wic/canned-wks/directdisk.wks
```
# short-description: Create a 'pcbios' direct disk image
# long-description: Creates a partitioned legacy BIOS disk image that the user
# can directly dd to boot media.

include common.wks.inc

bootloader  --timeout=0  --append="rootwait rootfstype=ext4 video=vesafb vga=0x318 console=tty0"
```

## import-layers/yocto-poky/scripts/lib/wic/canned-wks/mkefidisk.wks
```
# short-description: Create an EFI disk image
# long-description: Creates a partitioned EFI disk image that the user
# can directly dd to boot media.

part /boot --source bootimg-efi --sourceparams="loader=grub-efi" --ondisk sda --label msdos --active --align 1024

part / --source rootfs --ondisk sda --fstype=ext4 --label platform --align 1024

part swap --ondisk sda --size 44 --label swap1 --fstype=swap

bootloader  --timeout=10  --append="rootwait rootfstype=ext4 console=ttyPCH0,115200 console=tty0 vmalloc=256MB snd-hda-intel.enable_msi=0"
```

## import-layers/yocto-poky/scripts/lib/wic/canned-wks/mkhybridiso.wks
```
# short-description: Create a hybrid ISO image
# long-description: Creates an EFI and legacy bootable hybrid ISO image
# which can be used on optical media as well as USB media.

part /boot --source isoimage-isohybrid --sourceparams="loader=grub-efi,image_name=HYBRID_ISO_IMG" --ondisk cd --label HYBRIDISO --fstype=ext4

bootloader  --timeout=15  --append=""
```

## import-layers/yocto-poky/scripts/lib/wic/canned-wks/sdimage-bootpart.wks
```
# short-description: Create SD card image with a boot partition
# long-description: Creates a partitioned SD card image. Boot files
# are located in the first vfat partition.

part /boot --source bootimg-partition --ondisk mmcblk --fstype=vfat --label boot --active --align 4 --size 16
part / --source rootfs --ondisk mmcblk --fstype=ext4 --label root --align 4
```

## import-layers/yocto-poky/scripts/lib/wic/canned-wks/systemd-bootdisk.wks
```
# short-description: Create an EFI disk image with systemd-boot
# long-description: Creates a partitioned EFI disk image that the user
# can directly dd to boot media. The selected bootloader is systemd-boot.

part /boot --source bootimg-efi --sourceparams="loader=systemd-boot" --ondisk sda --label msdos --active --align 1024 --use-uuid

part / --source rootfs --ondisk sda --fstype=ext4 --label platform --align 1024 --use-uuid

part swap --ondisk sda --size 44 --label swap1 --fstype=swap --use-uuid

bootloader --ptable gpt --timeout=5 --append="rootwait rootfstype=ext4 console=ttyS0,115200 console=tty0"
```

## meta-alibaba/conf/layer.conf
```bitbake
# We have a conf and classes directory, add to BBPATH
BBPATH .= ":${LAYERDIR}"
# We have recipes-* directories, add to BBFILES

BBFILE_COLLECTIONS += "alibaba-layer"
BBFILE_PATTERN_alibaba-layer = "^${LAYERDIR}/"
LAYERSERIES_COMPAT_alibaba-layer = "dunfell gatesgarth"
```

## meta-alibaba/meta-thor/conf/bblayers.conf.sample
```bitbake
# LAYER_CONF_VERSION is increased each time build/conf/bblayers.conf
# changes incompatibly
LCONF_VERSION = "8"
BBPATH = "${TOPDIR}"
BBFILES ?= ""
BBLAYERS ?= " \
  ##OEROOT##/meta \
  ##OEROOT##/meta-openembedded/meta-oe \
  ##OEROOT##/meta-openembedded/meta-networking \
  ##OEROOT##/meta-openembedded/meta-perl \
  ##OEROOT##/meta-openembedded/meta-python \
  ##OEROOT##/meta-phosphor \
  ##OEROOT##/meta-aspeed \
  ##OEROOT##/meta-alibaba \
  ##OEROOT##/meta-alibaba/meta-thor \
  "
BBLAYERS_NON_REMOVABLE ?= " \
  ##OEROOT##/meta \
  ##OEROOT##/meta-openembedded/meta-oe \
  ##OEROOT##/meta-openembedded/meta-networking \
  ##OEROOT##/meta-openembedded/meta-perl \
  ##OEROOT##/meta-openembedded/meta-python \
  ##OEROOT##/meta-phosphor \
  ##OEROOT##/meta-aspeed \
  ##OEROOT##/meta-alibaba \
  ##OEROOT##/meta-alibaba/meta-thor \
  "
```

## meta-alibaba/meta-thor/conf/layer.conf
```bitbake
# We have a conf and classes directory, add to BBPATH
BBPATH .= ":${LAYERDIR}"
# We have recipes-* directories, add to BBFILES
BBFILES += "${LAYERDIR}/recipes-*/*/*.bb \
            ${LAYERDIR}/recipes-*/*/*.bbappend"

BBFILE_COLLECTIONS += ""
BBFILE_PATTERN := "^${LAYERDIR}/"
LAYERSERIES_COMPAT = "dunfell gatesgarth"
```

## meta-alibaba/meta-thor/conf/machine/thor.conf
```bitbake
KERNEL_DEVICETREE = "${KMACHINE}-alibaba-${MACHINE}.dtb"
KMACHINE = "aspeed"
require conf/machine/include/ast2500.inc


UBOOT_MACHINE = "ast_g5_phy_config"
FLASH_SIZE = "32768"

# below contents will be gathered by macro 'MACHINE_FEATURES' which defined in phosphor-base.inc file
OBMC_MACHINE_FEATURES += "\
        "
VIRTUAL-RUNTIME_skeleton_workbook = "alibaba-ast2500-config"
PREFERRED_PROVIDER_virtual/obmc-system-mgmt = "packagegroup-alibaba-apps"
PREFERRED_PROVIDER_virtual/obmc-tools-mgmt = "packagegroup-alibaba-apps"
```

## meta-amd/conf/layer.conf
```bitbake
# We have a conf and classes directory, add to BBPATH
BBPATH .= ":${LAYERDIR}"

# We have recipes-* directories, add to BBFILES
BBFILES += "${LAYERDIR}/meta-common/recipes-*/*/*.bb \
            ${LAYERDIR}/meta-common/recipes-*/*/*.bbappend"

BBFILE_COLLECTIONS += "amd-layer"
BBFILE_PATTERN_amd-layer = "^${LAYERDIR}/meta-common/"
LAYERSERIES_COMPAT_amd-layer = "scarthgap styhead"
```

## meta-amd/conf/machine/include/amd-withhost.inc
```bitbake
MACHINEOVERRIDES =. "amd-withhost:"

require conf/machine/include/amd.inc

MACHINE_FEATURES:append = "\
        obmc-chassis-state-mgmt \
        obmc-host-state-mgmt \
        obmc-phosphor-chassis-mgmt \
        obmc-host-ipmi \
        "

VIRTUAL-RUNTIME_obmc-host-state-manager ?= "x86-power-control"
VIRTUAL-RUNTIME_obmc-chassis-state-manager ?= "x86-power-control"

PREFERRED_PROVIDER_virtual/obmc-chassis-mgmt = "packagegroup-amd-apps"
PREFERRED_PROVIDER_virtual/obmc-host-ipmi-hw ?= "phosphor-ipmi-kcs"
```

## meta-amd/conf/machine/include/amd.inc
```bitbake
MACHINE_FEATURES += "\
        obmc-bmc-state-mgmt \
        obmc-phosphor-fan-mgmt \
        obmc-phosphor-flash-mgmt \
        "

VIRTUAL-RUNTIME_obmc-sensors-hwmon ?= "dbus-sensors"
VIRTUAL-RUNTIME_obmc-inventory-manager = "entity-manager"

PREFERRED_PROVIDER_virtual/obmc-inventory-data = "entity-manager"
PREFERRED_PROVIDER_virtual/obmc-fan-mgmt = "packagegroup-amd-apps"
PREFERRED_PROVIDER_virtual/obmc-flash-mgmt = "packagegroup-amd-apps"
PREFERRED_PROVIDER_virtual/obmc-system-mgmt = "packagegroup-amd-apps"

OVERRIDES .= ":amd"
```
