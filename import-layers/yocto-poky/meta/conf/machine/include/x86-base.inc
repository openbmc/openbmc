## import-layers/yocto-poky/meta/conf/machine/include/x86-base.inc
```bitbake
#
# Base machine settings for X86 architecture BSPs
#

#
# common settings for X86 machines
#
MACHINE_FEATURES += "screen keyboard pci usbhost ext2 ext3 x86 \
                     acpi serial usbgadget alsa"

MACHINE_EXTRA_RRECOMMENDS += "kernel-modules"

IMAGE_FSTYPES ?= "live"
NOISO ?= "1"

KERNEL_IMAGETYPE ?= "bzImage"

SERIAL_CONSOLE ?= "115200 ttyS0"

#
# kernel-related variables
#
PREFERRED_PROVIDER_virtual/kernel ??= "linux-yocto"
PREFERRED_VERSION_linux-yocto ??= "4.12%"

#
# XSERVER subcomponents, used to build the XSERVER variable
#
XSERVER_X86_BASE = "xserver-xorg \
           "

XSERVER_X86_EXT = " \
           ${@bb.utils.contains('DISTRO_FEATURES', 'opengl', 'xserver-xorg-extension-glx', '', d)} \
           xserver-xorg-module-libint10 \
           "

XSERVER_X86_I915 = "xf86-video-intel \
           ${@bb.utils.contains('DISTRO_FEATURES', 'opengl', 'mesa-driver-i915', '', d)} \
           "

XSERVER_X86_I965 = "xf86-video-intel \
           ${@bb.utils.contains('DISTRO_FEATURES', 'opengl', 'mesa-driver-i965', '', d)} \
           "

XSERVER_X86_VESA = "xf86-video-vesa"

XSERVER_X86_FBDEV = "xf86-video-fbdev"

XSERVER_X86_MODESETTING = "xf86-video-modesetting"
```

## import-layers/yocto-poky/meta/conf/machine/include/x86/arch-x86.inc
```bitbake
#
# X86 Architecture definition (IA32, X86_64, and X32)
#

DEFAULTTUNE ?= "x86"
TARGET_FPU ?= ""
X86ARCH32 ?= "i586"
X86ARCH64 ?= "x86_64"

TUNE_PKGARCH = "${TUNE_PKGARCH_tune-${DEFAULTTUNE}}"

# ELF32 ABI
TUNEVALID[m32] = "IA32 ELF32 standard ABI"
TUNECONFLICTS[m32] = "m64 mx32"
TUNE_ARCH .= "${@bb.utils.contains('TUNE_FEATURES', 'm32', '${X86ARCH32}', '' ,d)}"
TUNE_CCARGS .= "${@bb.utils.contains('TUNE_FEATURES', 'm32', ' -m32', '', d)}"
MACHINEOVERRIDES =. "${@bb.utils.contains('TUNE_FEATURES', 'm32', 'x86:', '' ,d)}"

# x32 ABI
TUNEVALID[mx32] = "IA32e (x86_64) ELF32 standard ABI"
TUNECONFLICTS[mx32] = "m64 m32"
TUNE_ARCH .= "${@bb.utils.contains('TUNE_FEATURES', 'mx32', '${X86ARCH64}', '' ,d)}"
ABIEXTENSION .= "${@bb.utils.contains('TUNE_FEATURES', 'mx32', 'x32', '' ,d)}"
TUNE_CCARGS .= "${@bb.utils.contains('TUNE_FEATURES', 'mx32', ' -mx32', '', d)}"
TUNE_LDARGS += "${@bb.utils.contains('TUNE_FEATURES', 'mx32', '-m elf32_x86_64', '', d)}"
TUNE_ASARGS += "${@bb.utils.contains('TUNE_FEATURES', 'mx32', '-x32', '', d)}"
# user mode qemu doesn't support x32
MACHINE_FEATURES_BACKFILL_CONSIDERED_append = " ${@bb.utils.contains('TUNE_FEATURES', 'mx32', 'qemu-usermode', '', d)}"
MACHINEOVERRIDES =. "${@bb.utils.contains('TUNE_FEATURES', 'mx32', 'x86-x32:', '' ,d)}"

# ELF64 ABI
TUNEVALID[m64] = "IA32e (x86_64) ELF64 standard ABI"
TUNECONFLICTS[m64] = "m32 mx32"
TUNE_ARCH .= "${@bb.utils.contains('TUNE_FEATURES', 'm64', '${X86ARCH64}', '' ,d)}"
TUNE_CCARGS .= "${@bb.utils.contains('TUNE_FEATURES', 'm64', ' -m64', '', d)}"

# Default Tune configurations
AVAILTUNES += "x86"
TUNE_FEATURES_tune-x86 = "m32"
BASE_LIB_tune-x86 = "lib"
TUNE_PKGARCH_tune-x86 = "x86"
PACKAGE_EXTRA_ARCHS_tune-x86 = "${TUNE_PKGARCH_tune-x86}"

AVAILTUNES += "x86-64"
TUNE_FEATURES_tune-x86-64 = "m64"
BASE_LIB_tune-x86-64 = "lib64"
TUNE_PKGARCH_tune-x86-64 = "x86_64"
PACKAGE_EXTRA_ARCHS_tune-x86-64 = "${TUNE_PKGARCH_tune-x86-64}"

AVAILTUNES += "x86-64-x32"
TUNE_FEATURES_tune-x86-64-x32 = "mx32"
BASE_LIB_tune-x86-64-x32 = "libx32"
TUNE_PKGARCH_tune-x86-64-x32 = "x86_64_x32"
PACKAGE_EXTRA_ARCHS_tune-x86-64-x32 = "${TUNE_PKGARCH_tune-x86-64-x32}"
```

## import-layers/yocto-poky/meta/conf/machine/qemuarm.conf
```bitbake
#@TYPE: Machine
#@NAME: arm_versatile_926ejs
#@DESCRIPTION: arm_versatile_926ejs

require conf/machine/include/qemu.inc
require conf/machine/include/tune-arm926ejs.inc
#require conf/machine/include/tune-arm1136jf-s.inc

KERNEL_IMAGETYPE = "zImage"

SERIAL_CONSOLES ?= "115200;ttyAMA0 115200;ttyAMA1"

# For runqemu
QB_SYSTEM_NAME = "qemu-system-arm"
QB_MACHINE = "-machine versatilepb"
QB_KERNEL_CMDLINE_APPEND = "console=ttyAMA0,115200 console=tty"
# Add the 'virtio-rng-pci' device otherwise the guest may run out of entropy
QB_OPT_APPEND = "-show-cursor -usb -device usb-tablet -device virtio-rng-pci"
PREFERRED_VERSION_linux-yocto ??= "4.12%"
QB_DTB = "${@base_version_less_or_equal('PREFERRED_VERSION_linux-yocto', '4.7', '', 'zImage-versatile-pb.dtb', d)}"
```

## import-layers/yocto-poky/meta/conf/machine/qemuarm64.conf
```bitbake
#@TYPE: Machine
#@NAME: generic armv8 machine
#@DESCRIPTION: Machine configuration for running a generic armv8

require conf/machine/include/arm/arch-armv8.inc
require conf/machine/include/qemu.inc

KERNEL_IMAGETYPE = "Image"

SERIAL_CONSOLES = "38400;ttyAMA0 38400;hvc0"
```

## import-layers/yocto-poky/meta/conf/machine/qemumips.conf
```bitbake
#@TYPE: Machine
#@NAME: mti_malta32_be MIPS
#@DESCRIPTION: mti_malta32_be

require conf/machine/include/qemu.inc
require conf/machine/include/tune-mips32r2.inc

KERNEL_IMAGETYPE = "vmlinux"
KERNEL_ALT_IMAGETYPE = "vmlinux.bin"

SERIAL_CONSOLES = "115200;ttyS0 115200;ttyS1"

MACHINE_EXTRA_RRECOMMENDS = " kernel-modules"
```

## import-layers/yocto-poky/meta/conf/machine/qemumips64.conf
```bitbake
#@TYPE: Machine
#@NAME: mti-malta64-be MIPS64
#@DESCRIPTION: mti-malta64-be

require conf/machine/include/qemu.inc
require conf/machine/include/tune-mips64.inc
require conf/machine/include/qemuboot-mips.inc

KERNEL_IMAGETYPE = "vmlinux"
KERNEL_ALT_IMAGETYPE = "vmlinux.bin"

SERIAL_CONSOLES ?= "115200;ttyS0 115200;ttyS1"

MACHINE_EXTRA_RRECOMMENDS = " kernel-modules"
```

## import-layers/yocto-poky/meta/conf/machine/qemuppc.conf
```bitbake
#@TYPE: Machine
#@NAME: qemu PPC Emulator setup
#@DESCRIPTION: Machine configuration for running an PPC system under qemu emulation

require conf/machine/include/qemu.inc
require conf/machine/include/tune-ppc7400.inc

TARGET_CC_KERNEL_ARCH = "-mno-spe"

KERNEL_IMAGETYPE = "vmlinux"

SERIAL_CONSOLES = "115200;ttyS0 115200;ttyS1"
```

## import-layers/yocto-poky/scripts/lib/bsp/substrate/target/arch/arm/conf/machine/machine.conf
```bitbake
# yocto-bsp-filename {{=machine}}.conf
#@TYPE: Machine
#@NAME: {{=machine}}

#@DESCRIPTION: Machine configuration for {{=machine}} systems

{{ input type:"boolean" name:"xserver" prio:"50" msg:"Do you need support for X? (y/n)" default:"y" }}
{{ if xserver == "y": }}
PREFERRED_PROVIDER_virtual/xserver ?= "xserver-xorg"
XSERVER ?= "xserver-xorg \
           xf86-video-fbdev \
           "

MACHINE_EXTRA_RRECOMMENDS = " kernel-modules kernel-devicetree"

EXTRA_IMAGEDEPENDS += "u-boot"

{{ input type:"choicelist" name:"tunefile" prio:"40" msg:"Which machine tuning would you like to use?" default:"tune_cortexa8" }}
{{ input type:"choice" val:"tune_arm1136jf_s" msg:"arm1136jf-s tuning optimizations" }}
{{ input type:"choice" val:"tune_arm920t" msg:"arm920t tuning optimizations" }}
{{ input type:"choice" val:"tune_arm926ejs" msg:"arm926ejs tuning optimizations" }}
{{ input type:"choice" val:"tune_arm9tdmi" msg:"arm9tdmi tuning optimizations" }}
{{ input type:"choice" val:"tune_cortexa5" msg:"cortexa5 tuning optimizations" }}
{{ input type:"choice" val:"tune_cortexa7" msg:"cortexa7 tuning optimizations" }}
{{ input type:"choice" val:"tune_cortexa8" msg:"cortexa8 tuning optimizations" }}
{{ input type:"choice" val:"tune_cortexa9" msg:"cortexa9 tuning optimizations" }}
{{ input type:"choice" val:"tune_cortexa15" msg:"cortexa15 tuning optimizations" }}
{{ input type:"choice" val:"tune_cortexm1" msg:"cortexm1 tuning optimizations" }}
{{ input type:"choice" val:"tune_cortexm3" msg:"cortexm3 tuning optimizations" }}
{{ input type:"choice" val:"tune_cortexr4" msg:"cortexr4 tuning optimizations" }}
{{ input type:"choice" val:"tune_ep9312" msg:"ep9312 tuning optimizations" }}
{{ input type:"choice" val:"tune_iwmmxt" msg:"iwmmxt tuning optimizations" }}
{{ input type:"choice" val:"tune_strongarm1100" msg:"strongarm1100 tuning optimizations" }}
{{ input type:"choice" val:"tune_xscale" msg:"xscale tuning optimizations" }}
{{ if tunefile == "tune_arm1136jf_s": }}
include conf/machine/include/tune-arm1136jf-s.inc
{{ if tunefile == "tune_arm920t": }}
include conf/machine/include/tune-arm920t.inc
{{ if tunefile == "tune_arm926ejs": }}
include conf/machine/include/tune-arm926ejs.inc
{{ if tunefile == "tune_arm9tdmi": }}
include conf/machine/include/tune-arm9tdmi.inc
{{ if tunefile == "tune_cortexa5": }}
include conf/machine/include/tune-cortexa5.inc
{{ if tunefile == "tune_cortexa7": }}
include conf/machine/include/tune-cortexa7.inc
{{ if tunefile == "tune_cortexa8": }}
DEFAULTTUNE ?= "cortexa8hf-neon"
include conf/machine/include/tune-cortexa8.inc
{{ if tunefile == "tune_cortexa9": }}
include conf/machine/include/tune-cortexa9.inc
{{ if tunefile == "tune_cortexa15": }}
include conf/machine/include/tune-cortexa15.inc
{{ if tunefile == "tune_cortexm1": }}
include conf/machine/include/tune-cortexm1.inc
{{ if tunefile == "tune_cortexm3": }}
include conf/machine/include/tune-cortexm3.inc
{{ if tunefile == "tune_cortexr4": }}
include conf/machine/include/tune-cortexr4.inc
{{ if tunefile == "tune_ep9312": }}
include conf/machine/include/tune-ep9312.inc
{{ if tunefile == "tune_iwmmxt": }}
include conf/machine/include/tune-iwmmxt.inc
{{ if tunefile == "tune_strongarm1100": }}
include conf/machine/include/tune-strongarm1100.inc
{{ if tunefile == "tune_xscale": }}
include conf/machine/include/tune-xscale.inc

IMAGE_FSTYPES += "tar.bz2 jffs2"
EXTRA_IMAGECMD_jffs2 = "-lnp "

SERIAL_CONSOLE = "115200 ttyO0"

{{ if kernel_choice == "custom": preferred_kernel = "linux-yocto-custom" }}
{{ if kernel_choice == "linux-yocto-dev": preferred_kernel = "linux-yocto-dev" }}
{{ if kernel_choice == "custom" or kernel_choice == "linux-yocto-dev" : }}
PREFERRED_PROVIDER_virtual/kernel ?= "{{=preferred_kernel}}"

{{ if kernel_choice != "custom" and kernel_choice != "linux-yocto-dev": preferred_kernel = kernel_choice.split('_')[0] }}
{{ if kernel_choice != "custom" and kernel_choice != "linux-yocto-dev": preferred_kernel_version = kernel_choice.split('_')[1] }}
{{ if kernel_choice != "custom" and kernel_choice != "linux-yocto-dev": }}
PREFERRED_PROVIDER_virtual/kernel ?= "{{=preferred_kernel}}"
PREFERRED_VERSION_{{=preferred_kernel}} ?= "{{=preferred_kernel_version}}%"

KERNEL_IMAGETYPE = "uImage"
KERNEL_DEVICETREE = "am335x-bone.dtb am335x-boneblack.dtb"
KERNEL_EXTRA_ARGS += "LOADADDR=${UBOOT_ENTRYPOINT}"

SPL_BINARY = "MLO"
UBOOT_SUFFIX = "img"
{{ input type:"edit" name:"uboot_machine" prio:"40" msg:"Please specify a value for UBOOT_MACHINE:" default:"am335x_evm_config" }}
UBOOT_MACHINE = "{{=uboot_machine}}"
{{ input type:"edit" name:"uboot_entrypoint" prio:"40" msg:"Please specify a value for UBOOT_ENTRYPOINT:" default:"0x80008000" }}
UBOOT_ENTRYPOINT = "{{=uboot_entrypoint}}"
{{ input type:"edit" name:"uboot_loadaddress" prio:"40" msg:"Please specify a value for UBOOT_LOADADDRESS:" default:"0x80008000" }}
UBOOT_LOADADDRESS = "{{=uboot_loadaddress}}"

MACHINE_FEATURES = "usbgadget usbhost vfat alsa"

IMAGE_BOOT_FILES ?= "u-boot.${UBOOT_SUFFIX} MLO"
```

## import-layers/yocto-poky/scripts/lib/bsp/substrate/target/arch/common/conf/layer.conf
```bitbake
# We have a conf and classes directory, add to BBPATH
BBPATH .= ":${LAYERDIR}"

# We have a recipes-* directories, add to BBFILES
BBFILES += "${LAYERDIR}/recipes-*/*/*.bb \
	${LAYERDIR}/recipes-*/*/*.bbappend"

BBFILE_COLLECTIONS += "{{=machine}}"
BBFILE_PATTERN_{{=machine}} = "^${LAYERDIR}/"
BBFILE_PRIORITY_{{=machine}} = "6"
```

## import-layers/yocto-poky/scripts/lib/bsp/substrate/target/arch/layer/conf/layer.conf
```bitbake
# We have a conf and classes directory, add to BBPATH
BBPATH .= ":${LAYERDIR}"

# We have recipes-* directories, add to BBFILES
BBFILES += "${LAYERDIR}/recipes-*/*/*.bb \
	${LAYERDIR}/recipes-*/*/*.bbappend"

BBFILE_COLLECTIONS += "{{=layer_name}}"
BBFILE_PATTERN_{{=layer_name}} = "^${LAYERDIR}/"
BBFILE_PRIORITY_{{=layer_name}} = "{{=layer_priority}}"
```

## import-layers/yocto-poky/scripts/lib/bsp/substrate/target/arch/qemu/conf/machine/machine.conf
```bitbake
# yocto-bsp-filename {{=machine}}.conf
#@TYPE: Machine
#@NAME: {{=machine}}

#@DESCRIPTION: Machine configuration for {{=machine}} systems

{{ if kernel_choice == "custom": preferred_kernel = "linux-yocto-custom" }}
{{ if kernel_choice == "linux-yocto-dev": preferred_kernel = "linux-yocto-dev" }}
{{ if kernel_choice == "custom" or kernel_choice == "linux-yocto-dev" : }}
PREFERRED_PROVIDER_virtual/kernel ?= "{{=preferred_kernel}}"

{{ if kernel_choice != "custom" and kernel_choice != "linux-yocto-dev": preferred_kernel = kernel_choice.split('_')[0] }}
{{ if kernel_choice != "custom" and kernel_choice != "linux-yocto-dev": preferred_kernel_version = kernel_choice.split('_')[1] }}
{{ if kernel_choice != "custom" and kernel_choice != "linux-yocto-dev": }}
PREFERRED_PROVIDER_virtual/kernel ?= "{{=preferred_kernel}}"
PREFERRED_VERSION_{{=preferred_kernel}} ?= "{{=preferred_kernel_version}}%"

{{ if qemuarch == "i386" or qemuarch == "x86_64": }}
PREFERRED_PROVIDER_virtual/xserver ?= "xserver-xorg"
PREFERRED_PROVIDER_virtual/libgl ?= "mesa"
PREFERRED_PROVIDER_virtual/libgles1 ?= "mesa"
PREFERRED_PROVIDER_virtual/libgles2 ?= "mesa"

{{ input type:"choicelist" name:"qemuarch" prio:"5" msg:"Which qemu architecture would you like to use?" default:"i386" }}
{{ input type:"choice" val:"i386" msg:"i386    (32-bit)" }}
{{ input type:"choice" val:"x86_64" msg:"x86_64  (64-bit)" }}
{{ input type:"choice" val:"arm" msg:"ARM     (32-bit)" }}
{{ input type:"choice" val:"powerpc" msg:"PowerPC (32-bit)" }}
{{ input type:"choice" val:"mips" msg:"MIPS    (32-bit)" }}
{{ input type:"choice" val:"mips64" msg:"MIPS64  (64-bit)" }}
{{ if qemuarch == "i386": }}
require conf/machine/include/qemu.inc
require conf/machine/include/tune-i586.inc
{{ if qemuarch == "x86_64": }}
require conf/machine/include/qemu.inc
DEFAULTTUNE ?= "core2-64"
require conf/machine/include/tune-core2.inc
{{ if qemuarch == "arm": }}
require conf/machine/include/qemu.inc
require conf/machine/include/tune-arm926ejs.inc
{{ if qemuarch == "powerpc": }}
require conf/machine/include/qemu.inc
require conf/machine/include/tune-ppc7400.inc
{{ if qemuarch == "mips": }}
require conf/machine/include/qemu.inc
require conf/machine/include/tune-mips32.inc
{{ if qemuarch == "mips64": }}
require conf/machine/include/qemu.inc
require conf/machine/include/tune-mips64.inc

{{ if qemuarch == "i386" or qemuarch == "x86_64": }}
MACHINE_FEATURES += "x86"
KERNEL_IMAGETYPE = "bzImage"
SERIAL_CONSOLE = "115200 ttyS0"
XSERVER = "xserver-xorg \
           ${@bb.utils.contains('DISTRO_FEATURES', 'opengl', 'mesa-driver-swrast', '', d)} \
           xf86-video-vmware"

{{ if qemuarch == "arm": }}
KERNEL_IMAGETYPE = "zImage"
SERIAL_CONSOLE = "115200 ttyAMA0"

{{ if qemuarch == "powerpc": }}
KERNEL_IMAGETYPE = "vmlinux"
SERIAL_CONSOLE = "115200 ttyS0"

{{ if qemuarch == "mips" or qemuarch == "mips64": }}
KERNEL_IMAGETYPE = "vmlinux"
KERNEL_ALT_IMAGETYPE = "vmlinux.bin"
SERIAL_CONSOLE = "115200 ttyS0"
MACHINE_EXTRA_RRECOMMENDS = " kernel-modules"
```
