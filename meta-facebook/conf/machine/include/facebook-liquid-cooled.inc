## meta-facebook/conf/machine/include/facebook-liquid-cooled.inc
```bitbake
MACHINE_FEATURES:append = " fb-liquid-cooled"
MACHINEOVERRIDES:append = ":mf-fb-liquid-cooled"
```

## meta-facebook/conf/machine/include/facebook-ncsi-nic.inc
```bitbake
MACHINE_FEATURES:append = " fb-ncsi-nic"
MACHINEOVERRIDES:append = ":mf-fb-ncsi-nic"

FB_ETH_INTF ?= "eth0"
```

## meta-facebook/conf/machine/include/facebook-secondary-emmc.inc
```bitbake
MACHINE_FEATURES:append = " fb-secondary-emmc"
MACHINEOVERRIDES:append = ":mf-fb-secondary-emmc"
```

## meta-facebook/conf/machine/include/facebook-withhost.inc
```bitbake
MACHINEOVERRIDES =. "fb-withhost:"

require conf/machine/include/facebook.inc

MACHINE_FEATURES:append = "\
        obmc-chassis-state-mgmt \
        obmc-host-state-mgmt \
        obmc-phosphor-chassis-mgmt \
        "

VIRTUAL-RUNTIME_obmc-host-state-manager ?= "x86-power-control"
VIRTUAL-RUNTIME_obmc-chassis-state-manager ?= "x86-power-control"
```

## meta-facebook/conf/machine/include/facebook.inc
```bitbake
DISTROOVERRIDES .= ":facebook"

require conf/distro/include/cgroup.inc
require conf/distro/include/phosphor-no-webui.inc
require conf/distro/include/phosphor-production.inc

MACHINE_FEATURES += "\
        obmc-bmc-state-mgmt \
        obmc-phosphor-fan-mgmt \
        obmc-phosphor-flash-mgmt \
        "

VIRTUAL-RUNTIME_skeleton_workbook = "${MACHINE}-config"

PREFERRED_PROVIDER_virtual/obmc-chassis-mgmt = "packagegroup-fb-apps"
PREFERRED_PROVIDER_virtual/obmc-fan-mgmt = "packagegroup-fb-apps"
PREFERRED_PROVIDER_virtual/obmc-flash-mgmt = "packagegroup-fb-apps"
PREFERRED_PROVIDER_virtual/obmc-inventory-data ?= "${VIRTUAL-RUNTIME_skeleton_workbook}"
PREFERRED_PROVIDER_virtual/obmc-system-mgmt = "packagegroup-fb-apps"

IMAGE_FEATURES:remove = "obmc-ikvm"
IMAGE_FEATURES:append = " allow-root-login"

# Most of our hardware uses the default ttyS4 but at 57600.
SERIAL_CONSOLES:facebook = "57600;ttyS4"

OBMC_ORG_YAML_SUBDIRS:append:facebook = " com/meta"

# Remove some common features we have no use for.
DISTRO_FEATURES:remove = "avahi"
DISTRO_FEATURES:remove = "ldap"
```

## meta-facebook/meta-anacapa/conf/layer.conf
```bitbake
# We have a conf and classes directory, add to BBPATH
BBPATH .= ":${LAYERDIR}"

# We have recipes-* directories, add to BBFILES
BBFILES += "${LAYERDIR}/recipes-*/*/*.bb \
            ${LAYERDIR}/recipes-*/*/*.bbappend"

BBFILE_COLLECTIONS += "anacapa-layer"
BBFILE_PATTERN_anacapa-layer := "^${LAYERDIR}/"

LAYERSERIES_COMPAT_anacapa-layer := "whinlatter walnascar"
```

## meta-facebook/meta-bletchley/conf/layer.conf
```bitbake
# We have a conf and classes directory, add to BBPATH
BBPATH .= ":${LAYERDIR}"

# We have recipes-* directories, add to BBFILES
BBFILES += "${LAYERDIR}/recipes-*/*/*.bb \
            ${LAYERDIR}/recipes-*/*/*.bbappend"

BBFILE_COLLECTIONS += "bletchley-layer"
BBFILE_PATTERN_bletchley-layer := "^${LAYERDIR}/"

LAYERSERIES_COMPAT_bletchley-layer := "scarthgap styhead"
```

## meta-facebook/meta-bletchley/conf/machine/bletchley.conf
```bitbake
KMACHINE = "aspeed"
KERNEL_DEVICETREE = "aspeed/${KMACHINE}-bmc-facebook-${MACHINE}.dtb"

UBOOT_MACHINE = "ast2600_openbmc_spl_defconfig"
UBOOT_DEVICETREE = "ast2600-bletchley"
SPL_BINARY = "spl/u-boot-spl.bin"
SOCSEC_SIGN_ENABLE = "0"

OBMC_COMPATIBLE_NAMES = "com.meta.Hardware.BMC.Model.Bletchley"

require conf/distro/include/phosphor-static-norootfs.inc
require conf/machine/include/ast2600.inc
require conf/machine/include/facebook-fixed-nic.inc
require conf/machine/include/facebook-nohost.inc
require conf/machine/include/facebook-secondary-emmc.inc
require conf/machine/include/obmc-bsp-common.inc
require conf/machine/include/tpm2.inc

FLASH_SIZE = "131072"

OBMC_HOST_INSTANCES ?= "1 2 3 4 5 6"
# Primary chassis as Sled plus secondary chassis in N slots.
OBMC_CHASSIS_INSTANCES = "0 ${OBMC_HOST_INSTANCES}"
```

## meta-facebook/meta-bletchley/meta-bletchley15/conf/layer.conf
```bitbake
# We have a conf and classes directory, add to BBPATH
BBPATH .= ":${LAYERDIR}"

# We have recipes-* directories, add to BBFILES
BBFILES += "${LAYERDIR}/recipes-*/*/*.bb \
            ${LAYERDIR}/recipes-*/*/*.bbappend"

BBFILE_COLLECTIONS += "bletchley15-layer"
BBFILE_PATTERN_bletchley15-layer := "^${LAYERDIR}/"

LAYERSERIES_COMPAT_bletchley15-layer := "walnascar scarthgap"
```

## meta-facebook/meta-bletchley/meta-bletchley15/conf/machine/bletchley15.conf
```bitbake
require conf/machine/bletchley.conf

# We should be able to reuse bletchley's DTS since they are mostly
# board compatible with only the number of hosts changing.
# If this assumption changes, we can always add a new DTS and
# change this to ${KMACHINE}-bmc-facebook-${MACHINE}.dtb
KERNEL_DEVICETREE = "aspeed/${KMACHINE}-bmc-facebook-bletchley.dtb"

OBMC_COMPATIBLE_NAMES = "com.meta.Hardware.BMC.Model.Bletchley15"

OBMC_HOST_INSTANCES ?= "1 2 3 4"
```

## meta-facebook/meta-catalina/conf/layer.conf
```bitbake
# We have a conf and classes directory, add to BBPATH
BBPATH .= ":${LAYERDIR}"

# We have recipes-* directories, add to BBFILES
BBFILES += "${LAYERDIR}/recipes-*/*/*.bb \
            ${LAYERDIR}/recipes-*/*/*.bbappend"

BBFILE_COLLECTIONS += "catalina-layer"
BBFILE_PATTERN_catalina-layer := "^${LAYERDIR}/"

LAYERSERIES_COMPAT_catalina-layer := "nanbield scarthgap"
```

## meta-facebook/meta-catalina/conf/machine/catalina.conf
```bitbake
# Catalina config file.

KMACHINE = "aspeed"
KERNEL_DEVICETREE = "aspeed/${KMACHINE}-bmc-facebook-${MACHINE}.dtb"

UBOOT_MACHINE = "ast2600_openbmc_spl_defconfig"
UBOOT_DEVICETREE = "ast2600-facebook"

SPL_BINARY = "spl/u-boot-spl.bin"
SOCSEC_SIGN_ENABLE = "0"

OBMC_COMPATIBLE_NAMES = "com.meta.Hardware.BMC.Model.Catalina"

require conf/distro/include/phosphor-static-norootfs.inc
require conf/machine/include/facebook-compute-singlehost.inc
require conf/machine/include/ast2600.inc
require conf/machine/include/obmc-bsp-common.inc
require conf/machine/include/facebook-tpm2.inc
require conf/machine/include/facebook-ncsi-nic.inc
require conf/distro/include/pldm.inc

FLASH_SIZE = "131072"

FB_ETH_INTF = "eth0 eth1"

VIRTUAL-RUNTIME_obmc-host-state-manager = "phosphor-state-manager-host"
VIRTUAL-RUNTIME_obmc-chassis-state-manager = "phosphor-state-manager-chassis"

PREFERRED_PROVIDER_virtual/obmc-host-ipmi-hw = "phosphor-ipmi-ssif"
```

## meta-facebook/meta-catalina/meta-clemente/conf/layer.conf
```bitbake
# We have a conf and classes directory, add to BBPATH
BBPATH .= ":${LAYERDIR}"

# We have recipes-* directories, add to BBFILES
BBFILES += "${LAYERDIR}/recipes-*/*/*.bb \
            ${LAYERDIR}/recipes-*/*/*.bbappend"

BBFILE_COLLECTIONS += "clemente-layer"
BBFILE_PATTERN_clemente-layer := "^${LAYERDIR}/"

LAYERSERIES_COMPAT_clemente-layer := "walnascar scarthgap"
```

## meta-facebook/meta-fbdarwin/conf/layer.conf
```bitbake
# We have a conf and classes directory, add to BBPATH
BBPATH .= ":${LAYERDIR}"

# We have recipes-* directories, add to BBFILES
BBFILES += "${LAYERDIR}/recipes-*/*/*.bb \
            ${LAYERDIR}/recipes-*/*/*.bbappend"

BBFILE_COLLECTIONS += "fbdarwin-layer"
BBFILE_PATTERN_fbdarwin-layer := "^${LAYERDIR}/"

LAYERSERIES_COMPAT_fbdarwin-layer := "walnascar scarthgap"
```

## meta-facebook/meta-fbdarwin/conf/machine/fbdarwin.conf
```bitbake
# Lfdarwin config file.

KMACHINE = "aspeed"

# This gets overridden downstrean
# Once the device tree is pushed upstream, replace with:
#KERNEL_DEVICETREE = "aspeed/${KMACHINE}-bmc-facebook-darwin.dtb"
KERNEL_DEVICETREE = "aspeed/aspeed-ast2600-evb.dtb"

UBOOT_MACHINE = "ast2600_openbmc_spl_defconfig"
UBOOT_DEVICETREE = "ast2600-facebook"

SPL_BINARY = "spl/u-boot-spl.bin"
SOCSEC_SIGN_ENABLE = "0"

OBMC_COMPATIBLE_NAMES = "com.meta.Hardware.BMC.Model.Darwin"

require conf/distro/include/phosphor-static-norootfs.inc
require conf/machine/include/ast2600.inc
require conf/machine/include/obmc-bsp-common.inc
require conf/machine/include/facebook-fboss.inc

FLASH_SIZE = "131072"

VIRTUAL-RUNTIME_obmc-host-state-manager = "phosphor-state-manager-host"
VIRTUAL-RUNTIME_obmc-chassis-state-manager = "phosphor-state-manager-chassis"

IMAGE_INSTALL:append = " phosphor-state-manager"
```

## meta-facebook/meta-greatlakes/conf/machine/greatlakes.conf
```bitbake
KMACHINE = "aspeed"
#KERNEL_DEVICETREE = "${KMACHINE}-bmc-facebook-${MACHINE}.dtb"
KERNEL_DEVICETREE = "aspeed-ast2600-evb.dtb"

UBOOT_MACHINE = "ast2600_openbmc_spl_defconfig"
UBOOT_DEVICETREE = "ast2600-evb"
SPL_BINARY = "spl/u-boot-spl.bin"
SOCSEC_SIGN_ENABLE = "0"

require conf/machine/include/facebook-compute-multihost.inc
require conf/machine/include/ast2600.inc
require conf/machine/include/obmc-bsp-common.inc
require conf/machine/include/facebook-tpm2.inc

FLASH_SIZE = "131072"

OBMC_HOST_INSTANCES = "1 2 3 4"
# Primary chassis as Sled plus secondary chassis in N slots.
OBMC_CHASSIS_INSTANCES = "0 ${OBMC_HOST_INSTANCES}"

VIRTUAL-RUNTIME_obmc-host-state-manager = "phosphor-state-manager-host"
VIRTUAL-RUNTIME_obmc-chassis-state-manager = "phosphor-state-manager-chassis"
```

## meta-facebook/meta-harma/conf/machine/harma.conf
```bitbake
# Harma config file.

KMACHINE = "aspeed"
KERNEL_DEVICETREE = "aspeed/${KMACHINE}-bmc-facebook-${MACHINE}.dtb"

UBOOT_MACHINE = "ast2600_openbmc_spl_defconfig"
UBOOT_DEVICETREE = "ast2600-facebook"

SPL_BINARY = "spl/u-boot-spl.bin"
SOCSEC_SIGN_ENABLE = "0"

OBMC_COMPATIBLE_NAMES = "com.meta.Hardware.BMC.Model.Harma"

require conf/distro/include/phosphor-static-norootfs.inc
require conf/distro/include/pldm.inc
require conf/machine/include/facebook-compute-singlehost.inc
require conf/machine/include/ast2600.inc
require conf/machine/include/obmc-bsp-common.inc
require conf/machine/include/facebook-tpm2.inc
require conf/machine/include/facebook-ncsi-nic.inc

FLASH_SIZE = "131072"

VIRTUAL-RUNTIME_obmc-host-state-manager = "phosphor-state-manager-host"
VIRTUAL-RUNTIME_obmc-chassis-state-manager = "phosphor-state-manager-chassis"

# There is an additional serial console to the CMM (Minerva) on ttyS3.
SERIAL_CONSOLES:append = " 57600;ttyS3"

# Note: Harma does not actually contain two chassis. Currently,
# we are utilizing an additional "chassis" representation
# as a temporary workaround to enable the required functionality.
OBMC_CHASSIS_INSTANCES = "0 1"
```

## meta-facebook/meta-lfdarwin/conf/layer.conf
```bitbake
# We have a conf and classes directory, add to BBPATH
BBPATH .= ":${LAYERDIR}"

# We have recipes-* directories, add to BBFILES
BBFILES += "${LAYERDIR}/recipes-*/*/*.bb \
            ${LAYERDIR}/recipes-*/*/*.bbappend"

BBFILE_COLLECTIONS += "lfdarwin-layer"
BBFILE_PATTERN_lfdarwin-layer := "^${LAYERDIR}/"

LAYERSERIES_COMPAT_lfdarwin-layer := "walnascar scarthgap"
```

## meta-facebook/meta-minerva/conf/layer.conf
```bitbake
# We have a conf and classes directory, add to BBPATH
BBPATH .= ":${LAYERDIR}"

# We have recipes-* directories, add to BBFILES
BBFILES += "${LAYERDIR}/recipes-*/*/*.bb \
            ${LAYERDIR}/recipes-*/*/*.bbappend"

BBFILE_COLLECTIONS += "minerva-layer"
BBFILE_PATTERN_minerva-layer := "^${LAYERDIR}/"

LAYERSERIES_COMPAT_minerva-layer := "scarthgap styhead"
```

## meta-facebook/meta-minerva/conf/machine/minerva.conf
```bitbake
KMACHINE = "aspeed"
KERNEL_DEVICETREE = "aspeed/${KMACHINE}-bmc-facebook-${MACHINE}.dtb"

UBOOT_MACHINE = "ast2600_openbmc_spl_defconfig"
UBOOT_DEVICETREE = "ast2600-facebook"
SPL_BINARY = "spl/u-boot-spl.bin"
SOCSEC_SIGN_ENABLE = "0"

OBMC_COMPATIBLE_NAMES = "com.meta.Hardware.BMC.Model.Minerva"

require conf/distro/include/phosphor-static-norootfs.inc
require conf/machine/include/facebook-nohost.inc
require conf/machine/include/ast2600.inc
require conf/machine/include/obmc-bsp-common.inc
require conf/machine/include/facebook-tpm2.inc
require conf/machine/include/facebook-fixed-nic.inc

FLASH_SIZE = "131072"

OBMC_CHASSIS_INSTANCES = "0 1"
```

## meta-facebook/meta-sanmiguel/conf/layer.conf
```bitbake
# We have a conf and classes directory, add to BBPATH
BBPATH .= ":${LAYERDIR}"

# We have recipes-* directories, add to BBFILES
BBFILES += "${LAYERDIR}/recipes-*/*/*.bb \
            ${LAYERDIR}/recipes-*/*/*.bbappend"

BBFILE_COLLECTIONS += "sanmiguel-layer"
BBFILE_PATTERN_sanmiguel-layer := "^${LAYERDIR}/"

LAYERSERIES_COMPAT_sanmiguel-layer := "whinlatter walnascar"
```

## meta-facebook/meta-santabarbara/conf/layer.conf
```bitbake
# We have a conf and classes directory, add to BBPATH
BBPATH .= ":${LAYERDIR}"

# We have recipes-* directories, add to BBFILES
BBFILES += "${LAYERDIR}/recipes-*/*/*.bb \
            ${LAYERDIR}/recipes-*/*/*.bbappend"

BBFILE_COLLECTIONS += "santabarbara-layer"
BBFILE_PATTERN_santabarbara-layer := "^${LAYERDIR}/"

LAYERSERIES_COMPAT_santabarbara-layer := "walnascar scarthgap"
```

## meta-facebook/meta-santabarbara/conf/machine/santabarbara.conf
```bitbake
# Santabarbara config file.

KMACHINE = "aspeed"
KERNEL_DEVICETREE = "aspeed/${KMACHINE}-bmc-facebook-${MACHINE}.dtb"

UBOOT_MACHINE = "ast2600_openbmc_spl_defconfig"
UBOOT_DEVICETREE = "ast2600-facebook"

SPL_BINARY = "spl/u-boot-spl.bin"
SOCSEC_SIGN_ENABLE = "0"

OBMC_COMPATIBLE_NAMES = "com.meta.Hardware.BMC.Model.Santabarbara"

require conf/distro/include/phosphor-static-norootfs.inc
require conf/machine/include/facebook-compute-singlehost.inc
require conf/machine/include/ast2600.inc
require conf/machine/include/obmc-bsp-common.inc
require conf/machine/include/tpm2.inc
require conf/machine/include/facebook-ncsi-nic.inc
require conf/machine/include/facebook-liquid-cooled.inc
require conf/distro/include/pldm.inc
require conf/machine/include/facebook-compute-amd.inc

FLASH_SIZE = "131072"

VIRTUAL-RUNTIME_obmc-host-state-manager = "phosphor-state-manager-host"
VIRTUAL-RUNTIME_obmc-chassis-state-manager = "phosphor-state-manager-chassis"

# Note: Santabarbara does not actually contain two chassis. Currently,
# we use an additional "chassis"  to enable the required functionality.
# 0 -> chassis, 1 -> IRIS module 1, 2 -> IRIS module 2, etc.
OBMC_CHASSIS_INSTANCES = "0 1 2 3 4"
```
