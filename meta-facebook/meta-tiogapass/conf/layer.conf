## meta-facebook/meta-tiogapass/conf/layer.conf
```bitbake
# We have a conf and classes directory, add to BBPATH
BBPATH .= ":${LAYERDIR}"

# We have recipes-* directories, add to BBFILES
BBFILES += "${LAYERDIR}/recipes-*/*/*.bb \
            ${LAYERDIR}/recipes-*/*/*.bbappend"

BBFILE_COLLECTIONS += "tiogapass-layer"
BBFILE_PATTERN_tiogapass-layer := "^${LAYERDIR}/"

LAYERSERIES_COMPAT_tiogapass-layer := "scarthgap styhead"
```

## meta-facebook/meta-tiogapass/conf/machine/tiogapass.conf
```bitbake
KMACHINE = "aspeed"
KERNEL_DEVICETREE = "aspeed/${KMACHINE}-bmc-facebook-${MACHINE}.dtb"

PREFERRED_PROVIDER_virtual/bootloader = "u-boot-aspeed-sdk"
PREFERRED_PROVIDER_u-boot = "u-boot-aspeed-sdk"
PREFERRED_PROVIDER_u-boot-fw-utils = "u-boot-fw-utils-aspeed-sdk"

UBOOT_DEVICETREE = "ast2500-evb"
UBOOT_MACHINE = "evb-ast2500_defconfig"

OBMC_COMPATIBLE_NAMES = "com.meta.Hardware.BMC.Model.TiogaPass"

require conf/distro/include/phosphor-static-norootfs.inc
require conf/machine/include/ast2500.inc
require conf/machine/include/facebook-compute-singlehost.inc
require conf/machine/include/obmc-bsp-common.inc

FLASH_SIZE = "32768"
```

## meta-facebook/meta-ventura/conf/layer.conf
```bitbake
# We have a conf and classes directory, add to BBPATH
BBPATH .= ":${LAYERDIR}"

# We have recipes-* directories, add to BBFILES
BBFILES += "${LAYERDIR}/recipes-*/*/*.bb \
            ${LAYERDIR}/recipes-*/*/*.bbappend"

BBFILE_COLLECTIONS += "ventura-layer"
BBFILE_PATTERN_ventura-layer := "^${LAYERDIR}/"

LAYERSERIES_COMPAT_ventura-layer := "nanbield scarthgap"
```

## meta-facebook/meta-ventura2/conf/machine/ventura2.conf
```bitbake
KMACHINE = "aspeed"
#KERNEL_DEVICETREE = "aspeed/${KMACHINE}-bmc-facebook-${MACHINE}.dtb"
KERNEL_DEVICETREE = "aspeed/aspeed-ast2600-evb.dtb"

UBOOT_MACHINE = "ast2600_openbmc_spl_defconfig"
UBOOT_DEVICETREE = "ast2600-facebook"
SPL_BINARY = "spl/u-boot-spl.bin"
SOCSEC_SIGN_ENABLE = "0"

OBMC_COMPATIBLE_NAMES = "com.meta.Hardware.BMC.Model.Ventura2"

require conf/distro/include/phosphor-static-norootfs.inc
require conf/machine/include/ast2600.inc
require conf/machine/include/facebook-fixed-nic.inc
require conf/machine/include/facebook-liquid-cooled.inc
require conf/machine/include/facebook-nohost.inc
require conf/machine/include/obmc-bsp-common.inc
require conf/machine/include/tpm2.inc

FLASH_SIZE = "131072"

OBMC_CHASSIS_INSTANCES = "0"
```

## meta-facebook/meta-yosemite4/conf/layer.conf
```bitbake
# We have a conf and classes directory, add to BBPATH
BBPATH .= ":${LAYERDIR}"

# We have recipes-* directories, add to BBFILES
BBFILES += "${LAYERDIR}/recipes-*/*/*.bb \
            ${LAYERDIR}/recipes-*/*/*.bbappend"

BBFILE_COLLECTIONS += "yosemite4-layer"
BBFILE_PATTERN_yosemite4-layer := "^${LAYERDIR}/"

LAYERSERIES_COMPAT_yosemite4-layer := "scarthgap styhead"
```

## meta-facebook/meta-yosemite4/conf/machine/include/yosemite4-common.inc
```bitbake
MACHINEOVERRIDES =. "yosemite4-common:"

require conf/distro/include/phosphor-static-norootfs.inc
require conf/distro/include/pldm.inc
require conf/machine/include/facebook-compute-multihost.inc
require conf/machine/include/obmc-bsp-common.inc
require conf/machine/include/tpm2.inc
require conf/machine/include/facebook-ncsi-nic.inc

FLASH_SIZE = "131072"

OBMC_HOST_INSTANCES = "1 2 3 4 5 6 7 8"
# Primary chassis as Sled plus secondary chassis in N slots.
OBMC_CHASSIS_INSTANCES = "0 ${OBMC_HOST_INSTANCES}"

OBMC_NIC_INSTANCES = "0 1 2 3"

FB_ETH_INTF = "eth0 eth1"

VIRTUAL-RUNTIME_obmc-host-state-manager = "phosphor-state-manager-host"
VIRTUAL-RUNTIME_obmc-chassis-state-manager = "phosphor-state-manager-chassis"

PREFERRED_PROVIDER_virtual/phosphor-led-manager-config-native = "yosemite4-led-manager-config-native"
```

## meta-facebook/meta-yosemite4/conf/machine/yosemite4.conf
```bitbake
KMACHINE = "aspeed"
KERNEL_DEVICETREE = "aspeed/${KMACHINE}-bmc-facebook-${MACHINE}.dtb"

UBOOT_MACHINE = "ast2600_openbmc_spl_defconfig"
UBOOT_DEVICETREE = "ast2600-evb"
SPL_BINARY = "spl/u-boot-spl.bin"
SOCSEC_SIGN_ENABLE = "0"

OBMC_COMPATIBLE_NAMES = "com.meta.Hardware.BMC.Model.Yosemite4"

require conf/machine/include/ast2600.inc
require conf/machine/include/yosemite4-common.inc
```

## meta-facebook/meta-yosemite4/meta-yosemite4n/conf/layer.conf
```bitbake
# We have a conf and classes directory, add to BBPATH
BBPATH .= ":${LAYERDIR}"

# We have recipes-* directories, add to BBFILES
BBFILES += "${LAYERDIR}/recipes-*/*/*.bb \
            ${LAYERDIR}/recipes-*/*/*.bbappend"

# Ignore bbappend related to ASPEED in meta-yosemite4
BBMASK += ".*aspeed.*\.bbappend"

BBFILE_COLLECTIONS += "yosemite4n-layer"
BBFILE_PATTERN_yosemite4n-layer := "^${LAYERDIR}/"

LAYERSERIES_COMPAT_yosemite4n-layer := "scarthgap styhead"
```

## meta-facebook/meta-yosemite4/meta-yosemite4n/conf/machine/yosemite4n.conf
```bitbake
KMACHINE = "nuvoton"
KERNEL_DEVICETREE = "nuvoton/${KMACHINE}-npcm845-yosemite4.dtb"

UBOOT_MACHINE = "arbel_evb_defconfig"
UBOOT_DEVICETREE = "nuvoton-npcm845-yosemite4"

IGPS_MACHINE = "META"
DEVICE_GEN = "A2"

OBMC_COMPATIBLE_NAMES = "com.meta.Hardware.BMC.Model.Yosemite4N"

ARCH_DEFAULT_KERNELIMAGETYPE:npcm8xx = "Image"

require meta-yosemite4/conf/machine/include/yosemite4-common.inc
require conf/machine/include/npcm8xx.inc

UBOOT_MKIMAGE:append:npcm8xx = " -E -B 8"

FLASH_UBOOT_OFFSET:flash-131072 = "0"
FLASH_MANIFEST_OFFSET:flash-131072 = "2808"
FLASH_UBOOT_ENV_OFFSET:flash-131072 = "2816"
FLASH_KERNEL_OFFSET:flash-131072 = "3072"

SECURED_IMAGE = "True"
TIP_IMAGE = "True"
```

## meta-facebook/meta-yosemite5/conf/layer.conf
```bitbake
# We have a conf and classes directory, add to BBPATH
BBPATH .= ":${LAYERDIR}"

# We have recipes-* directories, add to BBFILES
BBFILES += "${LAYERDIR}/recipes-*/*/*.bb \
            ${LAYERDIR}/recipes-*/*/*.bbappend"

BBFILE_COLLECTIONS += "yosemite5-layer"
BBFILE_PATTERN_yosemite5-layer := "^${LAYERDIR}/"

LAYERSERIES_COMPAT_yosemite5-layer := "walnascar scarthgap"
```

## meta-facebook/meta-yosemite5/conf/machine/yosemite5.conf
```bitbake
# Yosemite5 config file.

KMACHINE = "aspeed"
KERNEL_DEVICETREE = "aspeed/${KMACHINE}-bmc-facebook-${MACHINE}.dtb"

UBOOT_MACHINE = "ast2600_openbmc_spl_defconfig"
UBOOT_DEVICETREE = "ast2600-facebook"

SPL_BINARY = "spl/u-boot-spl.bin"
SOCSEC_SIGN_ENABLE = "0"

OBMC_COMPATIBLE_NAMES = "com.meta.Hardware.BMC.Model.Yosemite5"

require conf/distro/include/phosphor-static-norootfs.inc
require conf/distro/include/pldm.inc
require conf/machine/include/ast2600.inc
require conf/machine/include/facebook-compute-amd.inc
require conf/machine/include/facebook-compute-singlehost.inc
require conf/machine/include/facebook-ncsi-nic.inc
require conf/machine/include/obmc-bsp-common.inc
require conf/machine/include/tpm2.inc

FLASH_SIZE = "131072"

VIRTUAL-RUNTIME_obmc-host-state-manager = "phosphor-state-manager-host"
VIRTUAL-RUNTIME_obmc-chassis-state-manager = "phosphor-state-manager-chassis"

# Note: Yosemite5 does not actually contain two chassis. Currently,
# we use an additional "chassis"  to enable the required functionality.
# 0 -> chassis, 1 -> tray
OBMC_CHASSIS_INSTANCES = "0 1"
```

## meta-facebook/meta-yosemite5/meta-rainiera6/conf/layer.conf
```bitbake
# We have a conf and classes directory, add to BBPATH
BBPATH .= ":${LAYERDIR}"

# We have recipes-* directories, add to BBFILES
BBFILES += "${LAYERDIR}/recipes-*/*/*.bb \
            ${LAYERDIR}/recipes-*/*/*.bbappend"

BBFILE_COLLECTIONS += "rainiera6-layer"
BBFILE_PATTERN_rainiera6-layer := "^${LAYERDIR}/"

LAYERSERIES_COMPAT_rainiera6-layer := "wrynose whinlatter"
```

## meta-facebook/meta-yosemite5/meta-rainiera6/conf/machine/rainiera6.conf
```bitbake
# Rainier AST2600 config file.

KMACHINE = "aspeed"
# TODO: Update KERNEL_DEVICETREE to Rainier DTB once added to the kernel
# KERNEL_DEVICETREE = "aspeed/${KMACHINE}-bmc-facebook-${MACHINE}.dtb"
KERNEL_DEVICETREE = "aspeed/${KMACHINE}-bmc-facebook-yosemite5.dtb"

UBOOT_MACHINE = "ast2600_openbmc_spl_defconfig"
UBOOT_DEVICETREE = "ast2600-facebook"

SPL_BINARY = "spl/u-boot-spl.bin"
SOCSEC_SIGN_ENABLE = "0"

OBMC_COMPATIBLE_NAMES = "com.meta.Hardware.BMC.Model.RainierA6"

require conf/distro/include/phosphor-static-norootfs.inc
require conf/distro/include/pldm.inc
require conf/machine/include/ast2600.inc
require conf/machine/include/facebook-compute-singlehost.inc
require conf/machine/include/facebook-ncsi-nic.inc
require conf/machine/include/obmc-bsp-common.inc
require conf/machine/include/tpm2.inc

FLASH_SIZE = "131072"

VIRTUAL-RUNTIME_obmc-host-state-manager = "phosphor-state-manager-host"
VIRTUAL-RUNTIME_obmc-chassis-state-manager = "phosphor-state-manager-chassis"

# Note: Rainier does not actually contain two chassis. Currently,
# we use an additional "chassis"  to enable the required functionality.
# 0 -> chassis, 1 -> tray
OBMC_CHASSIS_INSTANCES = "0 1"
```

## meta-facebook/meta-yosemite5/meta-yosemite5a7/conf/layer.conf
```bitbake
# We have a conf and classes directory, add to BBPATH
BBPATH .= ":${LAYERDIR}"

# We have recipes-* directories, add to BBFILES
BBFILES += "${LAYERDIR}/recipes-*/*/*.bb \
            ${LAYERDIR}/recipes-*/*/*.bbappend"

BBFILE_COLLECTIONS += "yosemite5a7-layer"
BBFILE_PATTERN_yosemite5a7-layer := "^${LAYERDIR}/"

LAYERSERIES_COMPAT_yosemite5a7-layer := "whinlatter walnascar"
```

## meta-facebook/meta-yosemite5/meta-yosemite5a7/conf/machine/yosemite5a7.conf
```bitbake
# Yosemite5 AST2700 config file.

# Uses linux-dummy and temporary workarounds until formal AST2700
# upstream support is available.
YV5A7_ASSUMED_PROVIDERS ?= "u-boot-fw-utils-aspeed-sdk"
YV5A7_IMAGE_FSTYPES_REMOVE ?= "cpio.zst.fitImage mtd-static-norootfs"
PREFERRED_PROVIDER_virtual/kernel = "linux-dummy"
ASSUME_PROVIDED:append = " ${YV5A7_ASSUMED_PROVIDERS}"
RPROVIDES:base-files:append = " ${YV5A7_ASSUMED_PROVIDERS}"
IMAGE_FSTYPES:remove = "${YV5A7_IMAGE_FSTYPES_REMOVE}"

# Kernel Build Settings
KMACHINE = "aspeed"
KERNEL_DEVICETREE = "aspeed/ast2700-evb.dtb"
KBUILD_DEFCONFIG = "aspeed_g7_defconfig"

# CALIPTRA Settings
CALIPTRA_FW_BINARY = "caliptra-fw.bin"
CALIPTRA_MANIFEST_FLASH_IMAGE = "ast2700-manifest-flash.bin"

# U-Boot Build Settings
UBOOT_MACHINE = "evb-ast2700_defconfig"
UBOOT_DEVICETREE = "ast2700-evb"

OBMC_COMPATIBLE_NAMES = "com.meta.Hardware.BMC.Model.Yosemite5a7"

require conf/distro/include/phosphor-static-norootfs.inc
require conf/distro/include/pldm.inc
require conf/machine/include/ast2700.inc
require conf/machine/include/facebook-compute-amd.inc
require conf/machine/include/facebook-compute-singlehost.inc
require conf/machine/include/facebook-ncsi-nic.inc
require conf/machine/include/obmc-bsp-common.inc
require conf/machine/include/tpm2.inc

VIRTUAL-RUNTIME_obmc-host-state-manager = "phosphor-state-manager-host"
VIRTUAL-RUNTIME_obmc-chassis-state-manager = "phosphor-state-manager-chassis"

# Note: Yosemite5 does not actually contain two chassis. Currently,
# we use an additional "chassis" to enable the required functionality.
# 0 -> chassis, 1 -> tray
OBMC_CHASSIS_INSTANCES = "0 1"

FIT_KERNEL_COMP_ALG:df-obmc-static-norootfs ?= "gzip"
FIT_KERNEL_COMP_ALG_EXTENSION:df-obmc-static-norootfs ?= ".gz"

IMAGE_FSTYPES:remove = "mtd-static mtd-static-alltar mtd-static-tar"

FLASH_SIZE = "131072"
FLASH_MANIFEST_OFFSET:flash-131072 = "4088"
FLASH_UBOOT_ENV_OFFSET:flash-131072 = "4096"
FLASH_KERNEL_OFFSET:flash-131072 = "4224"
```

## meta-facebook/meta-yosemitev2/conf/layer.conf
```bitbake
# We have a conf and classes directory, add to BBPATH
BBPATH .= ":${LAYERDIR}"

# We have recipes-* directories, add to BBFILES
BBFILES += "${LAYERDIR}/recipes-*/*/*.bb \
            ${LAYERDIR}/recipes-*/*/*.bbappend"

BBFILE_COLLECTIONS += "yosemitev2-layer"
BBFILE_PATTERN_yosemitev2-layer := "^${LAYERDIR}/"

LAYERSERIES_COMPAT_yosemitev2-layer := "scarthgap styhead"
```

## meta-facebook/meta-yosemitev2/conf/machine/yosemitev2.conf
```bitbake
KMACHINE = "aspeed"
KERNEL_DEVICETREE = "${KMACHINE}-bmc-facebook-${MACHINE}.dtb"

PREFERRED_PROVIDER_virtual/bootloader = "u-boot-aspeed-sdk"
PREFERRED_PROVIDER_u-boot = "u-boot-aspeed-sdk"
PREFERRED_PROVIDER_u-boot-fw-utils = "u-boot-fw-utils-aspeed-sdk"

UBOOT_DEVICETREE = "ast2500-evb"
UBOOT_MACHINE = "evb-ast2500_defconfig"

require conf/machine/include/facebook-compute-multihost.inc
require conf/machine/include/ast2500.inc
require conf/machine/include/obmc-bsp-common.inc

FLASH_SIZE = "32768"
OBMC_HOST_INSTANCES = "1 2 3 4"
```

## meta-fii/meta-kudo/conf/bblayers.conf.sample
```bitbake
# LAYER_CONF_VERSION is increased each time build/conf/bblayers.conf
# changes incompatibly
LCONF_VERSION = "8"

BBPATH = "${TOPDIR}"
BBFILES ?= ""

BBLAYERS ?= " \
  ##OEROOT##/meta \
  ##OEROOT##/meta-openembedded/meta-oe \
  ##OEROOT##/meta-openembedded/meta-networking \
  ##OEROOT##/meta-openembedded/meta-python \
  ##OEROOT##/meta-phosphor \
  ##OEROOT##/meta-nuvoton \
  ##OEROOT##/meta-google \
  ##OEROOT##/meta-fii \
  ##OEROOT##/meta-fii/meta-kudo \
  "
```

## meta-fii/meta-kudo/conf/distro/openbmc-kudo.conf
```bitbake
require conf/distro/gbmc.conf

DISTRO = "openbmc-kudo"
VERSION_ID:kudo = "v0.10-00-kudo"
```

## meta-fii/meta-kudo/conf/layer.conf
```bitbake
# We have a conf and classes directory, add to BBPATH
BBPATH .= ":${LAYERDIR}"

# We have recipes-* directories, add to BBFILES
BBFILES += "${LAYERDIR}/recipes-*/*/*.bb \
            ${LAYERDIR}/recipes-*/*/*.bbappend"

BBFILE_COLLECTIONS += "kudo-layer"
BBFILE_PATTERN_kudo-layer = "^${LAYERDIR}/"
LAYERSERIES_COMPAT_kudo-layer = "scarthgap styhead"
LAYERDEPENDS_kudo-layer = "core phosphor-layer google-layer fii-layer"
```

## meta-fii/meta-kudo/conf/machine/kudo.conf
```bitbake
KMACHINE = "nuvoton"
KERNEL_DEVICETREE = "${KMACHINE}-npcm730-kudo.dtb"

require conf/machine/include/npcm7xx.inc
require conf/machine/include/obmc-bsp-common.inc

FLASH_SIZE = "65536"
FLASH_UBOOT_OFFSET:flash-65536 = "0"
FLASH_UBOOT_ENV_OFFSET:flash-65536 = "1024"
FLASH_KERNEL_OFFSET:flash-65536 = "2048"
FLASH_ROFS_OFFSET:flash-65536 = "7168"
FLASH_RWFS_OFFSET:flash-65536 = "62400"

UBOOT_MACHINE = "PolegSVB_config"
UBOOT_DEVICETREE = "nuvoton-npcm730-kudo"
IGPS_MACHINE = "EB"

GBMC_MAC_EEPROM_OF_NAME = "bmcfru"
GBMC_NCSI_IF_NAME = "eth0"
GBMC_MAC_IF_MAP = "[0]='gbmcbr ncsi' [1]=eth1"

IMAGE_FSTYPES += " cpio.${INITRAMFS_CTYPE}.u-boot"

SERIAL_CONSOLES = "115200;ttyS0"

MACHINE_FEATURES += " \
    obmc-host-ipmi \
    obmc-phosphor-fan-mgmt \
    obmc-phosphor-flash-mgmt \
    obmc-phosphor-chassis-mgmt \
    "

PREFERRED_PROVIDER_virtual/obmc-system-mgmt = "packagegroup-kudo-apps"
PREFERRED_PROVIDER_virtual/obmc-host-ipmi-hw = "phosphor-ipmi-ssif"
PREFERRED_PROVIDER_virtual/obmc-flash-mgmt = "packagegroup-kudo-apps"
PREFERRED_PROVIDER_virtual/obmc-fan-mgmt = "packagegroup-kudo-apps"
VIRTUAL-RUNTIME_bmc-update = "kudo-bmc-update"
VIRTUAL-RUNTIME_bios-update = "kudo-bios-update"
PREFERRED_PROVIDER_virtual/obmc-chassis-mgmt = "packagegroup-kudo-apps"
# Remove unneeded binaries from image
IMAGE_FEATURES:remove = "obmc-health-monitor \
                         obmc-fan-control \
                         obmc-inventory \
                         obmc-bmcweb \
                        "
```

## meta-fii/meta-mori/conf/layer.conf
```bitbake
# We have a conf and classes directory, add to BBPATH
BBPATH .= ":${LAYERDIR}"

# We have recipes-* directories, add to BBFILES
BBFILES += "${LAYERDIR}/recipes-*/*/*.bb \
            ${LAYERDIR}/recipes-*/*/*.bbappend"

BBFILE_COLLECTIONS += "mori-layer"
BBFILE_PATTERN_mori-layer = "^${LAYERDIR}/"
LAYERSERIES_COMPAT_mori-layer = "scarthgap styhead"
LAYERDEPENDS_mori-layer = "core phosphor-layer google-layer fii-layer"
```
