## meta-fii/meta-mori/conf/machine/mori.conf
```bitbake
KMACHINE = "nuvoton"

require conf/machine/include/npcm7xx.inc
require conf/machine/include/obmc-bsp-common.inc

FLASH_SIZE = "65536"
FLASH_UBOOT_OFFSET:flash-65536 = "0"
FLASH_UBOOT_ENV_OFFSET:flash-65536 = "1024"
FLASH_KERNEL_OFFSET:flash-65536 = "2048"
FLASH_ROFS_OFFSET:flash-65536 = "7168"
FLASH_RWFS_OFFSET:flash-65536 = "62400"

UBOOT_MACHINE = "PolegSVB_config"
UBOOT_DEVICETREE = "nuvoton-npcm730-mori"
IGPS_MACHINE = "EB"

GBMC_MAC_EEPROM_OF_NAME = "bmcfru"
GBMC_NCSI_IF_NAME = "eth0"
GBMC_MAC_IF_MAP = "[0]='gbmcbr ncsi' [1]=eth1"

IMAGE_FSTYPES += " cpio.${INITRAMFS_CTYPE}.u-boot"

SERIAL_CONSOLES = "115200;ttyS0"

PREFERRED_PROVIDER_virtual/obmc-host-ipmi-hw = "phosphor-ipmi-ssif"
VIRTUAL-RUNTIME_bmc-update = "phosphor-ipmi-flash"
PREFERRED_PROVIDER_virtual/phosphor-led-manager-config-native = "mori-led-manager-config-native"

MACHINE_FEATURES += "dynamic-sensors"

# Remove unneeded binaries from image
IMAGE_FEATURES:remove = "obmc-console"
IMAGE_FEATURES:remove = "obmc-devtools"
IMAGE_FEATURES:remove = "obmc-fan-control"
IMAGE_FEATURES:remove = "obmc-fan-mgmt"
IMAGE_FEATURES:remove = "obmc-flash-mgmt"
IMAGE_FEATURES:remove = "obmc-health-monitor"
IMAGE_FEATURES:remove = "obmc-host-ipmi"
IMAGE_FEATURES:remove = "obmc-ikvm"
IMAGE_FEATURES:remove = "obmc-inventory"
IMAGE_FEATURES:remove = "obmc-leds"
IMAGE_FEATURES:remove = "obmc-logging-mgmt"
IMAGE_FEATURES:remove = "obmc-remote-logging-mgmt"
IMAGE_FEATURES:remove = "obmc-net-ipmi"
IMAGE_FEATURES:remove = "obmc-sensors"
IMAGE_FEATURES:remove = "obmc-software"
IMAGE_FEATURES:remove = "obmc-telemetry"
IMAGE_FEATURES:remove = "obmc-system-mgmt"
IMAGE_FEATURES:remove = "obmc-settings-mgmt"
IMAGE_FEATURES:remove = "obmc-network-mgmt"
IMAGE_FEATURES:remove = "obmc-user-mgmt-ldap"
OBMC_IMAGE_BASE_INSTALL:remove = "packagegroup-obmc-apps-extras"
```

## meta-google/conf/distro/gbmc.conf
```bitbake
require conf/distro/openbmc-phosphor.conf
require conf/distro/include/phosphor-isolation.inc
require conf/distro/include/phosphor-no-webui.inc

GBMC_VERSION ?= "0.5.0.0"
DISTRO = "gbmc"
DISTRO_NAME = "gBMC (OpenBMC + Google customizations)"
DISTRO_VERSION = "gbmc-release-${GBMC_VERSION}"
EXTENDED_VERSION = "${DISTRO_VERSION}"
DISTROOVERRIDES .= ":gbmc"

# Possible values: "dev", "prod", "local", "mfg"
GBMC_CONFIG ?= "local"
OVERRIDES .= ":${GBMC_CONFIG}:"
# mfg config includes local config
OVERRIDES:append:mfg = ":local:"
# local config will also include dev config
OVERRIDES:append:local = ":dev:"

DISTRO_FEATURES:remove = "avahi"
DISTRO_FEATURES:remove = "ldap"

# Required to get entity-manager to build with FruDevice service
DISTRO_FEATURES:append = " ipmi-fru"

# Disable u-boot shell for prod builds
DISTRO_FEATURES:append:prod = " disable-u-boot-shell"

WATCHDOG_PKG ?= "watchdog"

SANITY_TESTED_DISTROS:append = " Debian-rodete \n debian-rodete \n "

VIRTUAL-RUNTIME_bmc-update ??= "inplace-gbmc-update"

# Provides reasonable data integrity and faster than sha*
FIT_HASH_ALG = "crc32"

OBMC_ORG_YAML_SUBDIRS += " com/google"

# Force the patches to not have any fuzz for gBMC
ERROR_QA:append = " patch-fuzz"

IGPS_MACHINE_DEFAULT = "EB"
IGPS_MACHINE_DEFAULT:npcm8xx = "Google"
IGPS_MACHINE ?= "${IGPS_MACHINE_DEFAULT}"

# Remove dependencies on python3-core when using nftables
PACKAGECONFIG:remove:pn-nftables = "python"

# Do not configure TPM layer
SKIP_META_TPM_SANITY_CHECK = "1"

# Set /var/log directory to be volatile
PHOSPHOR_VOLATILE_VARLOG = "1"
```
