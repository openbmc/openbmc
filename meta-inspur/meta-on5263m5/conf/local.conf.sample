## meta-inventec/meta-common/conf/layer.conf
```bitbake
# We have a conf and classes directory, add to BBPATH
BBPATH .= ":${LAYERDIR}"

# We have recipes-* directories, add to BBFILES
BBFILES += "${LAYERDIR}/recipes-*/*/*.bb \
        ${LAYERDIR}/recipes-*/*/*.bbappend"

BBFILE_COLLECTIONS += "common"
BBFILE_PATTERN_common = "^${LAYERDIR}/"
BBFILE_PRIORITY_common = "10"
LAYERSERIES_COMPAT_common = "scarthgap styhead"
```

## meta-inventec/meta-lanyang/conf/bblayers.conf.sample
```bitbake
# LAYER_CONF_VERSION is increased each time build/conf/bblayers.conf
# changes incompatibly
LCONF_VERSION = "8"

BBPATH = "${TOPDIR}"
BBFILES ?= ""

BBLAYERS ?= " \
  ##OEROOT##/meta \
  ##OEROOT##/meta-poky \
  ##OEROOT##/meta-openembedded/meta-oe \
  ##OEROOT##/meta-openembedded/meta-networking \
  ##OEROOT##/meta-openembedded/meta-perl \
  ##OEROOT##/meta-openembedded/meta-python \
  ##OEROOT##/meta-phosphor \
  ##OEROOT##/meta-aspeed \
  ##OEROOT##/meta-openpower \
  ##OEROOT##/meta-inventec \
  ##OEROOT##/meta-inventec/meta-lanyang \
  "
BBLAYERS_NON_REMOVABLE ?= " \
  ##OEROOT##/meta \
  ##OEROOT##/meta-poky \
  ##OEROOT##/meta-openembedded/meta-oe \
  ##OEROOT##/meta-openembedded/meta-networking \
  ##OEROOT##/meta-openembedded/meta-perl \
  ##OEROOT##/meta-openembedded/meta-python \
  ##OEROOT##/meta-phosphor \
  ##OEROOT##/meta-aspeed \
  ##OEROOT##/meta-openpower \
  ##OEROOT##/meta-inventec \
  ##OEROOT##/meta-inventec/meta-lanyang \
  "
```

## meta-inventec/meta-lanyang/conf/layer.conf
```bitbake
# We have a conf and classes directory, add to BBPATH
BBPATH .= ":${LAYERDIR}"

# We have recipes-* directories, add to BBFILES
BBFILES += "${LAYERDIR}/recipes-*/*/*.bb \
            ${LAYERDIR}/recipes-*/*/*.bbappend"

BBFILE_COLLECTIONS += "lanyang"
BBFILE_PATTERN_lanyang = ""
```

## meta-inventec/meta-starscream/conf/layer.conf
```bitbake
# We have a conf and classes directory, add to BBPATH
BBPATH .= ":${LAYERDIR}"

# We have recipes-* directories, add to BBFILES
BBFILES += "${LAYERDIR}/recipes-*/*/*.bb \
            ${LAYERDIR}/recipes-*/*/*.bbappend"

BBFILE_COLLECTIONS += "starscream"
BBFILE_PATTERN_starscream = "^${LAYERDIR}/"
BBFILE_PRIORITY_starscream = "7"
LAYERSERIES_COMPAT_starscream = "scarthgap styhead"
```

## meta-inventec/meta-starscream/conf/machine/starscream.conf
```bitbake
KMACHINE = "aspeed"
KERNEL_DEVICETREE = "aspeed/${KMACHINE}-bmc-inventec-${MACHINE}.dtb"

require conf/machine/include/ast2600.inc
require conf/machine/include/obmc-bsp-common.inc
require conf/machine/include/inventec.inc

UBOOT_MACHINE = "ast2600_openbmc_spl_defconfig"
UBOOT_DEVICETREE = "ast2600-evb"
SPL_BINARY = "spl/u-boot-spl.bin"
SOCSEC_SIGN_ENABLE = "0"

# To build a 64MB image, set FLASH_SIZE value to "65536".
FLASH_SIZE = "65536"
```

## meta-inventec/meta-transformers/conf/layer.conf
```bitbake
# We have a conf and classes directory, add to BBPATH
BBPATH .= ":${LAYERDIR}"

# We have recipes-* directories, add to BBFILES
BBFILES += "${LAYERDIR}/recipes-*/*/*.bb \
            ${LAYERDIR}/recipes-*/*/*.bbappend"

BBFILE_COLLECTIONS += "transformers"
BBFILE_PATTERN_transformers = "^${LAYERDIR}/"
BBFILE_PRIORITY_transformers = "7"
LAYERSERIES_COMPAT_transformers = "scarthgap styhead"
```

## meta-inventec/meta-transformers/conf/machine/platform_configs.inc
```bitbake
# This include file is aim to pass variables to bb/bb.apppend files,
# such as sysguid tool, and easily maintain platform settings


##################### Configure default EEPROM setting #####################
### The I2C bus is "0 based, decimal"
### The address and offset are "hexcimal"
### e.g.
###     EEPROM_GUID_I2C_BUS = "3"
###     EEPROM_GUID_I2C_ADDRESS = "0x54"
###     EEPROM_GUID_OFFSET = "0x1F00"

EEPROM_GUID_I2C_BUS= "3"
EEPROM_GUID_I2C_ADDRESS = "0x54"
EEPROM_GUID_OFFSET = "0x1F00"

EEPROM_MAC_I2C_BUS = "14"
EEPROM_MAC_I2C_ADDRESS = "0x50"
EEPROM_MAC_OFFSET = "0x1000"

############################################################################
```

## meta-inventec/meta-transformers/conf/machine/transformers.conf
```bitbake
KMACHINE = "aspeed"
KERNEL_DEVICETREE = "aspeed/${KMACHINE}-bmc-inventec-${MACHINE}.dtb"

require conf/machine/include/ast2600.inc
require conf/machine/include/obmc-bsp-common.inc
require conf/machine/include/inventec.inc

UBOOT_MACHINE = "transformers-ast2600_defconfig"
UBOOT_DEVICETREE = "ast2600-transformers"

# To build a 64MB image, set FLASH_SIZE value to "65536".
FLASH_SIZE = "65536"
# Overwrite flash offsets
FLASH_UBOOT_OFFSET = "0"
FLASH_KERNEL_OFFSET = "1024"
FLASH_ROFS_OFFSET = "10240"
FLASH_RWFS_OFFSET = "43008"
```

## meta-lenovo/conf/layer.conf
```bitbake
#"Copyright ? 2019-present Lenovo
#Licensed under BSD-3, see COPYING.BSD file for details."


# We have a conf and classes directory, add to BBPATH
BBPATH .= ":${LAYERDIR}"

# We have recipes-* directories, add to BBFILES
BBFILES += "${LAYERDIR}/meta-common/recipes-*/*/*.bb \
            ${LAYERDIR}/meta-common/recipes-*/*/*.bbappend"

BBFILE_COLLECTIONS += "lenovo-layer"
BBFILE_PATTERN_lenovo-layer = ""
LAYERVERSION_lenovo-layer = "1"
LAYERSERIES_COMPAT_lenovo-layer = "dunfell gatesgarth"

# Provide a variable that points the base of the lenovo layer.
LENOVOBASE = '${@os.path.normpath("${LAYERDIR}/")}'
```

## meta-lenovo/conf/machine/include/lenovo.inc
```bitbake
#"Copyright ? 2019-present Lenovo
#Licensed under BSD-3, see COPYING.BSD file for details."

OBMC_MACHINE_FEATURES += "\
        obmc-phosphor-fan-mgmt \
        obmc-phosphor-chassis-mgmt \
        obmc-phosphor-flash-mgmt \
        obmc-host-ipmi \
        obmc-host-state-mgmt \
        obmc-chassis-state-mgmt \
        obmc-bmc-state-mgmt \
        "

VIRTUAL-RUNTIME_skeleton_workbook = "${MACHINE}-config"
```

## meta-lenovo/meta-hr630/conf/distro/openbmc-hr630.conf
```bitbake
#"Copyright (c) 2019-present Lenovo
#Licensed under BSD-3, see COPYING.BSD file for details."

require conf/distro/include/phosphor-base.inc

DISTRO_NAME = "Lenovo Hr630 OpenBMC"
DISTRO_VERSION = "0.1.2"
```

## meta-lenovo/meta-hr630/conf/layer.conf
```bitbake
#"Copyright (c) 2019-present Lenovo
#Licensed under BSD-3, see COPYING.BSD file for details."

# We have a conf and classes directory, add to BBPATH
BBPATH .= ":${LAYERDIR}"

# We have recipes-* directories, add to BBFILES
BBFILES += "${LAYERDIR}/recipes-*/*/*.bb \
            ${LAYERDIR}/recipes-*/*/*.bbappend"

BBFILE_COLLECTIONS += "hr630-layer"
BBFILE_PATTERN_hr630-layer = ""
BBFILE_PRIORITY_hr630-layer = "5"
LAYERSERIES_COMPAT_hr630-layer = "dunfell gatesgarth"
```

## meta-lenovo/meta-hr630/conf/machine/hr630.conf
```bitbake
#"Copyright (c) 2019-present Lenovo
#Licensed under BSD-3, see COPYING.BSD file for details."

KMACHINE = "aspeed"
KERNEL_DEVICETREE = "${KMACHINE}-bmc-lenovo-${MACHINE}.dtb"

UBOOT_MACHINE = "ast_g5_phy_config"

require conf/machine/include/ast2500.inc
require conf/machine/include/obmc-bsp-common.inc
require conf/machine/include/lenovo.inc

FLASH_SIZE = "32768"

PREFERRED_PROVIDER_virtual/obmc-host-ipmi-hw = "phosphor-ipmi-kcs"
PREFERRED_PROVIDER_virtual/phosphor-led-manager-config-native = "hr630-led-manager-config-native"
PREFERRED_PROVIDER_virtual/phosphor-ipmi-sensor-inventory = "hr630-ipmi-sensor-inventory-native"
PREFERRED_PROVIDER_virtual/phosphor-ipmi-fru-read-inventory = "hr630-ipmi-fru-read-inventory-native"
PREFERRED_PROVIDER_virtual/phosphor-ipmi-fru-inventory = "hr630-ipmi-inventory-map-native"
PREFERRED_PROVIDER_virtual/phosphor-ipmi-fru-properties = "hr630-ipmi-fru-properties-native"
PREFERRED_PROVIDER_virtual/obmc-chassis-mgmt = "packagegroup-lenovo-apps"
PREFERRED_PROVIDER_virtual/obmc-fan-mgmt = "packagegroup-lenovo-apps"
PREFERRED_PROVIDER_virtual/obmc-flash-mgmt = "packagegroup-lenovo-apps"
PREFERRED_PROVIDER_virtual/obmc-system-mgmt = "packagegroup-lenovo-apps"
PREFERRED_PROVIDER_virtual/obmc-inventory-data ?= "${VIRTUAL-RUNTIME_skeleton_workbook}"
```

## meta-lenovo/meta-hr855xg2/conf/bblayers.conf.sample
```bitbake
#"Copyright (c) 2019-present Lenovo
#Licensed under BSD-3, see COPYING.BSD file for details."

# LAYER_CONF_VERSION is increased each time build/conf/bblayers.conf
# changes incompatibly
LCONF_VERSION = "8"

BBPATH = "${TOPDIR}"
BBFILES ?= ""

BBLAYERS ?= " \
  ##OEROOT##/meta \
  ##OEROOT##/meta-openembedded/meta-oe \
  ##OEROOT##/meta-openembedded/meta-networking \
  ##OEROOT##/meta-openembedded/meta-python \
  ##OEROOT##/meta-openembedded/meta-webserver \
  ##OEROOT##/meta-phosphor \
  ##OEROOT##/meta-aspeed \
  ##OEROOT##/meta-x86 \
  ##OEROOT##/meta-google \
  ##OEROOT##/meta-lenovo \
  ##OEROOT##/meta-lenovo/meta-hr855xg2 \
  "
```

## meta-lenovo/meta-hr855xg2/conf/distro/openbmc-hr855xg2.conf
```bitbake
#"Copyright (c) 2019-present Lenovo
#Licensed under BSD-3, see COPYING.BSD file for details."

require conf/distro/openbmc-phosphor.conf

DISTRO_NAME = "Lenovo Hr855xg2 OpenBMC"
DISTRO_VERSION = "0.05"
```

## meta-lenovo/meta-hr855xg2/conf/layer.conf
```bitbake
#"Copyright (c) 2019-present Lenovo
#Licensed under BSD-3, see COPYING.BSD file for details."

# We have a conf and classes directory, add to BBPATH
BBPATH .= ":${LAYERDIR}"

# We have recipes-* directories, add to BBFILES
BBFILES += "${LAYERDIR}/recipes-*/*/*.bb \
            ${LAYERDIR}/recipes-*/*/*.bbappend"

BBFILE_COLLECTIONS += "hr855xg2-layer"
BBFILE_PATTERN_hr855xg2-layer := "^${LAYERDIR}/"
BBFILE_PRIORITY_hr855xg2-layer = "5"
LAYERSERIES_COMPAT_hr855xg2-layer = "dunfell gatesgarth"
```
